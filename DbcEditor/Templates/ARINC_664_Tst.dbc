VERSION ""

NS_ :

BS_:

BU_: IOM_A_34_3

BO_ 437922684 TESTMSG22_INT: 1400 IOM_A_34_3
 SG_ IOM_A_34_VFG_OIL_TEMP22_A_51 : 871|32@0- (1,0) [0|100] "deg C" Vector__XXX
 SG_ FS_HSMU_TEST22_21 : 839|8@0+ (1,0) [0|0] "" Vector__XXX
 SG_ IOM_A_34_VFG_OIL_TEMP22_A_50 : 807|32@0- (1,0) [0|100] "deg C" Vector__XXX
 SG_ FS_HSMU_TEST22_20 : 703|8@0+ (1,0) [0|0] "" Vector__XXX
 SG_ IOM_A_34_VFG_OIL_TEMP22_A_49 : 775|32@0- (1,0) [0|100] "deg C" Vector__XXX
 SG_ FS_HSMU_TEST22_19 : 695|8@0+ (1,0) [0|0] "" Vector__XXX
 SG_ IOM_A_34_VFG_OIL_TEMP22_A_48 : 743|32@0- (1,0) [0|100] "deg C" Vector__XXX
 SG_ FS_HSMU_TEST22_18 : 687|8@0+ (1,0) [0|0] "" Vector__XXX
 SG_ IOM_A_34_VFG_OIL_TEMP22_A_47 : 711|32@0- (1,0) [0|100] "deg C" Vector__XXX
 SG_ FS_HSMU_TEST22_17 : 679|8@0+ (1,0) [0|0] "" Vector__XXX
 SG_ IOM_A_34_VFG_OIL_TEMP22_A_46 : 647|32@0- (1,0) [0|100] "deg C" Vector__XXX
 SG_ FS_HSMU_TEST22_16 : 543|8@0+ (1,0) [0|0] "" Vector__XXX
 SG_ IOM_A_34_VFG_OIL_TEMP22_A_45 : 615|32@0- (1,0) [0|100] "deg C" Vector__XXX
 SG_ FS_HSMU_TEST22_15 : 535|8@0+ (1,0) [0|0] "" Vector__XXX
 SG_ IOM_A_34_VFG_OIL_TEMP22_A_44 : 583|32@0- (1,0) [0|100] "deg C" Vector__XXX
 SG_ FS_HSMU_TEST22_14 : 527|8@0+ (1,0) [0|0] "" Vector__XXX
 SG_ IOM_A_34_VFG_OIL_TEMP22_A_43 : 551|32@0- (1,0) [0|100] "deg C" Vector__XXX
 SG_ FS_HSMU_TEST22_13 : 519|8@0+ (1,0) [0|0] "" Vector__XXX
 SG_ IOM_A_34_VFG_OIL_TEMP22_A_42 : 487|32@0- (1,0) [0|100] "deg C" Vector__XXX
 SG_ FS_HSMU_TEST22_12 : 383|8@0+ (1,0) [0|0] "" Vector__XXX
 SG_ IOM_A_34_VFG_OIL_TEMP22_A_41 : 455|32@0- (1,0) [0|100] "deg C" Vector__XXX
 SG_ FS_HSMU_TEST22_11 : 375|8@0+ (1,0) [0|0] "" Vector__XXX
 SG_ IOM_A_34_VFG_OIL_TEMP22_A_40 : 423|32@0- (1,0) [0|100] "deg C" Vector__XXX
 SG_ FS_HSMU_TEST22_10 : 367|8@0+ (1,0) [0|0] "" Vector__XXX
 SG_ IOM_A_34_VFG_OIL_TEMP22_A_39 : 391|32@0- (1,0) [0|100] "deg C" Vector__XXX
 SG_ FS_HSMU_TEST22_9 : 359|8@0+ (1,0) [0|0] "" Vector__XXX
 SG_ IOM_A_34_VFG_OIL_TEMP22_A_38 : 327|32@0- (1,0) [0|100] "deg C" Vector__XXX
 SG_ FS_HSMU_TEST22_8 : 223|8@0+ (1,0) [0|0] "" Vector__XXX
 SG_ IOM_A_34_VFG_OIL_TEMP22_A_37 : 295|32@0- (1,0) [0|100] "deg C" Vector__XXX
 SG_ FS_HSMU_TEST22_7 : 215|8@0+ (1,0) [0|0] "" Vector__XXX
 SG_ IOM_A_34_VFG_OIL_TEMP22_A_36 : 263|32@0- (1,0) [0|100] "deg C" Vector__XXX
 SG_ FS_HSMU_TEST22_6 : 207|8@0+ (1,0) [0|0] "" Vector__XXX
 SG_ IOM_A_34_VFG_OIL_TEMP22_A_35 : 231|32@0- (1,0) [0|100] "deg C" Vector__XXX
 SG_ FS_HSMU_TEST22_5 : 199|8@0+ (1,0) [0|0] "" Vector__XXX
 SG_ IOM_A_34_VFG_OIL_TEMP22_A_34 : 167|32@0- (1,0) [0|100] "deg C" Vector__XXX
 SG_ FS_HSMU_TEST22_4 : 63|8@0+ (1,0) [0|0] "" Vector__XXX
 SG_ IOM_A_34_VFG_OIL_TEMP22_A_33 : 135|32@0- (1,0) [0|100] "deg C" Vector__XXX
 SG_ FS_HSMU_TEST22_3 : 55|8@0+ (1,0) [0|0] "" Vector__XXX
 SG_ IOM_A_34_VFG_OIL_TEMP22_A_32 : 103|32@0- (1,0) [0|100] "deg C" Vector__XXX
 SG_ FS_HSMU_TEST22_2 : 47|8@0+ (1,0) [0|0] "" Vector__XXX
 SG_ IOM_A_34_VFG_OIL_TEMP22_A_31 : 71|32@0- (1,0) [0|100] "deg C" Vector__XXX
 SG_ FS_HSMU_TEST22_1 : 39|8@0+ (1,0) [0|0] "" Vector__XXX

BO_ 437857147 TESTMSG21_INT: 1400 IOM_A_34_3
 SG_ IOM_A_34_VFG_OIL_TEMP21_A_70 : 1607|32@0- (1,0) [0|100] "deg C" Vector__XXX
 SG_ FS_HSMU_TEST21_40 : 1503|8@0+ (1,0) [0|0] "" Vector__XXX
 SG_ IOM_A_34_VFG_OIL_TEMP21_A_69 : 1575|32@0- (1,0) [0|100] "deg C" Vector__XXX
 SG_ FS_HSMU_TEST21_39 : 1495|8@0+ (1,0) [0|0] "" Vector__XXX
 SG_ IOM_A_34_VFG_OIL_TEMP21_A_68 : 1543|32@0- (1,0) [0|100] "deg C" Vector__XXX
 SG_ FS_HSMU_TEST21_38 : 1487|8@0+ (1,0) [0|0] "" Vector__XXX
 SG_ IOM_A_34_VFG_OIL_TEMP21_A_67 : 1511|32@0- (1,0) [0|100] "deg C" Vector__XXX
 SG_ FS_HSMU_TEST21_37 : 1479|8@0+ (1,0) [0|0] "" Vector__XXX
 SG_ IOM_A_34_VFG_OIL_TEMP21_A_66 : 1447|32@0- (1,0) [0|100] "deg C" Vector__XXX
 SG_ FS_HSMU_TEST21_36 : 1343|8@0+ (1,0) [0|0] "" Vector__XXX
 SG_ IOM_A_34_VFG_OIL_TEMP21_A_65 : 1415|32@0- (1,0) [0|100] "deg C" Vector__XXX
 SG_ FS_HSMU_TEST21_35 : 1335|8@0+ (1,0) [0|0] "" Vector__XXX
 SG_ IOM_A_34_VFG_OIL_TEMP21_A_64 : 1383|32@0- (1,0) [0|100] "deg C" Vector__XXX
 SG_ FS_HSMU_TEST21_34 : 1327|8@0+ (1,0) [0|0] "" Vector__XXX
 SG_ IOM_A_34_VFG_OIL_TEMP21_A_63 : 1351|32@0- (1,0) [0|100] "deg C" Vector__XXX
 SG_ FS_HSMU_TEST21_33 : 1319|8@0+ (1,0) [0|0] "" Vector__XXX
 SG_ IOM_A_34_VFG_OIL_TEMP21_A_62 : 1287|32@0- (1,0) [0|100] "deg C" Vector__XXX
 SG_ FS_HSMU_TEST21_32 : 1183|8@0+ (1,0) [0|0] "" Vector__XXX
 SG_ IOM_A_34_VFG_OIL_TEMP21_A_61 : 1255|32@0- (1,0) [0|100] "deg C" Vector__XXX
 SG_ FS_HSMU_TEST21_31 : 1175|8@0+ (1,0) [0|0] "" Vector__XXX
 SG_ IOM_A_34_VFG_OIL_TEMP21_A_60 : 1223|32@0- (1,0) [0|100] "deg C" Vector__XXX
 SG_ FS_HSMU_TEST21_30 : 1167|8@0+ (1,0) [0|0] "" Vector__XXX
 SG_ IOM_A_34_VFG_OIL_TEMP21_A_59 : 1191|32@0- (1,0) [0|100] "deg C" Vector__XXX
 SG_ FS_HSMU_TEST21_29 : 1159|8@0+ (1,0) [0|0] "" Vector__XXX
 SG_ IOM_A_34_VFG_OIL_TEMP21_A_58 : 1127|32@0- (1,0) [0|100] "deg C" Vector__XXX
 SG_ FS_HSMU_TEST21_28 : 1023|8@0+ (1,0) [0|0] "" Vector__XXX
 SG_ IOM_A_34_VFG_OIL_TEMP21_A_57 : 1095|32@0- (1,0) [0|100] "deg C" Vector__XXX
 SG_ FS_HSMU_TEST21_27 : 1015|8@0+ (1,0) [0|0] "" Vector__XXX
 SG_ IOM_A_34_VFG_OIL_TEMP21_A_56 : 1063|32@0- (1,0) [0|100] "deg C" Vector__XXX
 SG_ FS_HSMU_TEST21_26 : 1007|8@0+ (1,0) [0|0] "" Vector__XXX
 SG_ IOM_A_34_VFG_OIL_TEMP21_A_55 : 1031|32@0- (1,0) [0|100] "deg C" Vector__XXX
 SG_ FS_HSMU_TEST21_25 : 999|8@0+ (1,0) [0|0] "" Vector__XXX
 SG_ IOM_A_34_VFG_OIL_TEMP21_A_54 : 967|32@0- (1,0) [0|100] "deg C" Vector__XXX
 SG_ FS_HSMU_TEST21_24 : 863|8@0+ (1,0) [0|0] "" Vector__XXX
 SG_ IOM_A_34_VFG_OIL_TEMP21_A_53 : 935|32@0- (1,0) [0|100] "deg C" Vector__XXX
 SG_ FS_HSMU_TEST21_23 : 855|8@0+ (1,0) [0|0] "" Vector__XXX
 SG_ IOM_A_34_VFG_OIL_TEMP21_A_52 : 903|32@0- (1,0) [0|100] "deg C" Vector__XXX
 SG_ FS_HSMU_TEST21_22 : 847|8@0+ (1,0) [0|0] "" Vector__XXX
 SG_ IOM_A_34_VFG_OIL_TEMP21_A_51 : 871|32@0- (1,0) [0|100] "deg C" Vector__XXX
 SG_ FS_HSMU_TEST21_21 : 839|8@0+ (1,0) [0|0] "" Vector__XXX
 SG_ IOM_A_34_VFG_OIL_TEMP21_A_50 : 807|32@0- (1,0) [0|100] "deg C" Vector__XXX
 SG_ FS_HSMU_TEST21_20 : 703|8@0+ (1,0) [0|0] "" Vector__XXX
 SG_ IOM_A_34_VFG_OIL_TEMP21_A_49 : 775|32@0- (1,0) [0|100] "deg C" Vector__XXX
 SG_ FS_HSMU_TEST21_19 : 695|8@0+ (1,0) [0|0] "" Vector__XXX
 SG_ IOM_A_34_VFG_OIL_TEMP21_A_48 : 743|32@0- (1,0) [0|100] "deg C" Vector__XXX
 SG_ FS_HSMU_TEST21_18 : 687|8@0+ (1,0) [0|0] "" Vector__XXX
 SG_ IOM_A_34_VFG_OIL_TEMP21_A_47 : 711|32@0- (1,0) [0|100] "deg C" Vector__XXX
 SG_ FS_HSMU_TEST21_17 : 679|8@0+ (1,0) [0|0] "" Vector__XXX
 SG_ IOM_A_34_VFG_OIL_TEMP21_A_46 : 647|32@0- (1,0) [0|100] "deg C" Vector__XXX
 SG_ FS_HSMU_TEST21_16 : 543|8@0+ (1,0) [0|0] "" Vector__XXX
 SG_ IOM_A_34_VFG_OIL_TEMP21_A_45 : 615|32@0- (1,0) [0|100] "deg C" Vector__XXX
 SG_ FS_HSMU_TEST21_15 : 535|8@0+ (1,0) [0|0] "" Vector__XXX
 SG_ IOM_A_34_VFG_OIL_TEMP21_A_44 : 583|32@0- (1,0) [0|100] "deg C" Vector__XXX
 SG_ FS_HSMU_TEST21_14 : 527|8@0+ (1,0) [0|0] "" Vector__XXX
 SG_ IOM_A_34_VFG_OIL_TEMP21_A_43 : 551|32@0- (1,0) [0|100] "deg C" Vector__XXX
 SG_ FS_HSMU_TEST21_13 : 519|8@0+ (1,0) [0|0] "" Vector__XXX
 SG_ IOM_A_34_VFG_OIL_TEMP21_A_42 : 487|32@0- (1,0) [0|100] "deg C" Vector__XXX
 SG_ FS_HSMU_TEST21_12 : 383|8@0+ (1,0) [0|0] "" Vector__XXX
 SG_ IOM_A_34_VFG_OIL_TEMP21_A_41 : 455|32@0- (1,0) [0|100] "deg C" Vector__XXX
 SG_ FS_HSMU_TEST21_11 : 375|8@0+ (1,0) [0|0] "" Vector__XXX
 SG_ IOM_A_34_VFG_OIL_TEMP21_A_40 : 423|32@0- (1,0) [0|100] "deg C" Vector__XXX
 SG_ FS_HSMU_TEST21_10 : 367|8@0+ (1,0) [0|0] "" Vector__XXX
 SG_ IOM_A_34_VFG_OIL_TEMP21_A_39 : 391|32@0- (1,0) [0|100] "deg C" Vector__XXX
 SG_ FS_HSMU_TEST21_9 : 359|8@0+ (1,0) [0|0] "" Vector__XXX
 SG_ IOM_A_34_VFG_OIL_TEMP21_A_38 : 327|32@0- (1,0) [0|100] "deg C" Vector__XXX
 SG_ FS_HSMU_TEST21_8 : 223|8@0+ (1,0) [0|0] "" Vector__XXX
 SG_ IOM_A_34_VFG_OIL_TEMP21_A_37 : 295|32@0- (1,0) [0|100] "deg C" Vector__XXX
 SG_ FS_HSMU_TEST21_7 : 215|8@0+ (1,0) [0|0] "" Vector__XXX
 SG_ IOM_A_34_VFG_OIL_TEMP21_A_36 : 263|32@0- (1,0) [0|100] "deg C" Vector__XXX
 SG_ FS_HSMU_TEST21_6 : 207|8@0+ (1,0) [0|0] "" Vector__XXX
 SG_ IOM_A_34_VFG_OIL_TEMP21_A_35 : 231|32@0- (1,0) [0|100] "deg C" Vector__XXX
 SG_ FS_HSMU_TEST21_5 : 199|8@0+ (1,0) [0|0] "" Vector__XXX
 SG_ IOM_A_34_VFG_OIL_TEMP21_A_34 : 167|32@0- (1,0) [0|100] "deg C" Vector__XXX
 SG_ FS_HSMU_TEST21_4 : 63|8@0+ (1,0) [0|0] "" Vector__XXX
 SG_ IOM_A_34_VFG_OIL_TEMP21_A_33 : 135|32@0- (1,0) [0|100] "deg C" Vector__XXX
 SG_ FS_HSMU_TEST21_3 : 55|8@0+ (1,0) [0|0] "" Vector__XXX
 SG_ IOM_A_34_VFG_OIL_TEMP21_A_32 : 103|32@0- (1,0) [0|100] "deg C" Vector__XXX
 SG_ FS_HSMU_TEST21_2 : 47|8@0+ (1,0) [0|0] "" Vector__XXX
 SG_ IOM_A_34_VFG_OIL_TEMP21_A_31 : 71|32@0- (1,0) [0|100] "deg C" Vector__XXX
 SG_ FS_HSMU_TEST21_1 : 39|8@0+ (1,0) [0|0] "" Vector__XXX

BO_ 437791610 TESTMSG20_INT: 1400 IOM_A_34_3
 SG_ IOM_A_34_VFG_OIL_TEMP20_A_130 : 4007|32@0- (1,0) [0|100] "deg C" Vector__XXX
 SG_ FS_HSMU_TEST20_100 : 3903|8@0+ (1,0) [0|0] "" Vector__XXX
 SG_ IOM_A_34_VFG_OIL_TEMP20_A_129 : 3975|32@0- (1,0) [0|100] "deg C" Vector__XXX
 SG_ FS_HSMU_TEST20_99 : 3895|8@0+ (1,0) [0|0] "" Vector__XXX
 SG_ IOM_A_34_VFG_OIL_TEMP20_A_128 : 3943|32@0- (1,0) [0|100] "deg C" Vector__XXX
 SG_ FS_HSMU_TEST20_98 : 3887|8@0+ (1,0) [0|0] "" Vector__XXX
 SG_ IOM_A_34_VFG_OIL_TEMP20_A_127 : 3911|32@0- (1,0) [0|100] "deg C" Vector__XXX
 SG_ FS_HSMU_TEST20_97 : 3879|8@0+ (1,0) [0|0] "" Vector__XXX
 SG_ IOM_A_34_VFG_OIL_TEMP20_A_126 : 3847|32@0- (1,0) [0|100] "deg C" Vector__XXX
 SG_ FS_HSMU_TEST20_96 : 3743|8@0+ (1,0) [0|0] "" Vector__XXX
 SG_ IOM_A_34_VFG_OIL_TEMP20_A_125 : 3815|32@0- (1,0) [0|100] "deg C" Vector__XXX
 SG_ FS_HSMU_TEST20_95 : 3735|8@0+ (1,0) [0|0] "" Vector__XXX
 SG_ IOM_A_34_VFG_OIL_TEMP20_A_124 : 3783|32@0- (1,0) [0|100] "deg C" Vector__XXX
 SG_ FS_HSMU_TEST20_94 : 3727|8@0+ (1,0) [0|0] "" Vector__XXX
 SG_ IOM_A_34_VFG_OIL_TEMP20_A_123 : 3751|32@0- (1,0) [0|100] "deg C" Vector__XXX
 SG_ FS_HSMU_TEST20_93 : 3719|8@0+ (1,0) [0|0] "" Vector__XXX
 SG_ IOM_A_34_VFG_OIL_TEMP20_A_122 : 3687|32@0- (1,0) [0|100] "deg C" Vector__XXX
 SG_ FS_HSMU_TEST20_92 : 3583|8@0+ (1,0) [0|0] "" Vector__XXX
 SG_ IOM_A_34_VFG_OIL_TEMP20_A_121 : 3655|32@0- (1,0) [0|100] "deg C" Vector__XXX
 SG_ FS_HSMU_TEST20_91 : 3575|8@0+ (1,0) [0|0] "" Vector__XXX
 SG_ IOM_A_34_VFG_OIL_TEMP20_A_120 : 3623|32@0- (1,0) [0|100] "deg C" Vector__XXX
 SG_ FS_HSMU_TEST20_90 : 3567|8@0+ (1,0) [0|0] "" Vector__XXX
 SG_ IOM_A_34_VFG_OIL_TEMP20_A_119 : 3591|32@0- (1,0) [0|100] "deg C" Vector__XXX
 SG_ FS_HSMU_TEST20_89 : 3559|8@0+ (1,0) [0|0] "" Vector__XXX
 SG_ IOM_A_34_VFG_OIL_TEMP20_A_118 : 3527|32@0- (1,0) [0|100] "deg C" Vector__XXX
 SG_ FS_HSMU_TEST20_88 : 3423|8@0+ (1,0) [0|0] "" Vector__XXX
 SG_ IOM_A_34_VFG_OIL_TEMP20_A_117 : 3495|32@0- (1,0) [0|100] "deg C" Vector__XXX
 SG_ FS_HSMU_TEST20_87 : 3415|8@0+ (1,0) [0|0] "" Vector__XXX
 SG_ IOM_A_34_VFG_OIL_TEMP20_A_116 : 3463|32@0- (1,0) [0|100] "deg C" Vector__XXX
 SG_ FS_HSMU_TEST20_86 : 3407|8@0+ (1,0) [0|0] "" Vector__XXX
 SG_ IOM_A_34_VFG_OIL_TEMP20_A_115 : 3431|32@0- (1,0) [0|100] "deg C" Vector__XXX
 SG_ FS_HSMU_TEST20_85 : 3399|8@0+ (1,0) [0|0] "" Vector__XXX
 SG_ IOM_A_34_VFG_OIL_TEMP20_A_114 : 3367|32@0- (1,0) [0|100] "deg C" Vector__XXX
 SG_ FS_HSMU_TEST20_84 : 3263|8@0+ (1,0) [0|0] "" Vector__XXX
 SG_ IOM_A_34_VFG_OIL_TEMP20_A_113 : 3335|32@0- (1,0) [0|100] "deg C" Vector__XXX
 SG_ FS_HSMU_TEST20_83 : 3255|8@0+ (1,0) [0|0] "" Vector__XXX
 SG_ IOM_A_34_VFG_OIL_TEMP20_A_112 : 3303|32@0- (1,0) [0|100] "deg C" Vector__XXX
 SG_ FS_HSMU_TEST20_82 : 3247|8@0+ (1,0) [0|0] "" Vector__XXX
 SG_ IOM_A_34_VFG_OIL_TEMP20_A_111 : 3271|32@0- (1,0) [0|100] "deg C" Vector__XXX
 SG_ FS_HSMU_TEST20_81 : 3239|8@0+ (1,0) [0|0] "" Vector__XXX
 SG_ IOM_A_34_VFG_OIL_TEMP20_A_110 : 3207|32@0- (1,0) [0|100] "deg C" Vector__XXX
 SG_ FS_HSMU_TEST20_80 : 3103|8@0+ (1,0) [0|0] "" Vector__XXX
 SG_ IOM_A_34_VFG_OIL_TEMP20_A_109 : 3175|32@0- (1,0) [0|100] "deg C" Vector__XXX
 SG_ FS_HSMU_TEST20_79 : 3095|8@0+ (1,0) [0|0] "" Vector__XXX
 SG_ IOM_A_34_VFG_OIL_TEMP20_A_108 : 3143|32@0- (1,0) [0|100] "deg C" Vector__XXX
 SG_ FS_HSMU_TEST20_78 : 3087|8@0+ (1,0) [0|0] "" Vector__XXX
 SG_ IOM_A_34_VFG_OIL_TEMP20_A_107 : 3111|32@0- (1,0) [0|100] "deg C" Vector__XXX
 SG_ FS_HSMU_TEST20_77 : 3079|8@0+ (1,0) [0|0] "" Vector__XXX
 SG_ IOM_A_34_VFG_OIL_TEMP20_A_106 : 3047|32@0- (1,0) [0|100] "deg C" Vector__XXX
 SG_ FS_HSMU_TEST20_76 : 2943|8@0+ (1,0) [0|0] "" Vector__XXX
 SG_ IOM_A_34_VFG_OIL_TEMP20_A_105 : 3015|32@0- (1,0) [0|100] "deg C" Vector__XXX
 SG_ FS_HSMU_TEST20_75 : 2935|8@0+ (1,0) [0|0] "" Vector__XXX
 SG_ IOM_A_34_VFG_OIL_TEMP20_A_104 : 2983|32@0- (1,0) [0|100] "deg C" Vector__XXX
 SG_ FS_HSMU_TEST20_74 : 2927|8@0+ (1,0) [0|0] "" Vector__XXX
 SG_ IOM_A_34_VFG_OIL_TEMP20_A_103 : 2951|32@0- (1,0) [0|100] "deg C" Vector__XXX
 SG_ FS_HSMU_TEST20_73 : 2919|8@0+ (1,0) [0|0] "" Vector__XXX
 SG_ IOM_A_34_VFG_OIL_TEMP20_A_102 : 2887|32@0- (1,0) [0|100] "deg C" Vector__XXX
 SG_ FS_HSMU_TEST20_72 : 2783|8@0+ (1,0) [0|0] "" Vector__XXX
 SG_ IOM_A_34_VFG_OIL_TEMP20_A_101 : 2855|32@0- (1,0) [0|100] "deg C" Vector__XXX
 SG_ FS_HSMU_TEST20_71 : 2775|8@0+ (1,0) [0|0] "" Vector__XXX
 SG_ IOM_A_34_VFG_OIL_TEMP20_A_100 : 2823|32@0- (1,0) [0|100] "deg C" Vector__XXX
 SG_ FS_HSMU_TEST20_70 : 2767|8@0+ (1,0) [0|0] "" Vector__XXX
 SG_ IOM_A_34_VFG_OIL_TEMP20_A_99 : 2791|32@0- (1,0) [0|100] "deg C" Vector__XXX
 SG_ FS_HSMU_TEST20_69 : 2759|8@0+ (1,0) [0|0] "" Vector__XXX
 SG_ IOM_A_34_VFG_OIL_TEMP20_A_98 : 2727|32@0- (1,0) [0|100] "deg C" Vector__XXX
 SG_ FS_HSMU_TEST20_68 : 2623|8@0+ (1,0) [0|0] "" Vector__XXX
 SG_ IOM_A_34_VFG_OIL_TEMP20_A_97 : 2695|32@0- (1,0) [0|100] "deg C" Vector__XXX
 SG_ FS_HSMU_TEST20_67 : 2615|8@0+ (1,0) [0|0] "" Vector__XXX
 SG_ IOM_A_34_VFG_OIL_TEMP20_A_96 : 2663|32@0- (1,0) [0|100] "deg C" Vector__XXX
 SG_ FS_HSMU_TEST20_66 : 2607|8@0+ (1,0) [0|0] "" Vector__XXX
 SG_ IOM_A_34_VFG_OIL_TEMP20_A_95 : 2631|32@0- (1,0) [0|100] "deg C" Vector__XXX
 SG_ FS_HSMU_TEST20_65 : 2599|8@0+ (1,0) [0|0] "" Vector__XXX
 SG_ IOM_A_34_VFG_OIL_TEMP20_A_94 : 2567|32@0- (1,0) [0|100] "deg C" Vector__XXX
 SG_ FS_HSMU_TEST20_64 : 2463|8@0+ (1,0) [0|0] "" Vector__XXX
 SG_ IOM_A_34_VFG_OIL_TEMP20_A_93 : 2535|32@0- (1,0) [0|100] "deg C" Vector__XXX
 SG_ FS_HSMU_TEST20_63 : 2455|8@0+ (1,0) [0|0] "" Vector__XXX
 SG_ IOM_A_34_VFG_OIL_TEMP20_A_92 : 2503|32@0- (1,0) [0|100] "deg C" Vector__XXX
 SG_ FS_HSMU_TEST20_62 : 2447|8@0+ (1,0) [0|0] "" Vector__XXX
 SG_ IOM_A_34_VFG_OIL_TEMP20_A_91 : 2471|32@0- (1,0) [0|100] "deg C" Vector__XXX
 SG_ FS_HSMU_TEST20_61 : 2439|8@0+ (1,0) [0|0] "" Vector__XXX
 SG_ IOM_A_34_VFG_OIL_TEMP20_A_90 : 2407|32@0- (1,0) [0|100] "deg C" Vector__XXX
 SG_ FS_HSMU_TEST20_60 : 2303|8@0+ (1,0) [0|0] "" Vector__XXX
 SG_ IOM_A_34_VFG_OIL_TEMP20_A_89 : 2375|32@0- (1,0) [0|100] "deg C" Vector__XXX
 SG_ FS_HSMU_TEST20_59 : 2295|8@0+ (1,0) [0|0] "" Vector__XXX
 SG_ IOM_A_34_VFG_OIL_TEMP20_A_88 : 2343|32@0- (1,0) [0|100] "deg C" Vector__XXX
 SG_ FS_HSMU_TEST20_58 : 2287|8@0+ (1,0) [0|0] "" Vector__XXX
 SG_ IOM_A_34_VFG_OIL_TEMP20_A_87 : 2311|32@0- (1,0) [0|100] "deg C" Vector__XXX
 SG_ FS_HSMU_TEST20_57 : 2279|8@0+ (1,0) [0|0] "" Vector__XXX
 SG_ IOM_A_34_VFG_OIL_TEMP20_A_86 : 2247|32@0- (1,0) [0|100] "deg C" Vector__XXX
 SG_ FS_HSMU_TEST20_56 : 2143|8@0+ (1,0) [0|0] "" Vector__XXX
 SG_ IOM_A_34_VFG_OIL_TEMP20_A_85 : 2215|32@0- (1,0) [0|100] "deg C" Vector__XXX
 SG_ FS_HSMU_TEST20_55 : 2135|8@0+ (1,0) [0|0] "" Vector__XXX
 SG_ IOM_A_34_VFG_OIL_TEMP20_A_84 : 2183|32@0- (1,0) [0|100] "deg C" Vector__XXX
 SG_ FS_HSMU_TEST20_54 : 2127|8@0+ (1,0) [0|0] "" Vector__XXX
 SG_ IOM_A_34_VFG_OIL_TEMP20_A_83 : 2151|32@0- (1,0) [0|100] "deg C" Vector__XXX
 SG_ FS_HSMU_TEST20_53 : 2119|8@0+ (1,0) [0|0] "" Vector__XXX
 SG_ IOM_A_34_VFG_OIL_TEMP20_A_82 : 2087|32@0- (1,0) [0|100] "deg C" Vector__XXX
 SG_ FS_HSMU_TEST20_52 : 1983|8@0+ (1,0) [0|0] "" Vector__XXX
 SG_ IOM_A_34_VFG_OIL_TEMP20_A_81 : 2055|32@0- (1,0) [0|100] "deg C" Vector__XXX
 SG_ FS_HSMU_TEST20_51 : 1975|8@0+ (1,0) [0|0] "" Vector__XXX
 SG_ IOM_A_34_VFG_OIL_TEMP20_A_80 : 2023|32@0- (1,0) [0|100] "deg C" Vector__XXX
 SG_ FS_HSMU_TEST20_50 : 1967|8@0+ (1,0) [0|0] "" Vector__XXX
 SG_ IOM_A_34_VFG_OIL_TEMP20_A_79 : 1991|32@0- (1,0) [0|100] "deg C" Vector__XXX
 SG_ FS_HSMU_TEST20_49 : 1959|8@0+ (1,0) [0|0] "" Vector__XXX
 SG_ IOM_A_34_VFG_OIL_TEMP20_A_78 : 1927|32@0- (1,0) [0|100] "deg C" Vector__XXX
 SG_ FS_HSMU_TEST20_48 : 1823|8@0+ (1,0) [0|0] "" Vector__XXX
 SG_ IOM_A_34_VFG_OIL_TEMP20_A_77 : 1895|32@0- (1,0) [0|100] "deg C" Vector__XXX
 SG_ FS_HSMU_TEST20_47 : 1815|8@0+ (1,0) [0|0] "" Vector__XXX
 SG_ IOM_A_34_VFG_OIL_TEMP20_A_76 : 1863|32@0- (1,0) [0|100] "deg C" Vector__XXX
 SG_ FS_HSMU_TEST20_46 : 1807|8@0+ (1,0) [0|0] "" Vector__XXX
 SG_ IOM_A_34_VFG_OIL_TEMP20_A_75 : 1831|32@0- (1,0) [0|100] "deg C" Vector__XXX
 SG_ FS_HSMU_TEST20_45 : 1799|8@0+ (1,0) [0|0] "" Vector__XXX
 SG_ IOM_A_34_VFG_OIL_TEMP20_A_74 : 1767|32@0- (1,0) [0|100] "deg C" Vector__XXX
 SG_ FS_HSMU_TEST20_44 : 1663|8@0+ (1,0) [0|0] "" Vector__XXX
 SG_ IOM_A_34_VFG_OIL_TEMP20_A_73 : 1735|32@0- (1,0) [0|100] "deg C" Vector__XXX
 SG_ FS_HSMU_TEST20_43 : 1655|8@0+ (1,0) [0|0] "" Vector__XXX
 SG_ IOM_A_34_VFG_OIL_TEMP20_A_72 : 1703|32@0- (1,0) [0|100] "deg C" Vector__XXX
 SG_ FS_HSMU_TEST20_42 : 1647|8@0+ (1,0) [0|0] "" Vector__XXX
 SG_ IOM_A_34_VFG_OIL_TEMP20_A_71 : 1671|32@0- (1,0) [0|100] "deg C" Vector__XXX
 SG_ FS_HSMU_TEST20_41 : 1639|8@0+ (1,0) [0|0] "" Vector__XXX
 SG_ IOM_A_34_VFG_OIL_TEMP20_A_70 : 1607|32@0- (1,0) [0|100] "deg C" Vector__XXX
 SG_ FS_HSMU_TEST20_40 : 1503|8@0+ (1,0) [0|0] "" Vector__XXX
 SG_ IOM_A_34_VFG_OIL_TEMP20_A_69 : 1575|32@0- (1,0) [0|100] "deg C" Vector__XXX
 SG_ FS_HSMU_TEST20_39 : 1495|8@0+ (1,0) [0|0] "" Vector__XXX
 SG_ IOM_A_34_VFG_OIL_TEMP20_A_68 : 1543|32@0- (1,0) [0|100] "deg C" Vector__XXX
 SG_ FS_HSMU_TEST20_38 : 1487|8@0+ (1,0) [0|0] "" Vector__XXX
 SG_ IOM_A_34_VFG_OIL_TEMP20_A_67 : 1511|32@0- (1,0) [0|100] "deg C" Vector__XXX
 SG_ FS_HSMU_TEST20_37 : 1479|8@0+ (1,0) [0|0] "" Vector__XXX
 SG_ IOM_A_34_VFG_OIL_TEMP20_A_66 : 1447|32@0- (1,0) [0|100] "deg C" Vector__XXX
 SG_ FS_HSMU_TEST20_36 : 1343|8@0+ (1,0) [0|0] "" Vector__XXX
 SG_ IOM_A_34_VFG_OIL_TEMP20_A_65 : 1415|32@0- (1,0) [0|100] "deg C" Vector__XXX
 SG_ FS_HSMU_TEST20_35 : 1335|8@0+ (1,0) [0|0] "" Vector__XXX
 SG_ IOM_A_34_VFG_OIL_TEMP20_A_64 : 1383|32@0- (1,0) [0|100] "deg C" Vector__XXX
 SG_ FS_HSMU_TEST20_34 : 1327|8@0+ (1,0) [0|0] "" Vector__XXX
 SG_ IOM_A_34_VFG_OIL_TEMP20_A_63 : 1351|32@0- (1,0) [0|100] "deg C" Vector__XXX
 SG_ FS_HSMU_TEST20_33 : 1319|8@0+ (1,0) [0|0] "" Vector__XXX
 SG_ IOM_A_34_VFG_OIL_TEMP20_A_62 : 1287|32@0- (1,0) [0|100] "deg C" Vector__XXX
 SG_ FS_HSMU_TEST20_32 : 1183|8@0+ (1,0) [0|0] "" Vector__XXX
 SG_ IOM_A_34_VFG_OIL_TEMP20_A_61 : 1255|32@0- (1,0) [0|100] "deg C" Vector__XXX
 SG_ FS_HSMU_TEST20_31 : 1175|8@0+ (1,0) [0|0] "" Vector__XXX
 SG_ IOM_A_34_VFG_OIL_TEMP20_A_60 : 1223|32@0- (1,0) [0|100] "deg C" Vector__XXX
 SG_ FS_HSMU_TEST20_30 : 1167|8@0+ (1,0) [0|0] "" Vector__XXX
 SG_ IOM_A_34_VFG_OIL_TEMP20_A_59 : 1191|32@0- (1,0) [0|100] "deg C" Vector__XXX
 SG_ FS_HSMU_TEST20_29 : 1159|8@0+ (1,0) [0|0] "" Vector__XXX
 SG_ IOM_A_34_VFG_OIL_TEMP20_A_58 : 1127|32@0- (1,0) [0|100] "deg C" Vector__XXX
 SG_ FS_HSMU_TEST20_28 : 1023|8@0+ (1,0) [0|0] "" Vector__XXX
 SG_ IOM_A_34_VFG_OIL_TEMP20_A_57 : 1095|32@0- (1,0) [0|100] "deg C" Vector__XXX
 SG_ FS_HSMU_TEST20_27 : 1015|8@0+ (1,0) [0|0] "" Vector__XXX
 SG_ IOM_A_34_VFG_OIL_TEMP20_A_56 : 1063|32@0- (1,0) [0|100] "deg C" Vector__XXX
 SG_ FS_HSMU_TEST20_26 : 1007|8@0+ (1,0) [0|0] "" Vector__XXX
 SG_ IOM_A_34_VFG_OIL_TEMP20_A_55 : 1031|32@0- (1,0) [0|100] "deg C" Vector__XXX
 SG_ FS_HSMU_TEST20_25 : 999|8@0+ (1,0) [0|0] "" Vector__XXX
 SG_ IOM_A_34_VFG_OIL_TEMP20_A_54 : 967|32@0- (1,0) [0|100] "deg C" Vector__XXX
 SG_ FS_HSMU_TEST20_24 : 863|8@0+ (1,0) [0|0] "" Vector__XXX
 SG_ IOM_A_34_VFG_OIL_TEMP20_A_53 : 935|32@0- (1,0) [0|100] "deg C" Vector__XXX
 SG_ FS_HSMU_TEST20_23 : 855|8@0+ (1,0) [0|0] "" Vector__XXX
 SG_ IOM_A_34_VFG_OIL_TEMP20_A_52 : 903|32@0- (1,0) [0|100] "deg C" Vector__XXX
 SG_ FS_HSMU_TEST20_22 : 847|8@0+ (1,0) [0|0] "" Vector__XXX
 SG_ IOM_A_34_VFG_OIL_TEMP20_A_51 : 871|32@0- (1,0) [0|100] "deg C" Vector__XXX
 SG_ FS_HSMU_TEST20_21 : 839|8@0+ (1,0) [0|0] "" Vector__XXX
 SG_ IOM_A_34_VFG_OIL_TEMP20_A_50 : 807|32@0- (1,0) [0|100] "deg C" Vector__XXX
 SG_ FS_HSMU_TEST20_20 : 703|8@0+ (1,0) [0|0] "" Vector__XXX
 SG_ IOM_A_34_VFG_OIL_TEMP20_A_49 : 775|32@0- (1,0) [0|100] "deg C" Vector__XXX
 SG_ FS_HSMU_TEST20_19 : 695|8@0+ (1,0) [0|0] "" Vector__XXX
 SG_ IOM_A_34_VFG_OIL_TEMP20_A_48 : 743|32@0- (1,0) [0|100] "deg C" Vector__XXX
 SG_ FS_HSMU_TEST20_18 : 687|8@0+ (1,0) [0|0] "" Vector__XXX
 SG_ IOM_A_34_VFG_OIL_TEMP20_A_47 : 711|32@0- (1,0) [0|100] "deg C" Vector__XXX
 SG_ FS_HSMU_TEST20_17 : 679|8@0+ (1,0) [0|0] "" Vector__XXX
 SG_ IOM_A_34_VFG_OIL_TEMP20_A_46 : 647|32@0- (1,0) [0|100] "deg C" Vector__XXX
 SG_ FS_HSMU_TEST20_16 : 543|8@0+ (1,0) [0|0] "" Vector__XXX
 SG_ IOM_A_34_VFG_OIL_TEMP20_A_45 : 615|32@0- (1,0) [0|100] "deg C" Vector__XXX
 SG_ FS_HSMU_TEST20_15 : 535|8@0+ (1,0) [0|0] "" Vector__XXX
 SG_ IOM_A_34_VFG_OIL_TEMP20_A_44 : 583|32@0- (1,0) [0|100] "deg C" Vector__XXX
 SG_ FS_HSMU_TEST20_14 : 527|8@0+ (1,0) [0|0] "" Vector__XXX
 SG_ IOM_A_34_VFG_OIL_TEMP20_A_43 : 551|32@0- (1,0) [0|100] "deg C" Vector__XXX
 SG_ FS_HSMU_TEST20_13 : 519|8@0+ (1,0) [0|0] "" Vector__XXX
 SG_ IOM_A_34_VFG_OIL_TEMP20_A_42 : 487|32@0- (1,0) [0|100] "deg C" Vector__XXX
 SG_ FS_HSMU_TEST20_12 : 383|8@0+ (1,0) [0|0] "" Vector__XXX
 SG_ IOM_A_34_VFG_OIL_TEMP20_A_41 : 455|32@0- (1,0) [0|100] "deg C" Vector__XXX
 SG_ FS_HSMU_TEST20_11 : 375|8@0+ (1,0) [0|0] "" Vector__XXX
 SG_ IOM_A_34_VFG_OIL_TEMP20_A_40 : 423|32@0- (1,0) [0|100] "deg C" Vector__XXX
 SG_ FS_HSMU_TEST20_10 : 367|8@0+ (1,0) [0|0] "" Vector__XXX
 SG_ IOM_A_34_VFG_OIL_TEMP20_A_39 : 391|32@0- (1,0) [0|100] "deg C" Vector__XXX
 SG_ FS_HSMU_TEST20_9 : 359|8@0+ (1,0) [0|0] "" Vector__XXX
 SG_ IOM_A_34_VFG_OIL_TEMP20_A_38 : 327|32@0- (1,0) [0|100] "deg C" Vector__XXX
 SG_ FS_HSMU_TEST20_8 : 223|8@0+ (1,0) [0|0] "" Vector__XXX
 SG_ IOM_A_34_VFG_OIL_TEMP20_A_37 : 295|32@0- (1,0) [0|100] "deg C" Vector__XXX
 SG_ FS_HSMU_TEST20_7 : 215|8@0+ (1,0) [0|0] "" Vector__XXX
 SG_ IOM_A_34_VFG_OIL_TEMP20_A_36 : 263|32@0- (1,0) [0|100] "deg C" Vector__XXX
 SG_ FS_HSMU_TEST20_6 : 207|8@0+ (1,0) [0|0] "" Vector__XXX
 SG_ IOM_A_34_VFG_OIL_TEMP20_A_35 : 231|32@0- (1,0) [0|100] "deg C" Vector__XXX
 SG_ FS_HSMU_TEST20_5 : 199|8@0+ (1,0) [0|0] "" Vector__XXX
 SG_ IOM_A_34_VFG_OIL_TEMP20_A_34 : 167|32@0- (1,0) [0|100] "deg C" Vector__XXX
 SG_ FS_HSMU_TEST20_4 : 63|8@0+ (1,0) [0|0] "" Vector__XXX
 SG_ IOM_A_34_VFG_OIL_TEMP20_A_33 : 135|32@0- (1,0) [0|100] "deg C" Vector__XXX
 SG_ FS_HSMU_TEST20_3 : 55|8@0+ (1,0) [0|0] "" Vector__XXX
 SG_ IOM_A_34_VFG_OIL_TEMP20_A_32 : 103|32@0- (1,0) [0|100] "deg C" Vector__XXX
 SG_ FS_HSMU_TEST20_2 : 47|8@0+ (1,0) [0|0] "" Vector__XXX
 SG_ IOM_A_34_VFG_OIL_TEMP20_A_31 : 71|32@0- (1,0) [0|100] "deg C" Vector__XXX
 SG_ FS_HSMU_TEST20_1 : 39|8@0+ (1,0) [0|0] "" Vector__XXX

BO_ 437267314 TESTMSG_INT3: 696 IOM_A_34_3
 SG_ IOM_A_34_VFG_OIL_TEMP_A_33 : 135|32@0- (1,0) [20|50] "deg C" Vector__XXX
 SG_ FS_FDS_3_HSMU_TEST_INT3 : 55|8@0+ (1,0) [0|0] "" Vector__XXX
 SG_ IOM_A_34_VFG_OIL_TEMP_A_32 : 103|32@0- (1,0) [0|100] "deg C" Vector__XXX
 SG_ FS_FDS_2_HSMU_TEST_INT3 : 47|8@0+ (1,0) [0|0] "" Vector__XXX
 SG_ IOM_A_34_VFG_OIL_TEMP_A_31 : 71|32@0- (1,0) [-30|255] "deg C" Vector__XXX
 SG_ FS_FDS_1_HSMU_TEST_INT3 : 39|8@0+ (1,0) [0|0] "" Vector__XXX

BO_ 437201777 TESTMSG_INT2: 696 IOM_A_34_3
 SG_ IOM_A_34_VFG_OIL_TEMP_A_2_22 : 103|32@0- (1,0) [-30|255] "deg C" Vector__XXX
 SG_ IOM_A_34_VFG_OIL_TEMP_A_2_21 : 71|32@0- (1,0) [-30|255] "deg C" Vector__XXX
 SG_ FS_FDS_1_HSMU_TEST_INT2 : 47|8@0+ (1,0) [0|0] "" Vector__XXX

BO_ 437136240 TESTMSG_INT1: 696 IOM_A_34_3
 SG_ IOM_A_34_VFG_OIL_TEMP_A_2_1 : 71|32@0- (1,0) [-30|255] "deg C" Vector__XXX
 SG_ FS_FDS_1_HSMU_TEST_INT1 : 39|8@0+ (1,0) [0|0] "" Vector__XXX

BO_ 437070703 TESTMSG_FLOAT8: 696 IOM_A_34_3
 SG_ IOM_A_34_SYS_PRESS_2_YY_10 : 71|32@0- (1,0) [0|4000] "psi" Vector__XXX
 SG_ FS_FDS_1_HSMU_TEST10_FLOAT : 39|8@0+ (1,0) [0|0] "" Vector__XXX

BO_ 437005166 TESTMSG_FLOAT7: 696 IOM_A_34_3
 SG_ IOM_A_34_SYS_PRESS_2_YY_9 : 71|32@0- (1,0) [0|4000] "psi" Vector__XXX
 SG_ FS_FDS_1_HSMU_TEST9_FLOAT : 39|8@0+ (1,0) [0|0] "" Vector__XXX

BO_ 436939629 TESTMSG_FLOAT6: 696 IOM_A_34_3
 SG_ IOM_A_34_SYS_PRESS_2_YY_8 : 71|32@0- (1,0) [0|4000] "psi" Vector__XXX
 SG_ FS_FDS_1_HSMU_TEST8_FLOAT : 39|8@0+ (1,0) [0|0] "" Vector__XXX

BO_ 436874092 TESTMSG_FLOAT5: 696 IOM_A_34_3
 SG_ IOM_A_34_SYS_PRESS_2_YY_75 : 231|32@0- (1,0) [0|10] "psi" Vector__XXX
 SG_ IOM_A_34_SYS_PRESS_2_YY_74 : 167|32@0- (1,0) [0|4] "psi" Vector__XXX
 SG_ IOM_A_34_SYS_PRESS_2_YY_73 : 135|32@0- (1,0) [0|400] "psi" Vector__XXX
 SG_ IOM_A_34_SYS_PRESS_2_YY_72 : 103|32@0- (1,0) [0|40] "psi" Vector__XXX
 SG_ IOM_A_34_SYS_PRESS_2_YY_71 : 71|32@0- (1,0) [0|4000] "psi" Vector__XXX
 SG_ FS_FDS_1_HSMU_TEST7_FLOAT : 199|8@0+ (1,0) [0|0] "" Vector__XXX

BO_ 436808555 TESTMSG_FLOAT4: 696 IOM_A_34_3
 SG_ IOM_A_34_SYS_PRESS_2_YY_64 : 167|32@0- (1,0) [0|4] "psi" Vector__XXX
 SG_ IOM_A_34_SYS_PRESS_2_YY_63 : 135|32@0- (1,0) [0|4000] "psi" Vector__XXX
 SG_ IOM_A_34_SYS_PRESS_2_YY_62 : 103|32@0- (1,0) [0|400] "psi" Vector__XXX
 SG_ IOM_A_34_SYS_PRESS_2_YY_61 : 71|32@0- (1,0) [0|40] "psi" Vector__XXX
 SG_ FS_FDS_1_HSMU_TEST6_FLOAT : 63|8@0+ (1,0) [0|0] "" Vector__XXX

BO_ 436743018 TESTMSG_FLOAT3: 696 IOM_A_34_3
 SG_ IOM_A_34_SYS_PRESS_2_YY_5 : 135|32@0- (1,0) [0|4000] "psi" Vector__XXX
 SG_ IOM_A_34_SYS_PRESS_2_YY_52 : 103|32@0- (1,0) [0|40] "psi" Vector__XXX
 SG_ IOM_A_34_SYS_PRESS_2_YY_51 : 71|32@0- (1,0) [0|4000] "psi" Vector__XXX
 SG_ FS_FDS_1_HSMU_TEST5_FLOAT : 55|8@0+ (1,0) [0|0] "" Vector__XXX

BO_ 436677481 TESTMSG_FLOAT2: 696 IOM_A_34_3
 SG_ IOM_A_34_SYS_PRESS_2_YY_42 : 103|32@0- (1,0) [0|40] "psi" Vector__XXX
 SG_ IOM_A_34_SYS_PRESS_2_YY_41 : 71|32@0- (1,0) [0|4000] "psi" Vector__XXX
 SG_ FS_FDS_1_HSMU_TEST4_FLOAT : 47|8@0+ (1,0) [0|0] "" Vector__XXX

BO_ 436611944 TESTMSG_FLOAT1: 696 IOM_A_34_3
 SG_ IOM_A_34_SYS_PRESS_2_YY_31 : 71|32@0- (1,0) [0|4000] "psi" Vector__XXX
 SG_ FS_FDS_1_HSMU_TEST3_FLOAT : 39|8@0+ (1,0) [0|0] "" Vector__XXX

BO_ 436546407 TESTFLOAT_MSG_2: 96 IOM_A_34_3
 SG_ IOM_A_34_ACCU_PRESSURE_SGX_1_3 : 263|32@0- (1,0) [0|444] "psi" Vector__XXX
 SG_ FS_FDS_6_HSMU_TEST1_FLOAT : 207|8@0+ (1,0) [0|0] "" Vector__XXX
 SG_ IOM_A_34_NORMAL_BRAKE_PRESSURE_W : 231|32@0- (1,0) [0|33300] "psi" Vector__XXX
 SG_ FS_FDS_5_HSMU_TEST1_FLOAT : 199|8@0+ (1,0) [0|0] "" Vector__XXX
 SG_ IOM_A_34_NORMAL_BRAKE_PRESS_0000 : 167|32@0- (1,0) [0|3300] "psi" Vector__XXX
 SG_ FS_FDS_4_HSMU_TEST1_FLOAT : 63|8@0+ (1,0) [0|0] "" Vector__XXX
 SG_ IOM_A_34_RSVR_MOVABLE_INDEX_YY_3 : 135|32@0- (1,0) [0|84] "l" Vector__XXX
 SG_ FS_FDS_3_HSMU_TEST1_FLOAT : 55|8@0+ (1,0) [0|0] "" Vector__XXX
 SG_ IOM_A_34_RSVR_LEVEL_YY_3 : 103|32@0- (1,0) [0|84] "l" Vector__XXX
 SG_ FS_FDS_2_HSMU_TEST1_FLOAT : 47|8@0+ (1,0) [0|0] "" Vector__XXX
 SG_ IOM_A_34_SYS_PRESS_2_YY_3 : 71|32@0- (1,0) [0|4000] "psi" Vector__XXX
 SG_ FS_FDS_1_HSMU_TEST1_FLOAT : 39|8@0+ (1,0) [0|0] "" Vector__XXX

BO_ 436480870 TESTFLOAT_MSG_1: 96 IOM_A_34_3
 SG_ IOM_A_34_ACCU_PRESSURE_SGX_1_3 : 263|32@0- (1,0) [0|444] "psi" Vector__XXX
 SG_ FS_FDS_6_HSMU_TEST1_FLOAT : 207|8@0+ (1,0) [0|0] "" Vector__XXX
 SG_ IOM_A_34_NORMAL_BRAKE_PRESS_0001 : 231|32@0- (1,0) [0|33300] "psi" Vector__XXX
 SG_ FS_FDS_5_HSMU_TEST1_FLOAT : 199|8@0+ (1,0) [0|0] "" Vector__XXX
 SG_ IOM_A_34_NORMAL_BRAKE_PRESS_0002 : 167|32@0- (1,0) [0|3300] "psi" Vector__XXX
 SG_ FS_FDS_4_HSMU_TEST1_FLOAT : 63|8@0+ (1,0) [0|0] "" Vector__XXX
 SG_ IOM_A_34_RSVR_MOVABLE_INDEX_YY_3 : 135|32@0- (1,0) [0|84] "l" Vector__XXX
 SG_ FS_FDS_3_HSMU_TEST1_FLOAT : 55|8@0+ (1,0) [0|0] "" Vector__XXX
 SG_ IOM_A_34_RSVR_LEVEL_YY_3 : 103|32@0- (1,0) [0|84] "l" Vector__XXX
 SG_ FS_FDS_2_HSMU_TEST1_FLOAT : 47|8@0+ (1,0) [0|0] "" Vector__XXX
 SG_ IOM_A_34_SYS_PRESS_2_YY_3 : 71|32@0- (1,0) [0|4000] "psi" Vector__XXX
 SG_ FS_FDS_1_HSMU_TEST1_FLOAT : 39|8@0+ (1,0) [0|0] "" Vector__XXX

CM_ "Created from:

AFDX_Tst.csv
";
BA_DEF_ SG_  "AfdxFSaddr" INT 4 8192;
BA_DEF_ SG_  "AfdxFDSaddr" INT 0 8192;
BA_DEF_ SG_  "AfdxFDSspareLen" INT 0 8192;
BA_DEF_ SG_  "AfdxFDSlength" INT 0 8192;
BA_DEF_ SG_  "AfdxFDSname" STRING ;
BA_DEF_ SG_  "AfdxSignalType" STRING ;
BA_DEF_ BO_  "AfdxTxPortId" INT 1 65535;
BA_DEF_ BO_  "AfdxPortMasterName" STRING ;
BA_DEF_ BO_  "AfdxMsgRefreshDef" INT 0 0;
BA_DEF_ BO_  "AfdxMsgTxRate" INT 0 0;
BA_DEF_ BO_  "AfdxVLbufSize" INT 1 8192;
BA_DEF_ BO_  "AfdxVLdestUDP" INT 0 65535;
BA_DEF_ BO_  "AfdxVLsrcUDP" INT 0 65535;
BA_DEF_ BO_  "AfdxVLdestIP" STRING ;
BA_DEF_ BO_  "AfdxVLsrcIP" STRING ;
BA_DEF_ BO_  "AfdxVLipFrag" STRING ;
BA_DEF_ BO_  "AfdxVLportChar" STRING ;
BA_DEF_ BO_  "AfdxVLportType" STRING ;
BA_DEF_ BO_  "AfdxVLsubVLId" INT 1 4;
BA_DEF_ BO_  "AfdxVLsubVL" INT 1 4;
BA_DEF_ BO_  "AfdxVLskewMax" INT 0 65535;
BA_DEF_ BO_  "AfdxVLintCheck" STRING ;
BA_DEF_ BO_  "AfdxVLrma" STRING ;
BA_DEF_ BO_  "AfdxVLmaxFrame" INT 17 1471;
BA_DEF_ BO_  "AfdxVLbag" INT 1 128;
BA_DEF_ BO_  "AfdxVLnetSel" STRING ;
BA_DEF_ BO_  "AfdxVLname" STRING ;
BA_DEF_ BO_  "AfdxVLid" INT 1 65535;
BA_DEF_ BO_  "AfdxVLportSpeed" INT 10 100;
BA_DEF_ SG_  "DefaultValue" STRING ;
BA_DEF_ BU_  "AfdxEquipment" STRING ;
BA_DEF_  "BusType" STRING ;
BA_DEF_  "ToolVersion" STRING ;
BA_DEF_  "ToolName" STRING ;
BA_DEF_ SG_  "SystemSignalLongSymbol" STRING ;
BA_DEF_DEF_  "AfdxFSaddr" 0;
BA_DEF_DEF_  "AfdxFDSaddr" 0;
BA_DEF_DEF_  "AfdxFDSspareLen" 0;
BA_DEF_DEF_  "AfdxFDSlength" 0;
BA_DEF_DEF_  "AfdxFDSname" "";
BA_DEF_DEF_  "AfdxSignalType" "";
BA_DEF_DEF_  "AfdxTxPortId" 0;
BA_DEF_DEF_  "AfdxPortMasterName" "";
BA_DEF_DEF_  "AfdxMsgRefreshDef" 0;
BA_DEF_DEF_  "AfdxMsgTxRate" 0;
BA_DEF_DEF_  "AfdxVLbufSize" 0;
BA_DEF_DEF_  "AfdxVLdestUDP" 0;
BA_DEF_DEF_  "AfdxVLsrcUDP" 0;
BA_DEF_DEF_  "AfdxVLdestIP" "";
BA_DEF_DEF_  "AfdxVLsrcIP" "";
BA_DEF_DEF_  "AfdxVLipFrag" "";
BA_DEF_DEF_  "AfdxVLportChar" "";
BA_DEF_DEF_  "AfdxVLportType" "";
BA_DEF_DEF_  "AfdxVLsubVLId" 0;
BA_DEF_DEF_  "AfdxVLsubVL" 0;
BA_DEF_DEF_  "AfdxVLskewMax" 0;
BA_DEF_DEF_  "AfdxVLintCheck" "";
BA_DEF_DEF_  "AfdxVLrma" "";
BA_DEF_DEF_  "AfdxVLmaxFrame" 0;
BA_DEF_DEF_  "AfdxVLbag" 0;
BA_DEF_DEF_  "AfdxVLnetSel" "";
BA_DEF_DEF_  "AfdxVLname" "";
BA_DEF_DEF_  "AfdxVLid" 0;
BA_DEF_DEF_  "AfdxVLportSpeed" 0;
BA_DEF_DEF_  "DefaultValue" "";
BA_DEF_DEF_  "AfdxEquipment" "";
BA_DEF_DEF_  "BusType" "AFDX";
BA_DEF_DEF_  "ToolVersion" "1.0.0.7";
BA_DEF_DEF_  "ToolName" "ICD2DBC";
BA_DEF_DEF_  "SystemSignalLongSymbol" "";
BA_ "AfdxEquipment" BU_ IOM_A_34_3 "IOM_A_34_3";
BA_ "AfdxTxPortId" BO_ 437922684 11132;
BA_ "AfdxPortMasterName" BO_ 437922684 "TEST22_AFDX_PORT_18";
BA_ "AfdxMsgTxRate" BO_ 437922684 1;
BA_ "AfdxVLbufSize" BO_ 437922684 1400;
BA_ "AfdxVLdestUDP" BO_ 437922684 11132;
BA_ "AfdxVLsrcUDP" BO_ 437922684 11132;
BA_ "AfdxVLdestIP" BO_ 437922684 "224.224.26.24";
BA_ "AfdxVLsrcIP" BO_ 437922684 "10.2.38.0";
BA_ "AfdxVLipFrag" BO_ 437922684 "True";
BA_ "AfdxVLportChar" BO_ 437922684 "Queuing";
BA_ "AfdxVLportType" BO_ 437922684 "AFDX communication port";
BA_ "AfdxVLsubVLId" BO_ 437922684 1;
BA_ "AfdxVLsubVL" BO_ 437922684 1;
BA_ "AfdxVLintCheck" BO_ 437922684 "False";
BA_ "AfdxVLmaxFrame" BO_ 437922684 1400;
BA_ "AfdxVLbag" BO_ 437922684 1;
BA_ "AfdxVLnetSel" BO_ 437922684 "NETWORK_AB";
BA_ "AfdxVLname" BO_ 437922684 "VL_TEST22";
BA_ "AfdxVLid" BO_ 437922684 6682;
BA_ "AfdxVLportSpeed" BO_ 437922684 100;
BA_ "AfdxTxPortId" BO_ 437857147 11131;
BA_ "AfdxPortMasterName" BO_ 437857147 "TEST21_AFDX_PORT_17";
BA_ "AfdxMsgTxRate" BO_ 437857147 1;
BA_ "AfdxVLbufSize" BO_ 437857147 1400;
BA_ "AfdxVLdestUDP" BO_ 437857147 11131;
BA_ "AfdxVLsrcUDP" BO_ 437857147 11131;
BA_ "AfdxVLdestIP" BO_ 437857147 "224.224.26.25";
BA_ "AfdxVLsrcIP" BO_ 437857147 "10.2.38.0";
BA_ "AfdxVLipFrag" BO_ 437857147 "True";
BA_ "AfdxVLportChar" BO_ 437857147 "Queuing";
BA_ "AfdxVLportType" BO_ 437857147 "AFDX communication port";
BA_ "AfdxVLsubVLId" BO_ 437857147 1;
BA_ "AfdxVLsubVL" BO_ 437857147 1;
BA_ "AfdxVLintCheck" BO_ 437857147 "False";
BA_ "AfdxVLmaxFrame" BO_ 437857147 1400;
BA_ "AfdxVLbag" BO_ 437857147 1;
BA_ "AfdxVLnetSel" BO_ 437857147 "NETWORK_AB";
BA_ "AfdxVLname" BO_ 437857147 "VL_TEST21";
BA_ "AfdxVLid" BO_ 437857147 6681;
BA_ "AfdxVLportSpeed" BO_ 437857147 100;
BA_ "AfdxTxPortId" BO_ 437791610 11130;
BA_ "AfdxPortMasterName" BO_ 437791610 "TEST20_AFDX_PORT_16";
BA_ "AfdxMsgTxRate" BO_ 437791610 1;
BA_ "AfdxVLbufSize" BO_ 437791610 1400;
BA_ "AfdxVLdestUDP" BO_ 437791610 11130;
BA_ "AfdxVLsrcUDP" BO_ 437791610 11130;
BA_ "AfdxVLdestIP" BO_ 437791610 "224.224.26.24";
BA_ "AfdxVLsrcIP" BO_ 437791610 "10.2.38.0";
BA_ "AfdxVLipFrag" BO_ 437791610 "True";
BA_ "AfdxVLportChar" BO_ 437791610 "Queuing";
BA_ "AfdxVLportType" BO_ 437791610 "AFDX communication port";
BA_ "AfdxVLsubVLId" BO_ 437791610 1;
BA_ "AfdxVLsubVL" BO_ 437791610 1;
BA_ "AfdxVLintCheck" BO_ 437791610 "False";
BA_ "AfdxVLmaxFrame" BO_ 437791610 1400;
BA_ "AfdxVLbag" BO_ 437791610 1;
BA_ "AfdxVLnetSel" BO_ 437791610 "NETWORK_AB";
BA_ "AfdxVLname" BO_ 437791610 "VL_TEST20";
BA_ "AfdxVLid" BO_ 437791610 6680;
BA_ "AfdxVLportSpeed" BO_ 437791610 100;
BA_ "AfdxTxPortId" BO_ 437267314 11122;
BA_ "AfdxPortMasterName" BO_ 437267314 "TEST13_AFDX_PORT_13";
BA_ "AfdxMsgTxRate" BO_ 437267314 1;
BA_ "AfdxVLbufSize" BO_ 437267314 800;
BA_ "AfdxVLdestUDP" BO_ 437267314 11122;
BA_ "AfdxVLsrcUDP" BO_ 437267314 11122;
BA_ "AfdxVLdestIP" BO_ 437267314 "224.224.26.16";
BA_ "AfdxVLsrcIP" BO_ 437267314 "10.2.38.0";
BA_ "AfdxVLipFrag" BO_ 437267314 "True";
BA_ "AfdxVLportChar" BO_ 437267314 "Queuing";
BA_ "AfdxVLportType" BO_ 437267314 "AFDX communication port";
BA_ "AfdxVLsubVLId" BO_ 437267314 1;
BA_ "AfdxVLsubVL" BO_ 437267314 1;
BA_ "AfdxVLintCheck" BO_ 437267314 "False";
BA_ "AfdxVLmaxFrame" BO_ 437267314 800;
BA_ "AfdxVLbag" BO_ 437267314 1;
BA_ "AfdxVLnetSel" BO_ 437267314 "NETWORK_AB";
BA_ "AfdxVLname" BO_ 437267314 "VL_TEST13";
BA_ "AfdxVLid" BO_ 437267314 6672;
BA_ "AfdxVLportSpeed" BO_ 437267314 100;
BA_ "AfdxTxPortId" BO_ 437201777 11121;
BA_ "AfdxPortMasterName" BO_ 437201777 "TEST12_AFDX_PORT_12";
BA_ "AfdxMsgTxRate" BO_ 437201777 80;
BA_ "AfdxVLbufSize" BO_ 437201777 800;
BA_ "AfdxVLdestUDP" BO_ 437201777 11121;
BA_ "AfdxVLsrcUDP" BO_ 437201777 11121;
BA_ "AfdxVLdestIP" BO_ 437201777 "224.224.26.15";
BA_ "AfdxVLsrcIP" BO_ 437201777 "10.2.38.0";
BA_ "AfdxVLipFrag" BO_ 437201777 "True";
BA_ "AfdxVLportChar" BO_ 437201777 "Queuing";
BA_ "AfdxVLportType" BO_ 437201777 "AFDX communication port";
BA_ "AfdxVLsubVLId" BO_ 437201777 1;
BA_ "AfdxVLsubVL" BO_ 437201777 1;
BA_ "AfdxVLintCheck" BO_ 437201777 "False";
BA_ "AfdxVLmaxFrame" BO_ 437201777 800;
BA_ "AfdxVLbag" BO_ 437201777 1;
BA_ "AfdxVLnetSel" BO_ 437201777 "NETWORK_AB";
BA_ "AfdxVLname" BO_ 437201777 "VL_TEST12";
BA_ "AfdxVLid" BO_ 437201777 6671;
BA_ "AfdxVLportSpeed" BO_ 437201777 100;
BA_ "AfdxTxPortId" BO_ 437136240 11120;
BA_ "AfdxPortMasterName" BO_ 437136240 "TEST11_AFDX_PORT_11";
BA_ "AfdxMsgTxRate" BO_ 437136240 80;
BA_ "AfdxVLbufSize" BO_ 437136240 800;
BA_ "AfdxVLdestUDP" BO_ 437136240 11120;
BA_ "AfdxVLsrcUDP" BO_ 437136240 11120;
BA_ "AfdxVLdestIP" BO_ 437136240 "224.224.26.14";
BA_ "AfdxVLsrcIP" BO_ 437136240 "10.2.38.0";
BA_ "AfdxVLipFrag" BO_ 437136240 "True";
BA_ "AfdxVLportChar" BO_ 437136240 "Queuing";
BA_ "AfdxVLportType" BO_ 437136240 "AFDX communication port";
BA_ "AfdxVLsubVLId" BO_ 437136240 1;
BA_ "AfdxVLsubVL" BO_ 437136240 1;
BA_ "AfdxVLintCheck" BO_ 437136240 "False";
BA_ "AfdxVLmaxFrame" BO_ 437136240 800;
BA_ "AfdxVLbag" BO_ 437136240 1;
BA_ "AfdxVLnetSel" BO_ 437136240 "NETWORK_AB";
BA_ "AfdxVLname" BO_ 437136240 "VL_TEST11";
BA_ "AfdxVLid" BO_ 437136240 6670;
BA_ "AfdxVLportSpeed" BO_ 437136240 100;
BA_ "AfdxTxPortId" BO_ 437070703 11119;
BA_ "AfdxPortMasterName" BO_ 437070703 "TEST10_AFDX_PORT_10";
BA_ "AfdxMsgTxRate" BO_ 437070703 80;
BA_ "AfdxVLbufSize" BO_ 437070703 800;
BA_ "AfdxVLdestUDP" BO_ 437070703 11119;
BA_ "AfdxVLsrcUDP" BO_ 437070703 11119;
BA_ "AfdxVLdestIP" BO_ 437070703 "224.224.26.13";
BA_ "AfdxVLsrcIP" BO_ 437070703 "10.2.38.0";
BA_ "AfdxVLipFrag" BO_ 437070703 "True";
BA_ "AfdxVLportChar" BO_ 437070703 "Queuing";
BA_ "AfdxVLportType" BO_ 437070703 "AFDX communication port";
BA_ "AfdxVLsubVLId" BO_ 437070703 1;
BA_ "AfdxVLsubVL" BO_ 437070703 1;
BA_ "AfdxVLintCheck" BO_ 437070703 "False";
BA_ "AfdxVLmaxFrame" BO_ 437070703 800;
BA_ "AfdxVLbag" BO_ 437070703 1;
BA_ "AfdxVLnetSel" BO_ 437070703 "NETWORK_AB";
BA_ "AfdxVLname" BO_ 437070703 "VL_TEST10";
BA_ "AfdxVLid" BO_ 437070703 6669;
BA_ "AfdxVLportSpeed" BO_ 437070703 100;
BA_ "AfdxTxPortId" BO_ 437005166 11118;
BA_ "AfdxPortMasterName" BO_ 437005166 "TEST9_AFDX_PORT_9";
BA_ "AfdxMsgTxRate" BO_ 437005166 80;
BA_ "AfdxVLbufSize" BO_ 437005166 800;
BA_ "AfdxVLdestUDP" BO_ 437005166 11118;
BA_ "AfdxVLsrcUDP" BO_ 437005166 11118;
BA_ "AfdxVLdestIP" BO_ 437005166 "224.224.26.12";
BA_ "AfdxVLsrcIP" BO_ 437005166 "10.2.38.0";
BA_ "AfdxVLipFrag" BO_ 437005166 "True";
BA_ "AfdxVLportChar" BO_ 437005166 "Queuing";
BA_ "AfdxVLportType" BO_ 437005166 "AFDX communication port";
BA_ "AfdxVLsubVLId" BO_ 437005166 1;
BA_ "AfdxVLsubVL" BO_ 437005166 1;
BA_ "AfdxVLintCheck" BO_ 437005166 "False";
BA_ "AfdxVLmaxFrame" BO_ 437005166 800;
BA_ "AfdxVLbag" BO_ 437005166 1;
BA_ "AfdxVLnetSel" BO_ 437005166 "NETWORK_AB";
BA_ "AfdxVLname" BO_ 437005166 "VL_TEST9";
BA_ "AfdxVLid" BO_ 437005166 6668;
BA_ "AfdxVLportSpeed" BO_ 437005166 100;
BA_ "AfdxTxPortId" BO_ 436939629 11117;
BA_ "AfdxPortMasterName" BO_ 436939629 "TEST8_AFDX_PORT_8";
BA_ "AfdxMsgTxRate" BO_ 436939629 80;
BA_ "AfdxVLbufSize" BO_ 436939629 800;
BA_ "AfdxVLdestUDP" BO_ 436939629 11117;
BA_ "AfdxVLsrcUDP" BO_ 436939629 11117;
BA_ "AfdxVLdestIP" BO_ 436939629 "224.224.26.11";
BA_ "AfdxVLsrcIP" BO_ 436939629 "10.2.38.0";
BA_ "AfdxVLipFrag" BO_ 436939629 "True";
BA_ "AfdxVLportChar" BO_ 436939629 "Queuing";
BA_ "AfdxVLportType" BO_ 436939629 "AFDX communication port";
BA_ "AfdxVLsubVLId" BO_ 436939629 1;
BA_ "AfdxVLsubVL" BO_ 436939629 1;
BA_ "AfdxVLintCheck" BO_ 436939629 "False";
BA_ "AfdxVLmaxFrame" BO_ 436939629 800;
BA_ "AfdxVLbag" BO_ 436939629 1;
BA_ "AfdxVLnetSel" BO_ 436939629 "NETWORK_AB";
BA_ "AfdxVLname" BO_ 436939629 "VL_TEST8";
BA_ "AfdxVLid" BO_ 436939629 6667;
BA_ "AfdxVLportSpeed" BO_ 436939629 100;
BA_ "AfdxTxPortId" BO_ 436874092 11116;
BA_ "AfdxPortMasterName" BO_ 436874092 "TEST7_AFDX_PORT_7";
BA_ "AfdxMsgTxRate" BO_ 436874092 80;
BA_ "AfdxVLbufSize" BO_ 436874092 800;
BA_ "AfdxVLdestUDP" BO_ 436874092 11116;
BA_ "AfdxVLsrcUDP" BO_ 436874092 11116;
BA_ "AfdxVLdestIP" BO_ 436874092 "224.224.26.10";
BA_ "AfdxVLsrcIP" BO_ 436874092 "10.2.38.0";
BA_ "AfdxVLipFrag" BO_ 436874092 "True";
BA_ "AfdxVLportChar" BO_ 436874092 "Queuing";
BA_ "AfdxVLportType" BO_ 436874092 "AFDX communication port";
BA_ "AfdxVLsubVLId" BO_ 436874092 1;
BA_ "AfdxVLsubVL" BO_ 436874092 1;
BA_ "AfdxVLintCheck" BO_ 436874092 "False";
BA_ "AfdxVLmaxFrame" BO_ 436874092 800;
BA_ "AfdxVLbag" BO_ 436874092 1;
BA_ "AfdxVLnetSel" BO_ 436874092 "NETWORK_AB";
BA_ "AfdxVLname" BO_ 436874092 "VL_TEST7";
BA_ "AfdxVLid" BO_ 436874092 6666;
BA_ "AfdxVLportSpeed" BO_ 436874092 100;
BA_ "AfdxTxPortId" BO_ 436808555 11115;
BA_ "AfdxPortMasterName" BO_ 436808555 "TEST6_AFDX_PORT_6";
BA_ "AfdxMsgTxRate" BO_ 436808555 80;
BA_ "AfdxVLbufSize" BO_ 436808555 800;
BA_ "AfdxVLdestUDP" BO_ 436808555 11115;
BA_ "AfdxVLsrcUDP" BO_ 436808555 11115;
BA_ "AfdxVLdestIP" BO_ 436808555 "224.224.26.9";
BA_ "AfdxVLsrcIP" BO_ 436808555 "10.2.38.0";
BA_ "AfdxVLipFrag" BO_ 436808555 "True";
BA_ "AfdxVLportChar" BO_ 436808555 "Queuing";
BA_ "AfdxVLportType" BO_ 436808555 "AFDX communication port";
BA_ "AfdxVLsubVLId" BO_ 436808555 1;
BA_ "AfdxVLsubVL" BO_ 436808555 1;
BA_ "AfdxVLintCheck" BO_ 436808555 "False";
BA_ "AfdxVLmaxFrame" BO_ 436808555 800;
BA_ "AfdxVLbag" BO_ 436808555 1;
BA_ "AfdxVLnetSel" BO_ 436808555 "NETWORK_AB";
BA_ "AfdxVLname" BO_ 436808555 "VL_TEST6";
BA_ "AfdxVLid" BO_ 436808555 6665;
BA_ "AfdxVLportSpeed" BO_ 436808555 100;
BA_ "AfdxTxPortId" BO_ 436743018 11114;
BA_ "AfdxPortMasterName" BO_ 436743018 "TEST5_AFDX_PORT_5";
BA_ "AfdxMsgTxRate" BO_ 436743018 80;
BA_ "AfdxVLbufSize" BO_ 436743018 800;
BA_ "AfdxVLdestUDP" BO_ 436743018 11114;
BA_ "AfdxVLsrcUDP" BO_ 436743018 11114;
BA_ "AfdxVLdestIP" BO_ 436743018 "224.224.26.8";
BA_ "AfdxVLsrcIP" BO_ 436743018 "10.2.38.0";
BA_ "AfdxVLipFrag" BO_ 436743018 "True";
BA_ "AfdxVLportChar" BO_ 436743018 "Queuing";
BA_ "AfdxVLportType" BO_ 436743018 "AFDX communication port";
BA_ "AfdxVLsubVLId" BO_ 436743018 1;
BA_ "AfdxVLsubVL" BO_ 436743018 1;
BA_ "AfdxVLintCheck" BO_ 436743018 "False";
BA_ "AfdxVLmaxFrame" BO_ 436743018 800;
BA_ "AfdxVLbag" BO_ 436743018 1;
BA_ "AfdxVLnetSel" BO_ 436743018 "NETWORK_AB";
BA_ "AfdxVLname" BO_ 436743018 "VL_TEST5";
BA_ "AfdxVLid" BO_ 436743018 6664;
BA_ "AfdxVLportSpeed" BO_ 436743018 100;
BA_ "AfdxTxPortId" BO_ 436677481 11113;
BA_ "AfdxPortMasterName" BO_ 436677481 "TEST4_AFDX_PORT_4";
BA_ "AfdxMsgTxRate" BO_ 436677481 80;
BA_ "AfdxVLbufSize" BO_ 436677481 800;
BA_ "AfdxVLdestUDP" BO_ 436677481 11113;
BA_ "AfdxVLsrcUDP" BO_ 436677481 11113;
BA_ "AfdxVLdestIP" BO_ 436677481 "224.224.26.7";
BA_ "AfdxVLsrcIP" BO_ 436677481 "10.2.38.0";
BA_ "AfdxVLipFrag" BO_ 436677481 "True";
BA_ "AfdxVLportChar" BO_ 436677481 "Queuing";
BA_ "AfdxVLportType" BO_ 436677481 "AFDX communication port";
BA_ "AfdxVLsubVLId" BO_ 436677481 1;
BA_ "AfdxVLsubVL" BO_ 436677481 1;
BA_ "AfdxVLintCheck" BO_ 436677481 "False";
BA_ "AfdxVLmaxFrame" BO_ 436677481 800;
BA_ "AfdxVLbag" BO_ 436677481 1;
BA_ "AfdxVLnetSel" BO_ 436677481 "NETWORK_AB";
BA_ "AfdxVLname" BO_ 436677481 "VL_TEST4";
BA_ "AfdxVLid" BO_ 436677481 6663;
BA_ "AfdxVLportSpeed" BO_ 436677481 100;
BA_ "AfdxTxPortId" BO_ 436611944 11112;
BA_ "AfdxPortMasterName" BO_ 436611944 "TEST3_AFDX_PORT_3";
BA_ "AfdxMsgTxRate" BO_ 436611944 80;
BA_ "AfdxVLbufSize" BO_ 436611944 800;
BA_ "AfdxVLdestUDP" BO_ 436611944 11112;
BA_ "AfdxVLsrcUDP" BO_ 436611944 11112;
BA_ "AfdxVLdestIP" BO_ 436611944 "224.224.26.6";
BA_ "AfdxVLsrcIP" BO_ 436611944 "10.2.38.0";
BA_ "AfdxVLipFrag" BO_ 436611944 "True";
BA_ "AfdxVLportChar" BO_ 436611944 "Queuing";
BA_ "AfdxVLportType" BO_ 436611944 "AFDX communication port";
BA_ "AfdxVLsubVLId" BO_ 436611944 1;
BA_ "AfdxVLsubVL" BO_ 436611944 1;
BA_ "AfdxVLintCheck" BO_ 436611944 "False";
BA_ "AfdxVLmaxFrame" BO_ 436611944 800;
BA_ "AfdxVLbag" BO_ 436611944 1;
BA_ "AfdxVLnetSel" BO_ 436611944 "NETWORK_AB";
BA_ "AfdxVLname" BO_ 436611944 "VL_TEST3";
BA_ "AfdxVLid" BO_ 436611944 6662;
BA_ "AfdxVLportSpeed" BO_ 436611944 100;
BA_ "AfdxTxPortId" BO_ 436546407 11111;
BA_ "AfdxPortMasterName" BO_ 436546407 "TEST1_AFDX_PORT_2";
BA_ "AfdxMsgTxRate" BO_ 436546407 320;
BA_ "AfdxVLbufSize" BO_ 436546407 120;
BA_ "AfdxVLdestUDP" BO_ 436546407 11111;
BA_ "AfdxVLsrcUDP" BO_ 436546407 11111;
BA_ "AfdxVLdestIP" BO_ 436546407 "224.224.26.5";
BA_ "AfdxVLsrcIP" BO_ 436546407 "10.2.38.0";
BA_ "AfdxVLipFrag" BO_ 436546407 "True";
BA_ "AfdxVLportChar" BO_ 436546407 "Queuing";
BA_ "AfdxVLportType" BO_ 436546407 "AFDX communication port";
BA_ "AfdxVLsubVLId" BO_ 436546407 1;
BA_ "AfdxVLsubVL" BO_ 436546407 1;
BA_ "AfdxVLintCheck" BO_ 436546407 "False";
BA_ "AfdxVLmaxFrame" BO_ 436546407 48;
BA_ "AfdxVLbag" BO_ 436546407 64;
BA_ "AfdxVLnetSel" BO_ 436546407 "NETWORK_AB";
BA_ "AfdxVLname" BO_ 436546407 "VL_TEST2SEG";
BA_ "AfdxVLid" BO_ 436546407 6661;
BA_ "AfdxVLportSpeed" BO_ 436546407 100;
BA_ "AfdxTxPortId" BO_ 436480870 11110;
BA_ "AfdxPortMasterName" BO_ 436480870 "TEST1_AFDX_PORT_1";
BA_ "AfdxMsgTxRate" BO_ 436480870 320;
BA_ "AfdxVLbufSize" BO_ 436480870 120;
BA_ "AfdxVLdestUDP" BO_ 436480870 11110;
BA_ "AfdxVLsrcUDP" BO_ 436480870 11110;
BA_ "AfdxVLdestIP" BO_ 436480870 "224.224.26.4";
BA_ "AfdxVLsrcIP" BO_ 436480870 "10.2.38.0";
BA_ "AfdxVLipFrag" BO_ 436480870 "False";
BA_ "AfdxVLportChar" BO_ 436480870 "Sampling";
BA_ "AfdxVLportType" BO_ 436480870 "AFDX communication port";
BA_ "AfdxVLsubVLId" BO_ 436480870 1;
BA_ "AfdxVLsubVL" BO_ 436480870 1;
BA_ "AfdxVLintCheck" BO_ 436480870 "False";
BA_ "AfdxVLmaxFrame" BO_ 436480870 96;
BA_ "AfdxVLbag" BO_ 436480870 64;
BA_ "AfdxVLnetSel" BO_ 436480870 "NETWORK_AB";
BA_ "AfdxVLname" BO_ 436480870 "VL_TEST1";
BA_ "AfdxVLid" BO_ 436480870 6660;
BA_ "AfdxVLportSpeed" BO_ 436480870 100;
BA_ "AfdxFSaddr" SG_ 437922684 IOM_A_34_VFG_OIL_TEMP22_A_51 108;
BA_ "AfdxFDSaddr" SG_ 437922684 IOM_A_34_VFG_OIL_TEMP22_A_51 108;
BA_ "AfdxFDSlength" SG_ 437922684 IOM_A_34_VFG_OIL_TEMP22_A_51 4;
BA_ "AfdxFDSname" SG_ 437922684 IOM_A_34_VFG_OIL_TEMP22_A_51 "FDS_HSMU_TEST22_21";
BA_ "AfdxSignalType" SG_ 437922684 IOM_A_34_VFG_OIL_TEMP22_A_51 "Integer";
BA_ "AfdxFSaddr" SG_ 437922684 FS_HSMU_TEST22_21 108;
BA_ "AfdxFDSaddr" SG_ 437922684 FS_HSMU_TEST22_21 108;
BA_ "AfdxFDSlength" SG_ 437922684 FS_HSMU_TEST22_21 4;
BA_ "AfdxFDSname" SG_ 437922684 FS_HSMU_TEST22_21 "FDS_HSMU_TEST22_21";
BA_ "AfdxSignalType" SG_ 437922684 FS_HSMU_TEST22_21 "Enumerate";
BA_ "AfdxFSaddr" SG_ 437922684 IOM_A_34_VFG_OIL_TEMP22_A_50 100;
BA_ "AfdxFDSaddr" SG_ 437922684 IOM_A_34_VFG_OIL_TEMP22_A_50 100;
BA_ "AfdxFDSlength" SG_ 437922684 IOM_A_34_VFG_OIL_TEMP22_A_50 4;
BA_ "AfdxFDSname" SG_ 437922684 IOM_A_34_VFG_OIL_TEMP22_A_50 "FDS_HSMU_TEST22_20";
BA_ "AfdxSignalType" SG_ 437922684 IOM_A_34_VFG_OIL_TEMP22_A_50 "Integer";
BA_ "AfdxFSaddr" SG_ 437922684 FS_HSMU_TEST22_20 100;
BA_ "AfdxFDSaddr" SG_ 437922684 FS_HSMU_TEST22_20 100;
BA_ "AfdxFDSlength" SG_ 437922684 FS_HSMU_TEST22_20 4;
BA_ "AfdxFDSname" SG_ 437922684 FS_HSMU_TEST22_20 "FDS_HSMU_TEST22_20";
BA_ "AfdxSignalType" SG_ 437922684 FS_HSMU_TEST22_20 "Enumerate";
BA_ "AfdxFSaddr" SG_ 437922684 IOM_A_34_VFG_OIL_TEMP22_A_49 96;
BA_ "AfdxFDSaddr" SG_ 437922684 IOM_A_34_VFG_OIL_TEMP22_A_49 96;
BA_ "AfdxFDSlength" SG_ 437922684 IOM_A_34_VFG_OIL_TEMP22_A_49 4;
BA_ "AfdxFDSname" SG_ 437922684 IOM_A_34_VFG_OIL_TEMP22_A_49 "FDS_HSMU_TEST22_19";
BA_ "AfdxSignalType" SG_ 437922684 IOM_A_34_VFG_OIL_TEMP22_A_49 "Integer";
BA_ "AfdxFSaddr" SG_ 437922684 FS_HSMU_TEST22_19 96;
BA_ "AfdxFDSaddr" SG_ 437922684 FS_HSMU_TEST22_19 96;
BA_ "AfdxFDSlength" SG_ 437922684 FS_HSMU_TEST22_19 4;
BA_ "AfdxFDSname" SG_ 437922684 FS_HSMU_TEST22_19 "FDS_HSMU_TEST22_19";
BA_ "AfdxSignalType" SG_ 437922684 FS_HSMU_TEST22_19 "Enumerate";
BA_ "AfdxFSaddr" SG_ 437922684 IOM_A_34_VFG_OIL_TEMP22_A_48 92;
BA_ "AfdxFDSaddr" SG_ 437922684 IOM_A_34_VFG_OIL_TEMP22_A_48 92;
BA_ "AfdxFDSlength" SG_ 437922684 IOM_A_34_VFG_OIL_TEMP22_A_48 4;
BA_ "AfdxFDSname" SG_ 437922684 IOM_A_34_VFG_OIL_TEMP22_A_48 "FDS_HSMU_TEST22_18";
BA_ "AfdxSignalType" SG_ 437922684 IOM_A_34_VFG_OIL_TEMP22_A_48 "Integer";
BA_ "AfdxFSaddr" SG_ 437922684 FS_HSMU_TEST22_18 92;
BA_ "AfdxFDSaddr" SG_ 437922684 FS_HSMU_TEST22_18 92;
BA_ "AfdxFDSlength" SG_ 437922684 FS_HSMU_TEST22_18 4;
BA_ "AfdxFDSname" SG_ 437922684 FS_HSMU_TEST22_18 "FDS_HSMU_TEST22_18";
BA_ "AfdxSignalType" SG_ 437922684 FS_HSMU_TEST22_18 "Enumerate";
BA_ "AfdxFSaddr" SG_ 437922684 IOM_A_34_VFG_OIL_TEMP22_A_47 88;
BA_ "AfdxFDSaddr" SG_ 437922684 IOM_A_34_VFG_OIL_TEMP22_A_47 88;
BA_ "AfdxFDSlength" SG_ 437922684 IOM_A_34_VFG_OIL_TEMP22_A_47 4;
BA_ "AfdxFDSname" SG_ 437922684 IOM_A_34_VFG_OIL_TEMP22_A_47 "FDS_HSMU_TEST22_17";
BA_ "AfdxSignalType" SG_ 437922684 IOM_A_34_VFG_OIL_TEMP22_A_47 "Integer";
BA_ "AfdxFSaddr" SG_ 437922684 FS_HSMU_TEST22_17 88;
BA_ "AfdxFDSaddr" SG_ 437922684 FS_HSMU_TEST22_17 88;
BA_ "AfdxFDSlength" SG_ 437922684 FS_HSMU_TEST22_17 4;
BA_ "AfdxFDSname" SG_ 437922684 FS_HSMU_TEST22_17 "FDS_HSMU_TEST22_17";
BA_ "AfdxSignalType" SG_ 437922684 FS_HSMU_TEST22_17 "Enumerate";
BA_ "AfdxFSaddr" SG_ 437922684 IOM_A_34_VFG_OIL_TEMP22_A_46 80;
BA_ "AfdxFDSaddr" SG_ 437922684 IOM_A_34_VFG_OIL_TEMP22_A_46 80;
BA_ "AfdxFDSlength" SG_ 437922684 IOM_A_34_VFG_OIL_TEMP22_A_46 4;
BA_ "AfdxFDSname" SG_ 437922684 IOM_A_34_VFG_OIL_TEMP22_A_46 "FDS_HSMU_TEST22_16";
BA_ "AfdxSignalType" SG_ 437922684 IOM_A_34_VFG_OIL_TEMP22_A_46 "Integer";
BA_ "AfdxFSaddr" SG_ 437922684 FS_HSMU_TEST22_16 80;
BA_ "AfdxFDSaddr" SG_ 437922684 FS_HSMU_TEST22_16 80;
BA_ "AfdxFDSlength" SG_ 437922684 FS_HSMU_TEST22_16 4;
BA_ "AfdxFDSname" SG_ 437922684 FS_HSMU_TEST22_16 "FDS_HSMU_TEST22_16";
BA_ "AfdxSignalType" SG_ 437922684 FS_HSMU_TEST22_16 "Enumerate";
BA_ "AfdxFSaddr" SG_ 437922684 IOM_A_34_VFG_OIL_TEMP22_A_45 76;
BA_ "AfdxFDSaddr" SG_ 437922684 IOM_A_34_VFG_OIL_TEMP22_A_45 76;
BA_ "AfdxFDSlength" SG_ 437922684 IOM_A_34_VFG_OIL_TEMP22_A_45 4;
BA_ "AfdxFDSname" SG_ 437922684 IOM_A_34_VFG_OIL_TEMP22_A_45 "FDS_HSMU_TEST22_15";
BA_ "AfdxSignalType" SG_ 437922684 IOM_A_34_VFG_OIL_TEMP22_A_45 "Integer";
BA_ "AfdxFSaddr" SG_ 437922684 FS_HSMU_TEST22_15 76;
BA_ "AfdxFDSaddr" SG_ 437922684 FS_HSMU_TEST22_15 76;
BA_ "AfdxFDSlength" SG_ 437922684 FS_HSMU_TEST22_15 4;
BA_ "AfdxFDSname" SG_ 437922684 FS_HSMU_TEST22_15 "FDS_HSMU_TEST22_15";
BA_ "AfdxSignalType" SG_ 437922684 FS_HSMU_TEST22_15 "Enumerate";
BA_ "AfdxFSaddr" SG_ 437922684 IOM_A_34_VFG_OIL_TEMP22_A_44 72;
BA_ "AfdxFDSaddr" SG_ 437922684 IOM_A_34_VFG_OIL_TEMP22_A_44 72;
BA_ "AfdxFDSlength" SG_ 437922684 IOM_A_34_VFG_OIL_TEMP22_A_44 4;
BA_ "AfdxFDSname" SG_ 437922684 IOM_A_34_VFG_OIL_TEMP22_A_44 "FDS_HSMU_TEST22_14";
BA_ "AfdxSignalType" SG_ 437922684 IOM_A_34_VFG_OIL_TEMP22_A_44 "Integer";
BA_ "AfdxFSaddr" SG_ 437922684 FS_HSMU_TEST22_14 72;
BA_ "AfdxFDSaddr" SG_ 437922684 FS_HSMU_TEST22_14 72;
BA_ "AfdxFDSlength" SG_ 437922684 FS_HSMU_TEST22_14 4;
BA_ "AfdxFDSname" SG_ 437922684 FS_HSMU_TEST22_14 "FDS_HSMU_TEST22_14";
BA_ "AfdxSignalType" SG_ 437922684 FS_HSMU_TEST22_14 "Enumerate";
BA_ "AfdxFSaddr" SG_ 437922684 IOM_A_34_VFG_OIL_TEMP22_A_43 68;
BA_ "AfdxFDSaddr" SG_ 437922684 IOM_A_34_VFG_OIL_TEMP22_A_43 68;
BA_ "AfdxFDSlength" SG_ 437922684 IOM_A_34_VFG_OIL_TEMP22_A_43 4;
BA_ "AfdxFDSname" SG_ 437922684 IOM_A_34_VFG_OIL_TEMP22_A_43 "FDS_HSMU_TEST22_13";
BA_ "AfdxSignalType" SG_ 437922684 IOM_A_34_VFG_OIL_TEMP22_A_43 "Integer";
BA_ "AfdxFSaddr" SG_ 437922684 FS_HSMU_TEST22_13 68;
BA_ "AfdxFDSaddr" SG_ 437922684 FS_HSMU_TEST22_13 68;
BA_ "AfdxFDSlength" SG_ 437922684 FS_HSMU_TEST22_13 4;
BA_ "AfdxFDSname" SG_ 437922684 FS_HSMU_TEST22_13 "FDS_HSMU_TEST22_13";
BA_ "AfdxSignalType" SG_ 437922684 FS_HSMU_TEST22_13 "Enumerate";
BA_ "AfdxFSaddr" SG_ 437922684 IOM_A_34_VFG_OIL_TEMP22_A_42 60;
BA_ "AfdxFDSaddr" SG_ 437922684 IOM_A_34_VFG_OIL_TEMP22_A_42 60;
BA_ "AfdxFDSlength" SG_ 437922684 IOM_A_34_VFG_OIL_TEMP22_A_42 4;
BA_ "AfdxFDSname" SG_ 437922684 IOM_A_34_VFG_OIL_TEMP22_A_42 "FDS_HSMU_TEST22_12";
BA_ "AfdxSignalType" SG_ 437922684 IOM_A_34_VFG_OIL_TEMP22_A_42 "Integer";
BA_ "AfdxFSaddr" SG_ 437922684 FS_HSMU_TEST22_12 60;
BA_ "AfdxFDSaddr" SG_ 437922684 FS_HSMU_TEST22_12 60;
BA_ "AfdxFDSlength" SG_ 437922684 FS_HSMU_TEST22_12 4;
BA_ "AfdxFDSname" SG_ 437922684 FS_HSMU_TEST22_12 "FDS_HSMU_TEST22_12";
BA_ "AfdxSignalType" SG_ 437922684 FS_HSMU_TEST22_12 "Enumerate";
BA_ "AfdxFSaddr" SG_ 437922684 IOM_A_34_VFG_OIL_TEMP22_A_41 56;
BA_ "AfdxFDSaddr" SG_ 437922684 IOM_A_34_VFG_OIL_TEMP22_A_41 56;
BA_ "AfdxFDSlength" SG_ 437922684 IOM_A_34_VFG_OIL_TEMP22_A_41 4;
BA_ "AfdxFDSname" SG_ 437922684 IOM_A_34_VFG_OIL_TEMP22_A_41 "FDS_HSMU_TEST22_11";
BA_ "AfdxSignalType" SG_ 437922684 IOM_A_34_VFG_OIL_TEMP22_A_41 "Integer";
BA_ "AfdxFSaddr" SG_ 437922684 FS_HSMU_TEST22_11 56;
BA_ "AfdxFDSaddr" SG_ 437922684 FS_HSMU_TEST22_11 56;
BA_ "AfdxFDSlength" SG_ 437922684 FS_HSMU_TEST22_11 4;
BA_ "AfdxFDSname" SG_ 437922684 FS_HSMU_TEST22_11 "FDS_HSMU_TEST22_11";
BA_ "AfdxSignalType" SG_ 437922684 FS_HSMU_TEST22_11 "Enumerate";
BA_ "AfdxFSaddr" SG_ 437922684 IOM_A_34_VFG_OIL_TEMP22_A_40 52;
BA_ "AfdxFDSaddr" SG_ 437922684 IOM_A_34_VFG_OIL_TEMP22_A_40 52;
BA_ "AfdxFDSlength" SG_ 437922684 IOM_A_34_VFG_OIL_TEMP22_A_40 4;
BA_ "AfdxFDSname" SG_ 437922684 IOM_A_34_VFG_OIL_TEMP22_A_40 "FDS_HSMU_TEST22_10";
BA_ "AfdxSignalType" SG_ 437922684 IOM_A_34_VFG_OIL_TEMP22_A_40 "Integer";
BA_ "AfdxFSaddr" SG_ 437922684 FS_HSMU_TEST22_10 52;
BA_ "AfdxFDSaddr" SG_ 437922684 FS_HSMU_TEST22_10 52;
BA_ "AfdxFDSlength" SG_ 437922684 FS_HSMU_TEST22_10 4;
BA_ "AfdxFDSname" SG_ 437922684 FS_HSMU_TEST22_10 "FDS_HSMU_TEST22_10";
BA_ "AfdxSignalType" SG_ 437922684 FS_HSMU_TEST22_10 "Enumerate";
BA_ "AfdxFSaddr" SG_ 437922684 IOM_A_34_VFG_OIL_TEMP22_A_39 48;
BA_ "AfdxFDSaddr" SG_ 437922684 IOM_A_34_VFG_OIL_TEMP22_A_39 48;
BA_ "AfdxFDSlength" SG_ 437922684 IOM_A_34_VFG_OIL_TEMP22_A_39 4;
BA_ "AfdxFDSname" SG_ 437922684 IOM_A_34_VFG_OIL_TEMP22_A_39 "FDS_HSMU_TEST22_9";
BA_ "AfdxSignalType" SG_ 437922684 IOM_A_34_VFG_OIL_TEMP22_A_39 "Integer";
BA_ "AfdxFSaddr" SG_ 437922684 FS_HSMU_TEST22_9 48;
BA_ "AfdxFDSaddr" SG_ 437922684 FS_HSMU_TEST22_9 48;
BA_ "AfdxFDSlength" SG_ 437922684 FS_HSMU_TEST22_9 4;
BA_ "AfdxFDSname" SG_ 437922684 FS_HSMU_TEST22_9 "FDS_HSMU_TEST22_9";
BA_ "AfdxSignalType" SG_ 437922684 FS_HSMU_TEST22_9 "Enumerate";
BA_ "AfdxFSaddr" SG_ 437922684 IOM_A_34_VFG_OIL_TEMP22_A_38 40;
BA_ "AfdxFDSaddr" SG_ 437922684 IOM_A_34_VFG_OIL_TEMP22_A_38 40;
BA_ "AfdxFDSlength" SG_ 437922684 IOM_A_34_VFG_OIL_TEMP22_A_38 4;
BA_ "AfdxFDSname" SG_ 437922684 IOM_A_34_VFG_OIL_TEMP22_A_38 "FDS_HSMU_TEST22_8";
BA_ "AfdxSignalType" SG_ 437922684 IOM_A_34_VFG_OIL_TEMP22_A_38 "Integer";
BA_ "AfdxFSaddr" SG_ 437922684 FS_HSMU_TEST22_8 40;
BA_ "AfdxFDSaddr" SG_ 437922684 FS_HSMU_TEST22_8 40;
BA_ "AfdxFDSlength" SG_ 437922684 FS_HSMU_TEST22_8 4;
BA_ "AfdxFDSname" SG_ 437922684 FS_HSMU_TEST22_8 "FDS_HSMU_TEST22_8";
BA_ "AfdxSignalType" SG_ 437922684 FS_HSMU_TEST22_8 "Enumerate";
BA_ "AfdxFSaddr" SG_ 437922684 IOM_A_34_VFG_OIL_TEMP22_A_37 36;
BA_ "AfdxFDSaddr" SG_ 437922684 IOM_A_34_VFG_OIL_TEMP22_A_37 36;
BA_ "AfdxFDSlength" SG_ 437922684 IOM_A_34_VFG_OIL_TEMP22_A_37 4;
BA_ "AfdxFDSname" SG_ 437922684 IOM_A_34_VFG_OIL_TEMP22_A_37 "FDS_HSMU_TEST22_7";
BA_ "AfdxSignalType" SG_ 437922684 IOM_A_34_VFG_OIL_TEMP22_A_37 "Integer";
BA_ "AfdxFSaddr" SG_ 437922684 FS_HSMU_TEST22_7 36;
BA_ "AfdxFDSaddr" SG_ 437922684 FS_HSMU_TEST22_7 36;
BA_ "AfdxFDSlength" SG_ 437922684 FS_HSMU_TEST22_7 4;
BA_ "AfdxFDSname" SG_ 437922684 FS_HSMU_TEST22_7 "FDS_HSMU_TEST22_7";
BA_ "AfdxSignalType" SG_ 437922684 FS_HSMU_TEST22_7 "Enumerate";
BA_ "AfdxFSaddr" SG_ 437922684 IOM_A_34_VFG_OIL_TEMP22_A_36 32;
BA_ "AfdxFDSaddr" SG_ 437922684 IOM_A_34_VFG_OIL_TEMP22_A_36 32;
BA_ "AfdxFDSlength" SG_ 437922684 IOM_A_34_VFG_OIL_TEMP22_A_36 4;
BA_ "AfdxFDSname" SG_ 437922684 IOM_A_34_VFG_OIL_TEMP22_A_36 "FDS_HSMU_TEST22_6";
BA_ "AfdxSignalType" SG_ 437922684 IOM_A_34_VFG_OIL_TEMP22_A_36 "Integer";
BA_ "AfdxFSaddr" SG_ 437922684 FS_HSMU_TEST22_6 32;
BA_ "AfdxFDSaddr" SG_ 437922684 FS_HSMU_TEST22_6 32;
BA_ "AfdxFDSlength" SG_ 437922684 FS_HSMU_TEST22_6 4;
BA_ "AfdxFDSname" SG_ 437922684 FS_HSMU_TEST22_6 "FDS_HSMU_TEST22_6";
BA_ "AfdxSignalType" SG_ 437922684 FS_HSMU_TEST22_6 "Enumerate";
BA_ "AfdxFSaddr" SG_ 437922684 IOM_A_34_VFG_OIL_TEMP22_A_35 28;
BA_ "AfdxFDSaddr" SG_ 437922684 IOM_A_34_VFG_OIL_TEMP22_A_35 28;
BA_ "AfdxFDSlength" SG_ 437922684 IOM_A_34_VFG_OIL_TEMP22_A_35 4;
BA_ "AfdxFDSname" SG_ 437922684 IOM_A_34_VFG_OIL_TEMP22_A_35 "FDS_HSMU_TEST22_5";
BA_ "AfdxSignalType" SG_ 437922684 IOM_A_34_VFG_OIL_TEMP22_A_35 "Integer";
BA_ "AfdxFSaddr" SG_ 437922684 FS_HSMU_TEST22_5 28;
BA_ "AfdxFDSaddr" SG_ 437922684 FS_HSMU_TEST22_5 28;
BA_ "AfdxFDSlength" SG_ 437922684 FS_HSMU_TEST22_5 4;
BA_ "AfdxFDSname" SG_ 437922684 FS_HSMU_TEST22_5 "FDS_HSMU_TEST22_5";
BA_ "AfdxSignalType" SG_ 437922684 FS_HSMU_TEST22_5 "Enumerate";
BA_ "AfdxFSaddr" SG_ 437922684 IOM_A_34_VFG_OIL_TEMP22_A_34 20;
BA_ "AfdxFDSaddr" SG_ 437922684 IOM_A_34_VFG_OIL_TEMP22_A_34 20;
BA_ "AfdxFDSlength" SG_ 437922684 IOM_A_34_VFG_OIL_TEMP22_A_34 4;
BA_ "AfdxFDSname" SG_ 437922684 IOM_A_34_VFG_OIL_TEMP22_A_34 "FDS_HSMU_TEST22_4";
BA_ "AfdxSignalType" SG_ 437922684 IOM_A_34_VFG_OIL_TEMP22_A_34 "Integer";
BA_ "AfdxFSaddr" SG_ 437922684 FS_HSMU_TEST22_4 20;
BA_ "AfdxFDSaddr" SG_ 437922684 FS_HSMU_TEST22_4 20;
BA_ "AfdxFDSlength" SG_ 437922684 FS_HSMU_TEST22_4 4;
BA_ "AfdxFDSname" SG_ 437922684 FS_HSMU_TEST22_4 "FDS_HSMU_TEST22_4";
BA_ "AfdxSignalType" SG_ 437922684 FS_HSMU_TEST22_4 "Enumerate";
BA_ "AfdxFSaddr" SG_ 437922684 IOM_A_34_VFG_OIL_TEMP22_A_33 16;
BA_ "AfdxFDSaddr" SG_ 437922684 IOM_A_34_VFG_OIL_TEMP22_A_33 16;
BA_ "AfdxFDSlength" SG_ 437922684 IOM_A_34_VFG_OIL_TEMP22_A_33 4;
BA_ "AfdxFDSname" SG_ 437922684 IOM_A_34_VFG_OIL_TEMP22_A_33 "FDS_HSMU_TEST22_3";
BA_ "AfdxSignalType" SG_ 437922684 IOM_A_34_VFG_OIL_TEMP22_A_33 "Integer";
BA_ "AfdxFSaddr" SG_ 437922684 FS_HSMU_TEST22_3 16;
BA_ "AfdxFDSaddr" SG_ 437922684 FS_HSMU_TEST22_3 16;
BA_ "AfdxFDSlength" SG_ 437922684 FS_HSMU_TEST22_3 4;
BA_ "AfdxFDSname" SG_ 437922684 FS_HSMU_TEST22_3 "FDS_HSMU_TEST22_3";
BA_ "AfdxSignalType" SG_ 437922684 FS_HSMU_TEST22_3 "Enumerate";
BA_ "AfdxFSaddr" SG_ 437922684 IOM_A_34_VFG_OIL_TEMP22_A_32 12;
BA_ "AfdxFDSaddr" SG_ 437922684 IOM_A_34_VFG_OIL_TEMP22_A_32 12;
BA_ "AfdxFDSlength" SG_ 437922684 IOM_A_34_VFG_OIL_TEMP22_A_32 4;
BA_ "AfdxFDSname" SG_ 437922684 IOM_A_34_VFG_OIL_TEMP22_A_32 "FDS_HSMU_TEST22_2";
BA_ "AfdxSignalType" SG_ 437922684 IOM_A_34_VFG_OIL_TEMP22_A_32 "Integer";
BA_ "AfdxFSaddr" SG_ 437922684 FS_HSMU_TEST22_2 12;
BA_ "AfdxFDSaddr" SG_ 437922684 FS_HSMU_TEST22_2 12;
BA_ "AfdxFDSlength" SG_ 437922684 FS_HSMU_TEST22_2 4;
BA_ "AfdxFDSname" SG_ 437922684 FS_HSMU_TEST22_2 "FDS_HSMU_TEST22_2";
BA_ "AfdxSignalType" SG_ 437922684 FS_HSMU_TEST22_2 "Enumerate";
BA_ "AfdxFSaddr" SG_ 437922684 IOM_A_34_VFG_OIL_TEMP22_A_31 8;
BA_ "AfdxFDSaddr" SG_ 437922684 IOM_A_34_VFG_OIL_TEMP22_A_31 8;
BA_ "AfdxFDSlength" SG_ 437922684 IOM_A_34_VFG_OIL_TEMP22_A_31 4;
BA_ "AfdxFDSname" SG_ 437922684 IOM_A_34_VFG_OIL_TEMP22_A_31 "FDS_HSMU_TEST22_1";
BA_ "AfdxSignalType" SG_ 437922684 IOM_A_34_VFG_OIL_TEMP22_A_31 "Integer";
BA_ "AfdxFSaddr" SG_ 437922684 FS_HSMU_TEST22_1 8;
BA_ "AfdxFDSaddr" SG_ 437922684 FS_HSMU_TEST22_1 8;
BA_ "AfdxFDSlength" SG_ 437922684 FS_HSMU_TEST22_1 4;
BA_ "AfdxFDSname" SG_ 437922684 FS_HSMU_TEST22_1 "FDS_HSMU_TEST22_1";
BA_ "AfdxSignalType" SG_ 437922684 FS_HSMU_TEST22_1 "Enumerate";
BA_ "AfdxFSaddr" SG_ 437857147 IOM_A_34_VFG_OIL_TEMP21_A_70 200;
BA_ "AfdxFDSaddr" SG_ 437857147 IOM_A_34_VFG_OIL_TEMP21_A_70 200;
BA_ "AfdxFDSlength" SG_ 437857147 IOM_A_34_VFG_OIL_TEMP21_A_70 4;
BA_ "AfdxFDSname" SG_ 437857147 IOM_A_34_VFG_OIL_TEMP21_A_70 "FDS_HSMU_TEST21_40";
BA_ "AfdxSignalType" SG_ 437857147 IOM_A_34_VFG_OIL_TEMP21_A_70 "Integer";
BA_ "AfdxFSaddr" SG_ 437857147 FS_HSMU_TEST21_40 200;
BA_ "AfdxFDSaddr" SG_ 437857147 FS_HSMU_TEST21_40 200;
BA_ "AfdxFDSlength" SG_ 437857147 FS_HSMU_TEST21_40 4;
BA_ "AfdxFDSname" SG_ 437857147 FS_HSMU_TEST21_40 "FDS_HSMU_TEST21_40";
BA_ "AfdxSignalType" SG_ 437857147 FS_HSMU_TEST21_40 "Enumerate";
BA_ "AfdxFSaddr" SG_ 437857147 IOM_A_34_VFG_OIL_TEMP21_A_69 196;
BA_ "AfdxFDSaddr" SG_ 437857147 IOM_A_34_VFG_OIL_TEMP21_A_69 196;
BA_ "AfdxFDSlength" SG_ 437857147 IOM_A_34_VFG_OIL_TEMP21_A_69 4;
BA_ "AfdxFDSname" SG_ 437857147 IOM_A_34_VFG_OIL_TEMP21_A_69 "FDS_HSMU_TEST21_39";
BA_ "AfdxSignalType" SG_ 437857147 IOM_A_34_VFG_OIL_TEMP21_A_69 "Integer";
BA_ "AfdxFSaddr" SG_ 437857147 FS_HSMU_TEST21_39 196;
BA_ "AfdxFDSaddr" SG_ 437857147 FS_HSMU_TEST21_39 196;
BA_ "AfdxFDSlength" SG_ 437857147 FS_HSMU_TEST21_39 4;
BA_ "AfdxFDSname" SG_ 437857147 FS_HSMU_TEST21_39 "FDS_HSMU_TEST21_39";
BA_ "AfdxSignalType" SG_ 437857147 FS_HSMU_TEST21_39 "Enumerate";
BA_ "AfdxFSaddr" SG_ 437857147 IOM_A_34_VFG_OIL_TEMP21_A_68 192;
BA_ "AfdxFDSaddr" SG_ 437857147 IOM_A_34_VFG_OIL_TEMP21_A_68 192;
BA_ "AfdxFDSlength" SG_ 437857147 IOM_A_34_VFG_OIL_TEMP21_A_68 4;
BA_ "AfdxFDSname" SG_ 437857147 IOM_A_34_VFG_OIL_TEMP21_A_68 "FDS_HSMU_TEST21_38";
BA_ "AfdxSignalType" SG_ 437857147 IOM_A_34_VFG_OIL_TEMP21_A_68 "Integer";
BA_ "AfdxFSaddr" SG_ 437857147 FS_HSMU_TEST21_38 192;
BA_ "AfdxFDSaddr" SG_ 437857147 FS_HSMU_TEST21_38 192;
BA_ "AfdxFDSlength" SG_ 437857147 FS_HSMU_TEST21_38 4;
BA_ "AfdxFDSname" SG_ 437857147 FS_HSMU_TEST21_38 "FDS_HSMU_TEST21_38";
BA_ "AfdxSignalType" SG_ 437857147 FS_HSMU_TEST21_38 "Enumerate";
BA_ "AfdxFSaddr" SG_ 437857147 IOM_A_34_VFG_OIL_TEMP21_A_67 188;
BA_ "AfdxFDSaddr" SG_ 437857147 IOM_A_34_VFG_OIL_TEMP21_A_67 188;
BA_ "AfdxFDSlength" SG_ 437857147 IOM_A_34_VFG_OIL_TEMP21_A_67 4;
BA_ "AfdxFDSname" SG_ 437857147 IOM_A_34_VFG_OIL_TEMP21_A_67 "FDS_HSMU_TEST21_37";
BA_ "AfdxSignalType" SG_ 437857147 IOM_A_34_VFG_OIL_TEMP21_A_67 "Integer";
BA_ "AfdxFSaddr" SG_ 437857147 FS_HSMU_TEST21_37 188;
BA_ "AfdxFDSaddr" SG_ 437857147 FS_HSMU_TEST21_37 188;
BA_ "AfdxFDSlength" SG_ 437857147 FS_HSMU_TEST21_37 4;
BA_ "AfdxFDSname" SG_ 437857147 FS_HSMU_TEST21_37 "FDS_HSMU_TEST21_37";
BA_ "AfdxSignalType" SG_ 437857147 FS_HSMU_TEST21_37 "Enumerate";
BA_ "AfdxFSaddr" SG_ 437857147 IOM_A_34_VFG_OIL_TEMP21_A_66 180;
BA_ "AfdxFDSaddr" SG_ 437857147 IOM_A_34_VFG_OIL_TEMP21_A_66 180;
BA_ "AfdxFDSlength" SG_ 437857147 IOM_A_34_VFG_OIL_TEMP21_A_66 4;
BA_ "AfdxFDSname" SG_ 437857147 IOM_A_34_VFG_OIL_TEMP21_A_66 "FDS_HSMU_TEST21_36";
BA_ "AfdxSignalType" SG_ 437857147 IOM_A_34_VFG_OIL_TEMP21_A_66 "Integer";
BA_ "AfdxFSaddr" SG_ 437857147 FS_HSMU_TEST21_36 180;
BA_ "AfdxFDSaddr" SG_ 437857147 FS_HSMU_TEST21_36 180;
BA_ "AfdxFDSlength" SG_ 437857147 FS_HSMU_TEST21_36 4;
BA_ "AfdxFDSname" SG_ 437857147 FS_HSMU_TEST21_36 "FDS_HSMU_TEST21_36";
BA_ "AfdxSignalType" SG_ 437857147 FS_HSMU_TEST21_36 "Enumerate";
BA_ "AfdxFSaddr" SG_ 437857147 IOM_A_34_VFG_OIL_TEMP21_A_65 176;
BA_ "AfdxFDSaddr" SG_ 437857147 IOM_A_34_VFG_OIL_TEMP21_A_65 176;
BA_ "AfdxFDSlength" SG_ 437857147 IOM_A_34_VFG_OIL_TEMP21_A_65 4;
BA_ "AfdxFDSname" SG_ 437857147 IOM_A_34_VFG_OIL_TEMP21_A_65 "FDS_HSMU_TEST21_35";
BA_ "AfdxSignalType" SG_ 437857147 IOM_A_34_VFG_OIL_TEMP21_A_65 "Integer";
BA_ "AfdxFSaddr" SG_ 437857147 FS_HSMU_TEST21_35 176;
BA_ "AfdxFDSaddr" SG_ 437857147 FS_HSMU_TEST21_35 176;
BA_ "AfdxFDSlength" SG_ 437857147 FS_HSMU_TEST21_35 4;
BA_ "AfdxFDSname" SG_ 437857147 FS_HSMU_TEST21_35 "FDS_HSMU_TEST21_35";
BA_ "AfdxSignalType" SG_ 437857147 FS_HSMU_TEST21_35 "Enumerate";
BA_ "AfdxFSaddr" SG_ 437857147 IOM_A_34_VFG_OIL_TEMP21_A_64 172;
BA_ "AfdxFDSaddr" SG_ 437857147 IOM_A_34_VFG_OIL_TEMP21_A_64 172;
BA_ "AfdxFDSlength" SG_ 437857147 IOM_A_34_VFG_OIL_TEMP21_A_64 4;
BA_ "AfdxFDSname" SG_ 437857147 IOM_A_34_VFG_OIL_TEMP21_A_64 "FDS_HSMU_TEST21_34";
BA_ "AfdxSignalType" SG_ 437857147 IOM_A_34_VFG_OIL_TEMP21_A_64 "Integer";
BA_ "AfdxFSaddr" SG_ 437857147 FS_HSMU_TEST21_34 172;
BA_ "AfdxFDSaddr" SG_ 437857147 FS_HSMU_TEST21_34 172;
BA_ "AfdxFDSlength" SG_ 437857147 FS_HSMU_TEST21_34 4;
BA_ "AfdxFDSname" SG_ 437857147 FS_HSMU_TEST21_34 "FDS_HSMU_TEST21_34";
BA_ "AfdxSignalType" SG_ 437857147 FS_HSMU_TEST21_34 "Enumerate";
BA_ "AfdxFSaddr" SG_ 437857147 IOM_A_34_VFG_OIL_TEMP21_A_63 168;
BA_ "AfdxFDSaddr" SG_ 437857147 IOM_A_34_VFG_OIL_TEMP21_A_63 168;
BA_ "AfdxFDSlength" SG_ 437857147 IOM_A_34_VFG_OIL_TEMP21_A_63 4;
BA_ "AfdxFDSname" SG_ 437857147 IOM_A_34_VFG_OIL_TEMP21_A_63 "FDS_HSMU_TEST21_33";
BA_ "AfdxSignalType" SG_ 437857147 IOM_A_34_VFG_OIL_TEMP21_A_63 "Integer";
BA_ "AfdxFSaddr" SG_ 437857147 FS_HSMU_TEST21_33 168;
BA_ "AfdxFDSaddr" SG_ 437857147 FS_HSMU_TEST21_33 168;
BA_ "AfdxFDSlength" SG_ 437857147 FS_HSMU_TEST21_33 4;
BA_ "AfdxFDSname" SG_ 437857147 FS_HSMU_TEST21_33 "FDS_HSMU_TEST21_33";
BA_ "AfdxSignalType" SG_ 437857147 FS_HSMU_TEST21_33 "Enumerate";
BA_ "AfdxFSaddr" SG_ 437857147 IOM_A_34_VFG_OIL_TEMP21_A_62 160;
BA_ "AfdxFDSaddr" SG_ 437857147 IOM_A_34_VFG_OIL_TEMP21_A_62 160;
BA_ "AfdxFDSlength" SG_ 437857147 IOM_A_34_VFG_OIL_TEMP21_A_62 4;
BA_ "AfdxFDSname" SG_ 437857147 IOM_A_34_VFG_OIL_TEMP21_A_62 "FDS_HSMU_TEST21_32";
BA_ "AfdxSignalType" SG_ 437857147 IOM_A_34_VFG_OIL_TEMP21_A_62 "Integer";
BA_ "AfdxFSaddr" SG_ 437857147 FS_HSMU_TEST21_32 160;
BA_ "AfdxFDSaddr" SG_ 437857147 FS_HSMU_TEST21_32 160;
BA_ "AfdxFDSlength" SG_ 437857147 FS_HSMU_TEST21_32 4;
BA_ "AfdxFDSname" SG_ 437857147 FS_HSMU_TEST21_32 "FDS_HSMU_TEST21_32";
BA_ "AfdxSignalType" SG_ 437857147 FS_HSMU_TEST21_32 "Enumerate";
BA_ "AfdxFSaddr" SG_ 437857147 IOM_A_34_VFG_OIL_TEMP21_A_61 156;
BA_ "AfdxFDSaddr" SG_ 437857147 IOM_A_34_VFG_OIL_TEMP21_A_61 156;
BA_ "AfdxFDSlength" SG_ 437857147 IOM_A_34_VFG_OIL_TEMP21_A_61 4;
BA_ "AfdxFDSname" SG_ 437857147 IOM_A_34_VFG_OIL_TEMP21_A_61 "FDS_HSMU_TEST21_31";
BA_ "AfdxSignalType" SG_ 437857147 IOM_A_34_VFG_OIL_TEMP21_A_61 "Integer";
BA_ "AfdxFSaddr" SG_ 437857147 FS_HSMU_TEST21_31 156;
BA_ "AfdxFDSaddr" SG_ 437857147 FS_HSMU_TEST21_31 156;
BA_ "AfdxFDSlength" SG_ 437857147 FS_HSMU_TEST21_31 4;
BA_ "AfdxFDSname" SG_ 437857147 FS_HSMU_TEST21_31 "FDS_HSMU_TEST21_31";
BA_ "AfdxSignalType" SG_ 437857147 FS_HSMU_TEST21_31 "Enumerate";
BA_ "AfdxFSaddr" SG_ 437857147 IOM_A_34_VFG_OIL_TEMP21_A_60 152;
BA_ "AfdxFDSaddr" SG_ 437857147 IOM_A_34_VFG_OIL_TEMP21_A_60 152;
BA_ "AfdxFDSlength" SG_ 437857147 IOM_A_34_VFG_OIL_TEMP21_A_60 4;
BA_ "AfdxFDSname" SG_ 437857147 IOM_A_34_VFG_OIL_TEMP21_A_60 "FDS_HSMU_TEST21_30";
BA_ "AfdxSignalType" SG_ 437857147 IOM_A_34_VFG_OIL_TEMP21_A_60 "Integer";
BA_ "AfdxFSaddr" SG_ 437857147 FS_HSMU_TEST21_30 152;
BA_ "AfdxFDSaddr" SG_ 437857147 FS_HSMU_TEST21_30 152;
BA_ "AfdxFDSlength" SG_ 437857147 FS_HSMU_TEST21_30 4;
BA_ "AfdxFDSname" SG_ 437857147 FS_HSMU_TEST21_30 "FDS_HSMU_TEST21_30";
BA_ "AfdxSignalType" SG_ 437857147 FS_HSMU_TEST21_30 "Enumerate";
BA_ "AfdxFSaddr" SG_ 437857147 IOM_A_34_VFG_OIL_TEMP21_A_59 148;
BA_ "AfdxFDSaddr" SG_ 437857147 IOM_A_34_VFG_OIL_TEMP21_A_59 148;
BA_ "AfdxFDSlength" SG_ 437857147 IOM_A_34_VFG_OIL_TEMP21_A_59 4;
BA_ "AfdxFDSname" SG_ 437857147 IOM_A_34_VFG_OIL_TEMP21_A_59 "FDS_HSMU_TEST21_29";
BA_ "AfdxSignalType" SG_ 437857147 IOM_A_34_VFG_OIL_TEMP21_A_59 "Integer";
BA_ "AfdxFSaddr" SG_ 437857147 FS_HSMU_TEST21_29 148;
BA_ "AfdxFDSaddr" SG_ 437857147 FS_HSMU_TEST21_29 148;
BA_ "AfdxFDSlength" SG_ 437857147 FS_HSMU_TEST21_29 4;
BA_ "AfdxFDSname" SG_ 437857147 FS_HSMU_TEST21_29 "FDS_HSMU_TEST21_29";
BA_ "AfdxSignalType" SG_ 437857147 FS_HSMU_TEST21_29 "Enumerate";
BA_ "AfdxFSaddr" SG_ 437857147 IOM_A_34_VFG_OIL_TEMP21_A_58 140;
BA_ "AfdxFDSaddr" SG_ 437857147 IOM_A_34_VFG_OIL_TEMP21_A_58 140;
BA_ "AfdxFDSlength" SG_ 437857147 IOM_A_34_VFG_OIL_TEMP21_A_58 4;
BA_ "AfdxFDSname" SG_ 437857147 IOM_A_34_VFG_OIL_TEMP21_A_58 "FDS_HSMU_TEST21_28";
BA_ "AfdxSignalType" SG_ 437857147 IOM_A_34_VFG_OIL_TEMP21_A_58 "Integer";
BA_ "AfdxFSaddr" SG_ 437857147 FS_HSMU_TEST21_28 140;
BA_ "AfdxFDSaddr" SG_ 437857147 FS_HSMU_TEST21_28 140;
BA_ "AfdxFDSlength" SG_ 437857147 FS_HSMU_TEST21_28 4;
BA_ "AfdxFDSname" SG_ 437857147 FS_HSMU_TEST21_28 "FDS_HSMU_TEST21_28";
BA_ "AfdxSignalType" SG_ 437857147 FS_HSMU_TEST21_28 "Enumerate";
BA_ "AfdxFSaddr" SG_ 437857147 IOM_A_34_VFG_OIL_TEMP21_A_57 136;
BA_ "AfdxFDSaddr" SG_ 437857147 IOM_A_34_VFG_OIL_TEMP21_A_57 136;
BA_ "AfdxFDSlength" SG_ 437857147 IOM_A_34_VFG_OIL_TEMP21_A_57 4;
BA_ "AfdxFDSname" SG_ 437857147 IOM_A_34_VFG_OIL_TEMP21_A_57 "FDS_HSMU_TEST21_27";
BA_ "AfdxSignalType" SG_ 437857147 IOM_A_34_VFG_OIL_TEMP21_A_57 "Integer";
BA_ "AfdxFSaddr" SG_ 437857147 FS_HSMU_TEST21_27 136;
BA_ "AfdxFDSaddr" SG_ 437857147 FS_HSMU_TEST21_27 136;
BA_ "AfdxFDSlength" SG_ 437857147 FS_HSMU_TEST21_27 4;
BA_ "AfdxFDSname" SG_ 437857147 FS_HSMU_TEST21_27 "FDS_HSMU_TEST21_27";
BA_ "AfdxSignalType" SG_ 437857147 FS_HSMU_TEST21_27 "Enumerate";
BA_ "AfdxFSaddr" SG_ 437857147 IOM_A_34_VFG_OIL_TEMP21_A_56 132;
BA_ "AfdxFDSaddr" SG_ 437857147 IOM_A_34_VFG_OIL_TEMP21_A_56 132;
BA_ "AfdxFDSlength" SG_ 437857147 IOM_A_34_VFG_OIL_TEMP21_A_56 4;
BA_ "AfdxFDSname" SG_ 437857147 IOM_A_34_VFG_OIL_TEMP21_A_56 "FDS_HSMU_TEST21_26";
BA_ "AfdxSignalType" SG_ 437857147 IOM_A_34_VFG_OIL_TEMP21_A_56 "Integer";
BA_ "AfdxFSaddr" SG_ 437857147 FS_HSMU_TEST21_26 132;
BA_ "AfdxFDSaddr" SG_ 437857147 FS_HSMU_TEST21_26 132;
BA_ "AfdxFDSlength" SG_ 437857147 FS_HSMU_TEST21_26 4;
BA_ "AfdxFDSname" SG_ 437857147 FS_HSMU_TEST21_26 "FDS_HSMU_TEST21_26";
BA_ "AfdxSignalType" SG_ 437857147 FS_HSMU_TEST21_26 "Enumerate";
BA_ "AfdxFSaddr" SG_ 437857147 IOM_A_34_VFG_OIL_TEMP21_A_55 128;
BA_ "AfdxFDSaddr" SG_ 437857147 IOM_A_34_VFG_OIL_TEMP21_A_55 128;
BA_ "AfdxFDSlength" SG_ 437857147 IOM_A_34_VFG_OIL_TEMP21_A_55 4;
BA_ "AfdxFDSname" SG_ 437857147 IOM_A_34_VFG_OIL_TEMP21_A_55 "FDS_HSMU_TEST21_25";
BA_ "AfdxSignalType" SG_ 437857147 IOM_A_34_VFG_OIL_TEMP21_A_55 "Integer";
BA_ "AfdxFSaddr" SG_ 437857147 FS_HSMU_TEST21_25 128;
BA_ "AfdxFDSaddr" SG_ 437857147 FS_HSMU_TEST21_25 128;
BA_ "AfdxFDSlength" SG_ 437857147 FS_HSMU_TEST21_25 4;
BA_ "AfdxFDSname" SG_ 437857147 FS_HSMU_TEST21_25 "FDS_HSMU_TEST21_25";
BA_ "AfdxSignalType" SG_ 437857147 FS_HSMU_TEST21_25 "Enumerate";
BA_ "AfdxFSaddr" SG_ 437857147 IOM_A_34_VFG_OIL_TEMP21_A_54 120;
BA_ "AfdxFDSaddr" SG_ 437857147 IOM_A_34_VFG_OIL_TEMP21_A_54 120;
BA_ "AfdxFDSlength" SG_ 437857147 IOM_A_34_VFG_OIL_TEMP21_A_54 4;
BA_ "AfdxFDSname" SG_ 437857147 IOM_A_34_VFG_OIL_TEMP21_A_54 "FDS_HSMU_TEST21_24";
BA_ "AfdxSignalType" SG_ 437857147 IOM_A_34_VFG_OIL_TEMP21_A_54 "Integer";
BA_ "AfdxFSaddr" SG_ 437857147 FS_HSMU_TEST21_24 120;
BA_ "AfdxFDSaddr" SG_ 437857147 FS_HSMU_TEST21_24 120;
BA_ "AfdxFDSlength" SG_ 437857147 FS_HSMU_TEST21_24 4;
BA_ "AfdxFDSname" SG_ 437857147 FS_HSMU_TEST21_24 "FDS_HSMU_TEST21_24";
BA_ "AfdxSignalType" SG_ 437857147 FS_HSMU_TEST21_24 "Enumerate";
BA_ "AfdxFSaddr" SG_ 437857147 IOM_A_34_VFG_OIL_TEMP21_A_53 116;
BA_ "AfdxFDSaddr" SG_ 437857147 IOM_A_34_VFG_OIL_TEMP21_A_53 116;
BA_ "AfdxFDSlength" SG_ 437857147 IOM_A_34_VFG_OIL_TEMP21_A_53 4;
BA_ "AfdxFDSname" SG_ 437857147 IOM_A_34_VFG_OIL_TEMP21_A_53 "FDS_HSMU_TEST21_23";
BA_ "AfdxSignalType" SG_ 437857147 IOM_A_34_VFG_OIL_TEMP21_A_53 "Integer";
BA_ "AfdxFSaddr" SG_ 437857147 FS_HSMU_TEST21_23 116;
BA_ "AfdxFDSaddr" SG_ 437857147 FS_HSMU_TEST21_23 116;
BA_ "AfdxFDSlength" SG_ 437857147 FS_HSMU_TEST21_23 4;
BA_ "AfdxFDSname" SG_ 437857147 FS_HSMU_TEST21_23 "FDS_HSMU_TEST21_23";
BA_ "AfdxSignalType" SG_ 437857147 FS_HSMU_TEST21_23 "Enumerate";
BA_ "AfdxFSaddr" SG_ 437857147 IOM_A_34_VFG_OIL_TEMP21_A_52 112;
BA_ "AfdxFDSaddr" SG_ 437857147 IOM_A_34_VFG_OIL_TEMP21_A_52 112;
BA_ "AfdxFDSlength" SG_ 437857147 IOM_A_34_VFG_OIL_TEMP21_A_52 4;
BA_ "AfdxFDSname" SG_ 437857147 IOM_A_34_VFG_OIL_TEMP21_A_52 "FDS_HSMU_TEST21_22";
BA_ "AfdxSignalType" SG_ 437857147 IOM_A_34_VFG_OIL_TEMP21_A_52 "Integer";
BA_ "AfdxFSaddr" SG_ 437857147 FS_HSMU_TEST21_22 112;
BA_ "AfdxFDSaddr" SG_ 437857147 FS_HSMU_TEST21_22 112;
BA_ "AfdxFDSlength" SG_ 437857147 FS_HSMU_TEST21_22 4;
BA_ "AfdxFDSname" SG_ 437857147 FS_HSMU_TEST21_22 "FDS_HSMU_TEST21_22";
BA_ "AfdxSignalType" SG_ 437857147 FS_HSMU_TEST21_22 "Enumerate";
BA_ "AfdxFSaddr" SG_ 437857147 IOM_A_34_VFG_OIL_TEMP21_A_51 108;
BA_ "AfdxFDSaddr" SG_ 437857147 IOM_A_34_VFG_OIL_TEMP21_A_51 108;
BA_ "AfdxFDSlength" SG_ 437857147 IOM_A_34_VFG_OIL_TEMP21_A_51 4;
BA_ "AfdxFDSname" SG_ 437857147 IOM_A_34_VFG_OIL_TEMP21_A_51 "FDS_HSMU_TEST21_21";
BA_ "AfdxSignalType" SG_ 437857147 IOM_A_34_VFG_OIL_TEMP21_A_51 "Integer";
BA_ "AfdxFSaddr" SG_ 437857147 FS_HSMU_TEST21_21 108;
BA_ "AfdxFDSaddr" SG_ 437857147 FS_HSMU_TEST21_21 108;
BA_ "AfdxFDSlength" SG_ 437857147 FS_HSMU_TEST21_21 4;
BA_ "AfdxFDSname" SG_ 437857147 FS_HSMU_TEST21_21 "FDS_HSMU_TEST21_21";
BA_ "AfdxSignalType" SG_ 437857147 FS_HSMU_TEST21_21 "Enumerate";
BA_ "AfdxFSaddr" SG_ 437857147 IOM_A_34_VFG_OIL_TEMP21_A_50 100;
BA_ "AfdxFDSaddr" SG_ 437857147 IOM_A_34_VFG_OIL_TEMP21_A_50 100;
BA_ "AfdxFDSlength" SG_ 437857147 IOM_A_34_VFG_OIL_TEMP21_A_50 4;
BA_ "AfdxFDSname" SG_ 437857147 IOM_A_34_VFG_OIL_TEMP21_A_50 "FDS_HSMU_TEST21_20";
BA_ "AfdxSignalType" SG_ 437857147 IOM_A_34_VFG_OIL_TEMP21_A_50 "Integer";
BA_ "AfdxFSaddr" SG_ 437857147 FS_HSMU_TEST21_20 100;
BA_ "AfdxFDSaddr" SG_ 437857147 FS_HSMU_TEST21_20 100;
BA_ "AfdxFDSlength" SG_ 437857147 FS_HSMU_TEST21_20 4;
BA_ "AfdxFDSname" SG_ 437857147 FS_HSMU_TEST21_20 "FDS_HSMU_TEST21_20";
BA_ "AfdxSignalType" SG_ 437857147 FS_HSMU_TEST21_20 "Enumerate";
BA_ "AfdxFSaddr" SG_ 437857147 IOM_A_34_VFG_OIL_TEMP21_A_49 96;
BA_ "AfdxFDSaddr" SG_ 437857147 IOM_A_34_VFG_OIL_TEMP21_A_49 96;
BA_ "AfdxFDSlength" SG_ 437857147 IOM_A_34_VFG_OIL_TEMP21_A_49 4;
BA_ "AfdxFDSname" SG_ 437857147 IOM_A_34_VFG_OIL_TEMP21_A_49 "FDS_HSMU_TEST21_19";
BA_ "AfdxSignalType" SG_ 437857147 IOM_A_34_VFG_OIL_TEMP21_A_49 "Integer";
BA_ "AfdxFSaddr" SG_ 437857147 FS_HSMU_TEST21_19 96;
BA_ "AfdxFDSaddr" SG_ 437857147 FS_HSMU_TEST21_19 96;
BA_ "AfdxFDSlength" SG_ 437857147 FS_HSMU_TEST21_19 4;
BA_ "AfdxFDSname" SG_ 437857147 FS_HSMU_TEST21_19 "FDS_HSMU_TEST21_19";
BA_ "AfdxSignalType" SG_ 437857147 FS_HSMU_TEST21_19 "Enumerate";
BA_ "AfdxFSaddr" SG_ 437857147 IOM_A_34_VFG_OIL_TEMP21_A_48 92;
BA_ "AfdxFDSaddr" SG_ 437857147 IOM_A_34_VFG_OIL_TEMP21_A_48 92;
BA_ "AfdxFDSlength" SG_ 437857147 IOM_A_34_VFG_OIL_TEMP21_A_48 4;
BA_ "AfdxFDSname" SG_ 437857147 IOM_A_34_VFG_OIL_TEMP21_A_48 "FDS_HSMU_TEST21_18";
BA_ "AfdxSignalType" SG_ 437857147 IOM_A_34_VFG_OIL_TEMP21_A_48 "Integer";
BA_ "AfdxFSaddr" SG_ 437857147 FS_HSMU_TEST21_18 92;
BA_ "AfdxFDSaddr" SG_ 437857147 FS_HSMU_TEST21_18 92;
BA_ "AfdxFDSlength" SG_ 437857147 FS_HSMU_TEST21_18 4;
BA_ "AfdxFDSname" SG_ 437857147 FS_HSMU_TEST21_18 "FDS_HSMU_TEST21_18";
BA_ "AfdxSignalType" SG_ 437857147 FS_HSMU_TEST21_18 "Enumerate";
BA_ "AfdxFSaddr" SG_ 437857147 IOM_A_34_VFG_OIL_TEMP21_A_47 88;
BA_ "AfdxFDSaddr" SG_ 437857147 IOM_A_34_VFG_OIL_TEMP21_A_47 88;
BA_ "AfdxFDSlength" SG_ 437857147 IOM_A_34_VFG_OIL_TEMP21_A_47 4;
BA_ "AfdxFDSname" SG_ 437857147 IOM_A_34_VFG_OIL_TEMP21_A_47 "FDS_HSMU_TEST21_17";
BA_ "AfdxSignalType" SG_ 437857147 IOM_A_34_VFG_OIL_TEMP21_A_47 "Integer";
BA_ "AfdxFSaddr" SG_ 437857147 FS_HSMU_TEST21_17 88;
BA_ "AfdxFDSaddr" SG_ 437857147 FS_HSMU_TEST21_17 88;
BA_ "AfdxFDSlength" SG_ 437857147 FS_HSMU_TEST21_17 4;
BA_ "AfdxFDSname" SG_ 437857147 FS_HSMU_TEST21_17 "FDS_HSMU_TEST21_17";
BA_ "AfdxSignalType" SG_ 437857147 FS_HSMU_TEST21_17 "Enumerate";
BA_ "AfdxFSaddr" SG_ 437857147 IOM_A_34_VFG_OIL_TEMP21_A_46 80;
BA_ "AfdxFDSaddr" SG_ 437857147 IOM_A_34_VFG_OIL_TEMP21_A_46 80;
BA_ "AfdxFDSlength" SG_ 437857147 IOM_A_34_VFG_OIL_TEMP21_A_46 4;
BA_ "AfdxFDSname" SG_ 437857147 IOM_A_34_VFG_OIL_TEMP21_A_46 "FDS_HSMU_TEST21_16";
BA_ "AfdxSignalType" SG_ 437857147 IOM_A_34_VFG_OIL_TEMP21_A_46 "Integer";
BA_ "AfdxFSaddr" SG_ 437857147 FS_HSMU_TEST21_16 80;
BA_ "AfdxFDSaddr" SG_ 437857147 FS_HSMU_TEST21_16 80;
BA_ "AfdxFDSlength" SG_ 437857147 FS_HSMU_TEST21_16 4;
BA_ "AfdxFDSname" SG_ 437857147 FS_HSMU_TEST21_16 "FDS_HSMU_TEST21_16";
BA_ "AfdxSignalType" SG_ 437857147 FS_HSMU_TEST21_16 "Enumerate";
BA_ "AfdxFSaddr" SG_ 437857147 IOM_A_34_VFG_OIL_TEMP21_A_45 76;
BA_ "AfdxFDSaddr" SG_ 437857147 IOM_A_34_VFG_OIL_TEMP21_A_45 76;
BA_ "AfdxFDSlength" SG_ 437857147 IOM_A_34_VFG_OIL_TEMP21_A_45 4;
BA_ "AfdxFDSname" SG_ 437857147 IOM_A_34_VFG_OIL_TEMP21_A_45 "FDS_HSMU_TEST21_15";
BA_ "AfdxSignalType" SG_ 437857147 IOM_A_34_VFG_OIL_TEMP21_A_45 "Integer";
BA_ "AfdxFSaddr" SG_ 437857147 FS_HSMU_TEST21_15 76;
BA_ "AfdxFDSaddr" SG_ 437857147 FS_HSMU_TEST21_15 76;
BA_ "AfdxFDSlength" SG_ 437857147 FS_HSMU_TEST21_15 4;
BA_ "AfdxFDSname" SG_ 437857147 FS_HSMU_TEST21_15 "FDS_HSMU_TEST21_15";
BA_ "AfdxSignalType" SG_ 437857147 FS_HSMU_TEST21_15 "Enumerate";
BA_ "AfdxFSaddr" SG_ 437857147 IOM_A_34_VFG_OIL_TEMP21_A_44 72;
BA_ "AfdxFDSaddr" SG_ 437857147 IOM_A_34_VFG_OIL_TEMP21_A_44 72;
BA_ "AfdxFDSlength" SG_ 437857147 IOM_A_34_VFG_OIL_TEMP21_A_44 4;
BA_ "AfdxFDSname" SG_ 437857147 IOM_A_34_VFG_OIL_TEMP21_A_44 "FDS_HSMU_TEST21_14";
BA_ "AfdxSignalType" SG_ 437857147 IOM_A_34_VFG_OIL_TEMP21_A_44 "Integer";
BA_ "AfdxFSaddr" SG_ 437857147 FS_HSMU_TEST21_14 72;
BA_ "AfdxFDSaddr" SG_ 437857147 FS_HSMU_TEST21_14 72;
BA_ "AfdxFDSlength" SG_ 437857147 FS_HSMU_TEST21_14 4;
BA_ "AfdxFDSname" SG_ 437857147 FS_HSMU_TEST21_14 "FDS_HSMU_TEST21_14";
BA_ "AfdxSignalType" SG_ 437857147 FS_HSMU_TEST21_14 "Enumerate";
BA_ "AfdxFSaddr" SG_ 437857147 IOM_A_34_VFG_OIL_TEMP21_A_43 68;
BA_ "AfdxFDSaddr" SG_ 437857147 IOM_A_34_VFG_OIL_TEMP21_A_43 68;
BA_ "AfdxFDSlength" SG_ 437857147 IOM_A_34_VFG_OIL_TEMP21_A_43 4;
BA_ "AfdxFDSname" SG_ 437857147 IOM_A_34_VFG_OIL_TEMP21_A_43 "FDS_HSMU_TEST21_13";
BA_ "AfdxSignalType" SG_ 437857147 IOM_A_34_VFG_OIL_TEMP21_A_43 "Integer";
BA_ "AfdxFSaddr" SG_ 437857147 FS_HSMU_TEST21_13 68;
BA_ "AfdxFDSaddr" SG_ 437857147 FS_HSMU_TEST21_13 68;
BA_ "AfdxFDSlength" SG_ 437857147 FS_HSMU_TEST21_13 4;
BA_ "AfdxFDSname" SG_ 437857147 FS_HSMU_TEST21_13 "FDS_HSMU_TEST21_13";
BA_ "AfdxSignalType" SG_ 437857147 FS_HSMU_TEST21_13 "Enumerate";
BA_ "AfdxFSaddr" SG_ 437857147 IOM_A_34_VFG_OIL_TEMP21_A_42 60;
BA_ "AfdxFDSaddr" SG_ 437857147 IOM_A_34_VFG_OIL_TEMP21_A_42 60;
BA_ "AfdxFDSlength" SG_ 437857147 IOM_A_34_VFG_OIL_TEMP21_A_42 4;
BA_ "AfdxFDSname" SG_ 437857147 IOM_A_34_VFG_OIL_TEMP21_A_42 "FDS_HSMU_TEST21_12";
BA_ "AfdxSignalType" SG_ 437857147 IOM_A_34_VFG_OIL_TEMP21_A_42 "Integer";
BA_ "AfdxFSaddr" SG_ 437857147 FS_HSMU_TEST21_12 60;
BA_ "AfdxFDSaddr" SG_ 437857147 FS_HSMU_TEST21_12 60;
BA_ "AfdxFDSlength" SG_ 437857147 FS_HSMU_TEST21_12 4;
BA_ "AfdxFDSname" SG_ 437857147 FS_HSMU_TEST21_12 "FDS_HSMU_TEST21_12";
BA_ "AfdxSignalType" SG_ 437857147 FS_HSMU_TEST21_12 "Enumerate";
BA_ "AfdxFSaddr" SG_ 437857147 IOM_A_34_VFG_OIL_TEMP21_A_41 56;
BA_ "AfdxFDSaddr" SG_ 437857147 IOM_A_34_VFG_OIL_TEMP21_A_41 56;
BA_ "AfdxFDSlength" SG_ 437857147 IOM_A_34_VFG_OIL_TEMP21_A_41 4;
BA_ "AfdxFDSname" SG_ 437857147 IOM_A_34_VFG_OIL_TEMP21_A_41 "FDS_HSMU_TEST21_11";
BA_ "AfdxSignalType" SG_ 437857147 IOM_A_34_VFG_OIL_TEMP21_A_41 "Integer";
BA_ "AfdxFSaddr" SG_ 437857147 FS_HSMU_TEST21_11 56;
BA_ "AfdxFDSaddr" SG_ 437857147 FS_HSMU_TEST21_11 56;
BA_ "AfdxFDSlength" SG_ 437857147 FS_HSMU_TEST21_11 4;
BA_ "AfdxFDSname" SG_ 437857147 FS_HSMU_TEST21_11 "FDS_HSMU_TEST21_11";
BA_ "AfdxSignalType" SG_ 437857147 FS_HSMU_TEST21_11 "Enumerate";
BA_ "AfdxFSaddr" SG_ 437857147 IOM_A_34_VFG_OIL_TEMP21_A_40 52;
BA_ "AfdxFDSaddr" SG_ 437857147 IOM_A_34_VFG_OIL_TEMP21_A_40 52;
BA_ "AfdxFDSlength" SG_ 437857147 IOM_A_34_VFG_OIL_TEMP21_A_40 4;
BA_ "AfdxFDSname" SG_ 437857147 IOM_A_34_VFG_OIL_TEMP21_A_40 "FDS_HSMU_TEST21_10";
BA_ "AfdxSignalType" SG_ 437857147 IOM_A_34_VFG_OIL_TEMP21_A_40 "Integer";
BA_ "AfdxFSaddr" SG_ 437857147 FS_HSMU_TEST21_10 52;
BA_ "AfdxFDSaddr" SG_ 437857147 FS_HSMU_TEST21_10 52;
BA_ "AfdxFDSlength" SG_ 437857147 FS_HSMU_TEST21_10 4;
BA_ "AfdxFDSname" SG_ 437857147 FS_HSMU_TEST21_10 "FDS_HSMU_TEST21_10";
BA_ "AfdxSignalType" SG_ 437857147 FS_HSMU_TEST21_10 "Enumerate";
BA_ "AfdxFSaddr" SG_ 437857147 IOM_A_34_VFG_OIL_TEMP21_A_39 48;
BA_ "AfdxFDSaddr" SG_ 437857147 IOM_A_34_VFG_OIL_TEMP21_A_39 48;
BA_ "AfdxFDSlength" SG_ 437857147 IOM_A_34_VFG_OIL_TEMP21_A_39 4;
BA_ "AfdxFDSname" SG_ 437857147 IOM_A_34_VFG_OIL_TEMP21_A_39 "FDS_HSMU_TEST21_9";
BA_ "AfdxSignalType" SG_ 437857147 IOM_A_34_VFG_OIL_TEMP21_A_39 "Integer";
BA_ "AfdxFSaddr" SG_ 437857147 FS_HSMU_TEST21_9 48;
BA_ "AfdxFDSaddr" SG_ 437857147 FS_HSMU_TEST21_9 48;
BA_ "AfdxFDSlength" SG_ 437857147 FS_HSMU_TEST21_9 4;
BA_ "AfdxFDSname" SG_ 437857147 FS_HSMU_TEST21_9 "FDS_HSMU_TEST21_9";
BA_ "AfdxSignalType" SG_ 437857147 FS_HSMU_TEST21_9 "Enumerate";
BA_ "AfdxFSaddr" SG_ 437857147 IOM_A_34_VFG_OIL_TEMP21_A_38 40;
BA_ "AfdxFDSaddr" SG_ 437857147 IOM_A_34_VFG_OIL_TEMP21_A_38 40;
BA_ "AfdxFDSlength" SG_ 437857147 IOM_A_34_VFG_OIL_TEMP21_A_38 4;
BA_ "AfdxFDSname" SG_ 437857147 IOM_A_34_VFG_OIL_TEMP21_A_38 "FDS_HSMU_TEST21_8";
BA_ "AfdxSignalType" SG_ 437857147 IOM_A_34_VFG_OIL_TEMP21_A_38 "Integer";
BA_ "AfdxFSaddr" SG_ 437857147 FS_HSMU_TEST21_8 40;
BA_ "AfdxFDSaddr" SG_ 437857147 FS_HSMU_TEST21_8 40;
BA_ "AfdxFDSlength" SG_ 437857147 FS_HSMU_TEST21_8 4;
BA_ "AfdxFDSname" SG_ 437857147 FS_HSMU_TEST21_8 "FDS_HSMU_TEST21_8";
BA_ "AfdxSignalType" SG_ 437857147 FS_HSMU_TEST21_8 "Enumerate";
BA_ "AfdxFSaddr" SG_ 437857147 IOM_A_34_VFG_OIL_TEMP21_A_37 36;
BA_ "AfdxFDSaddr" SG_ 437857147 IOM_A_34_VFG_OIL_TEMP21_A_37 36;
BA_ "AfdxFDSlength" SG_ 437857147 IOM_A_34_VFG_OIL_TEMP21_A_37 4;
BA_ "AfdxFDSname" SG_ 437857147 IOM_A_34_VFG_OIL_TEMP21_A_37 "FDS_HSMU_TEST21_7";
BA_ "AfdxSignalType" SG_ 437857147 IOM_A_34_VFG_OIL_TEMP21_A_37 "Integer";
BA_ "AfdxFSaddr" SG_ 437857147 FS_HSMU_TEST21_7 36;
BA_ "AfdxFDSaddr" SG_ 437857147 FS_HSMU_TEST21_7 36;
BA_ "AfdxFDSlength" SG_ 437857147 FS_HSMU_TEST21_7 4;
BA_ "AfdxFDSname" SG_ 437857147 FS_HSMU_TEST21_7 "FDS_HSMU_TEST21_7";
BA_ "AfdxSignalType" SG_ 437857147 FS_HSMU_TEST21_7 "Enumerate";
BA_ "AfdxFSaddr" SG_ 437857147 IOM_A_34_VFG_OIL_TEMP21_A_36 32;
BA_ "AfdxFDSaddr" SG_ 437857147 IOM_A_34_VFG_OIL_TEMP21_A_36 32;
BA_ "AfdxFDSlength" SG_ 437857147 IOM_A_34_VFG_OIL_TEMP21_A_36 4;
BA_ "AfdxFDSname" SG_ 437857147 IOM_A_34_VFG_OIL_TEMP21_A_36 "FDS_HSMU_TEST21_6";
BA_ "AfdxSignalType" SG_ 437857147 IOM_A_34_VFG_OIL_TEMP21_A_36 "Integer";
BA_ "AfdxFSaddr" SG_ 437857147 FS_HSMU_TEST21_6 32;
BA_ "AfdxFDSaddr" SG_ 437857147 FS_HSMU_TEST21_6 32;
BA_ "AfdxFDSlength" SG_ 437857147 FS_HSMU_TEST21_6 4;
BA_ "AfdxFDSname" SG_ 437857147 FS_HSMU_TEST21_6 "FDS_HSMU_TEST21_6";
BA_ "AfdxSignalType" SG_ 437857147 FS_HSMU_TEST21_6 "Enumerate";
BA_ "AfdxFSaddr" SG_ 437857147 IOM_A_34_VFG_OIL_TEMP21_A_35 28;
BA_ "AfdxFDSaddr" SG_ 437857147 IOM_A_34_VFG_OIL_TEMP21_A_35 28;
BA_ "AfdxFDSlength" SG_ 437857147 IOM_A_34_VFG_OIL_TEMP21_A_35 4;
BA_ "AfdxFDSname" SG_ 437857147 IOM_A_34_VFG_OIL_TEMP21_A_35 "FDS_HSMU_TEST21_5";
BA_ "AfdxSignalType" SG_ 437857147 IOM_A_34_VFG_OIL_TEMP21_A_35 "Integer";
BA_ "AfdxFSaddr" SG_ 437857147 FS_HSMU_TEST21_5 28;
BA_ "AfdxFDSaddr" SG_ 437857147 FS_HSMU_TEST21_5 28;
BA_ "AfdxFDSlength" SG_ 437857147 FS_HSMU_TEST21_5 4;
BA_ "AfdxFDSname" SG_ 437857147 FS_HSMU_TEST21_5 "FDS_HSMU_TEST21_5";
BA_ "AfdxSignalType" SG_ 437857147 FS_HSMU_TEST21_5 "Enumerate";
BA_ "AfdxFSaddr" SG_ 437857147 IOM_A_34_VFG_OIL_TEMP21_A_34 20;
BA_ "AfdxFDSaddr" SG_ 437857147 IOM_A_34_VFG_OIL_TEMP21_A_34 20;
BA_ "AfdxFDSlength" SG_ 437857147 IOM_A_34_VFG_OIL_TEMP21_A_34 4;
BA_ "AfdxFDSname" SG_ 437857147 IOM_A_34_VFG_OIL_TEMP21_A_34 "FDS_HSMU_TEST21_4";
BA_ "AfdxSignalType" SG_ 437857147 IOM_A_34_VFG_OIL_TEMP21_A_34 "Integer";
BA_ "AfdxFSaddr" SG_ 437857147 FS_HSMU_TEST21_4 20;
BA_ "AfdxFDSaddr" SG_ 437857147 FS_HSMU_TEST21_4 20;
BA_ "AfdxFDSlength" SG_ 437857147 FS_HSMU_TEST21_4 4;
BA_ "AfdxFDSname" SG_ 437857147 FS_HSMU_TEST21_4 "FDS_HSMU_TEST21_4";
BA_ "AfdxSignalType" SG_ 437857147 FS_HSMU_TEST21_4 "Enumerate";
BA_ "AfdxFSaddr" SG_ 437857147 IOM_A_34_VFG_OIL_TEMP21_A_33 16;
BA_ "AfdxFDSaddr" SG_ 437857147 IOM_A_34_VFG_OIL_TEMP21_A_33 16;
BA_ "AfdxFDSlength" SG_ 437857147 IOM_A_34_VFG_OIL_TEMP21_A_33 4;
BA_ "AfdxFDSname" SG_ 437857147 IOM_A_34_VFG_OIL_TEMP21_A_33 "FDS_HSMU_TEST21_3";
BA_ "AfdxSignalType" SG_ 437857147 IOM_A_34_VFG_OIL_TEMP21_A_33 "Integer";
BA_ "AfdxFSaddr" SG_ 437857147 FS_HSMU_TEST21_3 16;
BA_ "AfdxFDSaddr" SG_ 437857147 FS_HSMU_TEST21_3 16;
BA_ "AfdxFDSlength" SG_ 437857147 FS_HSMU_TEST21_3 4;
BA_ "AfdxFDSname" SG_ 437857147 FS_HSMU_TEST21_3 "FDS_HSMU_TEST21_3";
BA_ "AfdxSignalType" SG_ 437857147 FS_HSMU_TEST21_3 "Enumerate";
BA_ "AfdxFSaddr" SG_ 437857147 IOM_A_34_VFG_OIL_TEMP21_A_32 12;
BA_ "AfdxFDSaddr" SG_ 437857147 IOM_A_34_VFG_OIL_TEMP21_A_32 12;
BA_ "AfdxFDSlength" SG_ 437857147 IOM_A_34_VFG_OIL_TEMP21_A_32 4;
BA_ "AfdxFDSname" SG_ 437857147 IOM_A_34_VFG_OIL_TEMP21_A_32 "FDS_HSMU_TEST21_2";
BA_ "AfdxSignalType" SG_ 437857147 IOM_A_34_VFG_OIL_TEMP21_A_32 "Integer";
BA_ "AfdxFSaddr" SG_ 437857147 FS_HSMU_TEST21_2 12;
BA_ "AfdxFDSaddr" SG_ 437857147 FS_HSMU_TEST21_2 12;
BA_ "AfdxFDSlength" SG_ 437857147 FS_HSMU_TEST21_2 4;
BA_ "AfdxFDSname" SG_ 437857147 FS_HSMU_TEST21_2 "FDS_HSMU_TEST21_2";
BA_ "AfdxSignalType" SG_ 437857147 FS_HSMU_TEST21_2 "Enumerate";
BA_ "AfdxFSaddr" SG_ 437857147 IOM_A_34_VFG_OIL_TEMP21_A_31 8;
BA_ "AfdxFDSaddr" SG_ 437857147 IOM_A_34_VFG_OIL_TEMP21_A_31 8;
BA_ "AfdxFDSlength" SG_ 437857147 IOM_A_34_VFG_OIL_TEMP21_A_31 4;
BA_ "AfdxFDSname" SG_ 437857147 IOM_A_34_VFG_OIL_TEMP21_A_31 "FDS_HSMU_TEST21_1";
BA_ "AfdxSignalType" SG_ 437857147 IOM_A_34_VFG_OIL_TEMP21_A_31 "Integer";
BA_ "AfdxFSaddr" SG_ 437857147 FS_HSMU_TEST21_1 8;
BA_ "AfdxFDSaddr" SG_ 437857147 FS_HSMU_TEST21_1 8;
BA_ "AfdxFDSlength" SG_ 437857147 FS_HSMU_TEST21_1 4;
BA_ "AfdxFDSname" SG_ 437857147 FS_HSMU_TEST21_1 "FDS_HSMU_TEST21_1";
BA_ "AfdxSignalType" SG_ 437857147 FS_HSMU_TEST21_1 "Enumerate";
BA_ "AfdxFSaddr" SG_ 437791610 IOM_A_34_VFG_OIL_TEMP20_A_130 500;
BA_ "AfdxFDSaddr" SG_ 437791610 IOM_A_34_VFG_OIL_TEMP20_A_130 500;
BA_ "AfdxFDSlength" SG_ 437791610 IOM_A_34_VFG_OIL_TEMP20_A_130 4;
BA_ "AfdxFDSname" SG_ 437791610 IOM_A_34_VFG_OIL_TEMP20_A_130 "FDS_HSMU_TEST20_100";
BA_ "AfdxSignalType" SG_ 437791610 IOM_A_34_VFG_OIL_TEMP20_A_130 "Integer";
BA_ "AfdxFSaddr" SG_ 437791610 FS_HSMU_TEST20_100 500;
BA_ "AfdxFDSaddr" SG_ 437791610 FS_HSMU_TEST20_100 500;
BA_ "AfdxFDSlength" SG_ 437791610 FS_HSMU_TEST20_100 4;
BA_ "AfdxFDSname" SG_ 437791610 FS_HSMU_TEST20_100 "FDS_HSMU_TEST20_100";
BA_ "AfdxSignalType" SG_ 437791610 FS_HSMU_TEST20_100 "Enumerate";
BA_ "AfdxFSaddr" SG_ 437791610 IOM_A_34_VFG_OIL_TEMP20_A_129 496;
BA_ "AfdxFDSaddr" SG_ 437791610 IOM_A_34_VFG_OIL_TEMP20_A_129 496;
BA_ "AfdxFDSlength" SG_ 437791610 IOM_A_34_VFG_OIL_TEMP20_A_129 4;
BA_ "AfdxFDSname" SG_ 437791610 IOM_A_34_VFG_OIL_TEMP20_A_129 "FDS_HSMU_TEST20_99";
BA_ "AfdxSignalType" SG_ 437791610 IOM_A_34_VFG_OIL_TEMP20_A_129 "Integer";
BA_ "AfdxFSaddr" SG_ 437791610 FS_HSMU_TEST20_99 496;
BA_ "AfdxFDSaddr" SG_ 437791610 FS_HSMU_TEST20_99 496;
BA_ "AfdxFDSlength" SG_ 437791610 FS_HSMU_TEST20_99 4;
BA_ "AfdxFDSname" SG_ 437791610 FS_HSMU_TEST20_99 "FDS_HSMU_TEST20_99";
BA_ "AfdxSignalType" SG_ 437791610 FS_HSMU_TEST20_99 "Enumerate";
BA_ "AfdxFSaddr" SG_ 437791610 IOM_A_34_VFG_OIL_TEMP20_A_128 492;
BA_ "AfdxFDSaddr" SG_ 437791610 IOM_A_34_VFG_OIL_TEMP20_A_128 492;
BA_ "AfdxFDSlength" SG_ 437791610 IOM_A_34_VFG_OIL_TEMP20_A_128 4;
BA_ "AfdxFDSname" SG_ 437791610 IOM_A_34_VFG_OIL_TEMP20_A_128 "FDS_HSMU_TEST20_98";
BA_ "AfdxSignalType" SG_ 437791610 IOM_A_34_VFG_OIL_TEMP20_A_128 "Integer";
BA_ "AfdxFSaddr" SG_ 437791610 FS_HSMU_TEST20_98 492;
BA_ "AfdxFDSaddr" SG_ 437791610 FS_HSMU_TEST20_98 492;
BA_ "AfdxFDSlength" SG_ 437791610 FS_HSMU_TEST20_98 4;
BA_ "AfdxFDSname" SG_ 437791610 FS_HSMU_TEST20_98 "FDS_HSMU_TEST20_98";
BA_ "AfdxSignalType" SG_ 437791610 FS_HSMU_TEST20_98 "Enumerate";
BA_ "AfdxFSaddr" SG_ 437791610 IOM_A_34_VFG_OIL_TEMP20_A_127 488;
BA_ "AfdxFDSaddr" SG_ 437791610 IOM_A_34_VFG_OIL_TEMP20_A_127 488;
BA_ "AfdxFDSlength" SG_ 437791610 IOM_A_34_VFG_OIL_TEMP20_A_127 4;
BA_ "AfdxFDSname" SG_ 437791610 IOM_A_34_VFG_OIL_TEMP20_A_127 "FDS_HSMU_TEST20_97";
BA_ "AfdxSignalType" SG_ 437791610 IOM_A_34_VFG_OIL_TEMP20_A_127 "Integer";
BA_ "AfdxFSaddr" SG_ 437791610 FS_HSMU_TEST20_97 488;
BA_ "AfdxFDSaddr" SG_ 437791610 FS_HSMU_TEST20_97 488;
BA_ "AfdxFDSlength" SG_ 437791610 FS_HSMU_TEST20_97 4;
BA_ "AfdxFDSname" SG_ 437791610 FS_HSMU_TEST20_97 "FDS_HSMU_TEST20_97";
BA_ "AfdxSignalType" SG_ 437791610 FS_HSMU_TEST20_97 "Enumerate";
BA_ "AfdxFSaddr" SG_ 437791610 IOM_A_34_VFG_OIL_TEMP20_A_126 480;
BA_ "AfdxFDSaddr" SG_ 437791610 IOM_A_34_VFG_OIL_TEMP20_A_126 480;
BA_ "AfdxFDSlength" SG_ 437791610 IOM_A_34_VFG_OIL_TEMP20_A_126 4;
BA_ "AfdxFDSname" SG_ 437791610 IOM_A_34_VFG_OIL_TEMP20_A_126 "FDS_HSMU_TEST20_96";
BA_ "AfdxSignalType" SG_ 437791610 IOM_A_34_VFG_OIL_TEMP20_A_126 "Integer";
BA_ "AfdxFSaddr" SG_ 437791610 FS_HSMU_TEST20_96 480;
BA_ "AfdxFDSaddr" SG_ 437791610 FS_HSMU_TEST20_96 480;
BA_ "AfdxFDSlength" SG_ 437791610 FS_HSMU_TEST20_96 4;
BA_ "AfdxFDSname" SG_ 437791610 FS_HSMU_TEST20_96 "FDS_HSMU_TEST20_96";
BA_ "AfdxSignalType" SG_ 437791610 FS_HSMU_TEST20_96 "Enumerate";
BA_ "AfdxFSaddr" SG_ 437791610 IOM_A_34_VFG_OIL_TEMP20_A_125 476;
BA_ "AfdxFDSaddr" SG_ 437791610 IOM_A_34_VFG_OIL_TEMP20_A_125 476;
BA_ "AfdxFDSlength" SG_ 437791610 IOM_A_34_VFG_OIL_TEMP20_A_125 4;
BA_ "AfdxFDSname" SG_ 437791610 IOM_A_34_VFG_OIL_TEMP20_A_125 "FDS_HSMU_TEST20_95";
BA_ "AfdxSignalType" SG_ 437791610 IOM_A_34_VFG_OIL_TEMP20_A_125 "Integer";
BA_ "AfdxFSaddr" SG_ 437791610 FS_HSMU_TEST20_95 476;
BA_ "AfdxFDSaddr" SG_ 437791610 FS_HSMU_TEST20_95 476;
BA_ "AfdxFDSlength" SG_ 437791610 FS_HSMU_TEST20_95 4;
BA_ "AfdxFDSname" SG_ 437791610 FS_HSMU_TEST20_95 "FDS_HSMU_TEST20_95";
BA_ "AfdxSignalType" SG_ 437791610 FS_HSMU_TEST20_95 "Enumerate";
BA_ "AfdxFSaddr" SG_ 437791610 IOM_A_34_VFG_OIL_TEMP20_A_124 472;
BA_ "AfdxFDSaddr" SG_ 437791610 IOM_A_34_VFG_OIL_TEMP20_A_124 472;
BA_ "AfdxFDSlength" SG_ 437791610 IOM_A_34_VFG_OIL_TEMP20_A_124 4;
BA_ "AfdxFDSname" SG_ 437791610 IOM_A_34_VFG_OIL_TEMP20_A_124 "FDS_HSMU_TEST20_94";
BA_ "AfdxSignalType" SG_ 437791610 IOM_A_34_VFG_OIL_TEMP20_A_124 "Integer";
BA_ "AfdxFSaddr" SG_ 437791610 FS_HSMU_TEST20_94 472;
BA_ "AfdxFDSaddr" SG_ 437791610 FS_HSMU_TEST20_94 472;
BA_ "AfdxFDSlength" SG_ 437791610 FS_HSMU_TEST20_94 4;
BA_ "AfdxFDSname" SG_ 437791610 FS_HSMU_TEST20_94 "FDS_HSMU_TEST20_94";
BA_ "AfdxSignalType" SG_ 437791610 FS_HSMU_TEST20_94 "Enumerate";
BA_ "AfdxFSaddr" SG_ 437791610 IOM_A_34_VFG_OIL_TEMP20_A_123 468;
BA_ "AfdxFDSaddr" SG_ 437791610 IOM_A_34_VFG_OIL_TEMP20_A_123 468;
BA_ "AfdxFDSlength" SG_ 437791610 IOM_A_34_VFG_OIL_TEMP20_A_123 4;
BA_ "AfdxFDSname" SG_ 437791610 IOM_A_34_VFG_OIL_TEMP20_A_123 "FDS_HSMU_TEST20_93";
BA_ "AfdxSignalType" SG_ 437791610 IOM_A_34_VFG_OIL_TEMP20_A_123 "Integer";
BA_ "AfdxFSaddr" SG_ 437791610 FS_HSMU_TEST20_93 468;
BA_ "AfdxFDSaddr" SG_ 437791610 FS_HSMU_TEST20_93 468;
BA_ "AfdxFDSlength" SG_ 437791610 FS_HSMU_TEST20_93 4;
BA_ "AfdxFDSname" SG_ 437791610 FS_HSMU_TEST20_93 "FDS_HSMU_TEST20_93";
BA_ "AfdxSignalType" SG_ 437791610 FS_HSMU_TEST20_93 "Enumerate";
BA_ "AfdxFSaddr" SG_ 437791610 IOM_A_34_VFG_OIL_TEMP20_A_122 460;
BA_ "AfdxFDSaddr" SG_ 437791610 IOM_A_34_VFG_OIL_TEMP20_A_122 460;
BA_ "AfdxFDSlength" SG_ 437791610 IOM_A_34_VFG_OIL_TEMP20_A_122 4;
BA_ "AfdxFDSname" SG_ 437791610 IOM_A_34_VFG_OIL_TEMP20_A_122 "FDS_HSMU_TEST20_92";
BA_ "AfdxSignalType" SG_ 437791610 IOM_A_34_VFG_OIL_TEMP20_A_122 "Integer";
BA_ "AfdxFSaddr" SG_ 437791610 FS_HSMU_TEST20_92 460;
BA_ "AfdxFDSaddr" SG_ 437791610 FS_HSMU_TEST20_92 460;
BA_ "AfdxFDSlength" SG_ 437791610 FS_HSMU_TEST20_92 4;
BA_ "AfdxFDSname" SG_ 437791610 FS_HSMU_TEST20_92 "FDS_HSMU_TEST20_92";
BA_ "AfdxSignalType" SG_ 437791610 FS_HSMU_TEST20_92 "Enumerate";
BA_ "AfdxFSaddr" SG_ 437791610 IOM_A_34_VFG_OIL_TEMP20_A_121 456;
BA_ "AfdxFDSaddr" SG_ 437791610 IOM_A_34_VFG_OIL_TEMP20_A_121 456;
BA_ "AfdxFDSlength" SG_ 437791610 IOM_A_34_VFG_OIL_TEMP20_A_121 4;
BA_ "AfdxFDSname" SG_ 437791610 IOM_A_34_VFG_OIL_TEMP20_A_121 "FDS_HSMU_TEST20_91";
BA_ "AfdxSignalType" SG_ 437791610 IOM_A_34_VFG_OIL_TEMP20_A_121 "Integer";
BA_ "AfdxFSaddr" SG_ 437791610 FS_HSMU_TEST20_91 456;
BA_ "AfdxFDSaddr" SG_ 437791610 FS_HSMU_TEST20_91 456;
BA_ "AfdxFDSlength" SG_ 437791610 FS_HSMU_TEST20_91 4;
BA_ "AfdxFDSname" SG_ 437791610 FS_HSMU_TEST20_91 "FDS_HSMU_TEST20_91";
BA_ "AfdxSignalType" SG_ 437791610 FS_HSMU_TEST20_91 "Enumerate";
BA_ "AfdxFSaddr" SG_ 437791610 IOM_A_34_VFG_OIL_TEMP20_A_120 452;
BA_ "AfdxFDSaddr" SG_ 437791610 IOM_A_34_VFG_OIL_TEMP20_A_120 452;
BA_ "AfdxFDSlength" SG_ 437791610 IOM_A_34_VFG_OIL_TEMP20_A_120 4;
BA_ "AfdxFDSname" SG_ 437791610 IOM_A_34_VFG_OIL_TEMP20_A_120 "FDS_HSMU_TEST20_90";
BA_ "AfdxSignalType" SG_ 437791610 IOM_A_34_VFG_OIL_TEMP20_A_120 "Integer";
BA_ "AfdxFSaddr" SG_ 437791610 FS_HSMU_TEST20_90 452;
BA_ "AfdxFDSaddr" SG_ 437791610 FS_HSMU_TEST20_90 452;
BA_ "AfdxFDSlength" SG_ 437791610 FS_HSMU_TEST20_90 4;
BA_ "AfdxFDSname" SG_ 437791610 FS_HSMU_TEST20_90 "FDS_HSMU_TEST20_90";
BA_ "AfdxSignalType" SG_ 437791610 FS_HSMU_TEST20_90 "Enumerate";
BA_ "AfdxFSaddr" SG_ 437791610 IOM_A_34_VFG_OIL_TEMP20_A_119 448;
BA_ "AfdxFDSaddr" SG_ 437791610 IOM_A_34_VFG_OIL_TEMP20_A_119 448;
BA_ "AfdxFDSlength" SG_ 437791610 IOM_A_34_VFG_OIL_TEMP20_A_119 4;
BA_ "AfdxFDSname" SG_ 437791610 IOM_A_34_VFG_OIL_TEMP20_A_119 "FDS_HSMU_TEST20_89";
BA_ "AfdxSignalType" SG_ 437791610 IOM_A_34_VFG_OIL_TEMP20_A_119 "Integer";
BA_ "AfdxFSaddr" SG_ 437791610 FS_HSMU_TEST20_89 448;
BA_ "AfdxFDSaddr" SG_ 437791610 FS_HSMU_TEST20_89 448;
BA_ "AfdxFDSlength" SG_ 437791610 FS_HSMU_TEST20_89 4;
BA_ "AfdxFDSname" SG_ 437791610 FS_HSMU_TEST20_89 "FDS_HSMU_TEST20_89";
BA_ "AfdxSignalType" SG_ 437791610 FS_HSMU_TEST20_89 "Enumerate";
BA_ "AfdxFSaddr" SG_ 437791610 IOM_A_34_VFG_OIL_TEMP20_A_118 440;
BA_ "AfdxFDSaddr" SG_ 437791610 IOM_A_34_VFG_OIL_TEMP20_A_118 440;
BA_ "AfdxFDSlength" SG_ 437791610 IOM_A_34_VFG_OIL_TEMP20_A_118 4;
BA_ "AfdxFDSname" SG_ 437791610 IOM_A_34_VFG_OIL_TEMP20_A_118 "FDS_HSMU_TEST20_88";
BA_ "AfdxSignalType" SG_ 437791610 IOM_A_34_VFG_OIL_TEMP20_A_118 "Integer";
BA_ "AfdxFSaddr" SG_ 437791610 FS_HSMU_TEST20_88 440;
BA_ "AfdxFDSaddr" SG_ 437791610 FS_HSMU_TEST20_88 440;
BA_ "AfdxFDSlength" SG_ 437791610 FS_HSMU_TEST20_88 4;
BA_ "AfdxFDSname" SG_ 437791610 FS_HSMU_TEST20_88 "FDS_HSMU_TEST20_88";
BA_ "AfdxSignalType" SG_ 437791610 FS_HSMU_TEST20_88 "Enumerate";
BA_ "AfdxFSaddr" SG_ 437791610 IOM_A_34_VFG_OIL_TEMP20_A_117 436;
BA_ "AfdxFDSaddr" SG_ 437791610 IOM_A_34_VFG_OIL_TEMP20_A_117 436;
BA_ "AfdxFDSlength" SG_ 437791610 IOM_A_34_VFG_OIL_TEMP20_A_117 4;
BA_ "AfdxFDSname" SG_ 437791610 IOM_A_34_VFG_OIL_TEMP20_A_117 "FDS_HSMU_TEST20_87";
BA_ "AfdxSignalType" SG_ 437791610 IOM_A_34_VFG_OIL_TEMP20_A_117 "Integer";
BA_ "AfdxFSaddr" SG_ 437791610 FS_HSMU_TEST20_87 436;
BA_ "AfdxFDSaddr" SG_ 437791610 FS_HSMU_TEST20_87 436;
BA_ "AfdxFDSlength" SG_ 437791610 FS_HSMU_TEST20_87 4;
BA_ "AfdxFDSname" SG_ 437791610 FS_HSMU_TEST20_87 "FDS_HSMU_TEST20_87";
BA_ "AfdxSignalType" SG_ 437791610 FS_HSMU_TEST20_87 "Enumerate";
BA_ "AfdxFSaddr" SG_ 437791610 IOM_A_34_VFG_OIL_TEMP20_A_116 432;
BA_ "AfdxFDSaddr" SG_ 437791610 IOM_A_34_VFG_OIL_TEMP20_A_116 432;
BA_ "AfdxFDSlength" SG_ 437791610 IOM_A_34_VFG_OIL_TEMP20_A_116 4;
BA_ "AfdxFDSname" SG_ 437791610 IOM_A_34_VFG_OIL_TEMP20_A_116 "FDS_HSMU_TEST20_86";
BA_ "AfdxSignalType" SG_ 437791610 IOM_A_34_VFG_OIL_TEMP20_A_116 "Integer";
BA_ "AfdxFSaddr" SG_ 437791610 FS_HSMU_TEST20_86 432;
BA_ "AfdxFDSaddr" SG_ 437791610 FS_HSMU_TEST20_86 432;
BA_ "AfdxFDSlength" SG_ 437791610 FS_HSMU_TEST20_86 4;
BA_ "AfdxFDSname" SG_ 437791610 FS_HSMU_TEST20_86 "FDS_HSMU_TEST20_86";
BA_ "AfdxSignalType" SG_ 437791610 FS_HSMU_TEST20_86 "Enumerate";
BA_ "AfdxFSaddr" SG_ 437791610 IOM_A_34_VFG_OIL_TEMP20_A_115 428;
BA_ "AfdxFDSaddr" SG_ 437791610 IOM_A_34_VFG_OIL_TEMP20_A_115 428;
BA_ "AfdxFDSlength" SG_ 437791610 IOM_A_34_VFG_OIL_TEMP20_A_115 4;
BA_ "AfdxFDSname" SG_ 437791610 IOM_A_34_VFG_OIL_TEMP20_A_115 "FDS_HSMU_TEST20_85";
BA_ "AfdxSignalType" SG_ 437791610 IOM_A_34_VFG_OIL_TEMP20_A_115 "Integer";
BA_ "AfdxFSaddr" SG_ 437791610 FS_HSMU_TEST20_85 428;
BA_ "AfdxFDSaddr" SG_ 437791610 FS_HSMU_TEST20_85 428;
BA_ "AfdxFDSlength" SG_ 437791610 FS_HSMU_TEST20_85 4;
BA_ "AfdxFDSname" SG_ 437791610 FS_HSMU_TEST20_85 "FDS_HSMU_TEST20_85";
BA_ "AfdxSignalType" SG_ 437791610 FS_HSMU_TEST20_85 "Enumerate";
BA_ "AfdxFSaddr" SG_ 437791610 IOM_A_34_VFG_OIL_TEMP20_A_114 420;
BA_ "AfdxFDSaddr" SG_ 437791610 IOM_A_34_VFG_OIL_TEMP20_A_114 420;
BA_ "AfdxFDSlength" SG_ 437791610 IOM_A_34_VFG_OIL_TEMP20_A_114 4;
BA_ "AfdxFDSname" SG_ 437791610 IOM_A_34_VFG_OIL_TEMP20_A_114 "FDS_HSMU_TEST20_84";
BA_ "AfdxSignalType" SG_ 437791610 IOM_A_34_VFG_OIL_TEMP20_A_114 "Integer";
BA_ "AfdxFSaddr" SG_ 437791610 FS_HSMU_TEST20_84 420;
BA_ "AfdxFDSaddr" SG_ 437791610 FS_HSMU_TEST20_84 420;
BA_ "AfdxFDSlength" SG_ 437791610 FS_HSMU_TEST20_84 4;
BA_ "AfdxFDSname" SG_ 437791610 FS_HSMU_TEST20_84 "FDS_HSMU_TEST20_84";
BA_ "AfdxSignalType" SG_ 437791610 FS_HSMU_TEST20_84 "Enumerate";
BA_ "AfdxFSaddr" SG_ 437791610 IOM_A_34_VFG_OIL_TEMP20_A_113 416;
BA_ "AfdxFDSaddr" SG_ 437791610 IOM_A_34_VFG_OIL_TEMP20_A_113 416;
BA_ "AfdxFDSlength" SG_ 437791610 IOM_A_34_VFG_OIL_TEMP20_A_113 4;
BA_ "AfdxFDSname" SG_ 437791610 IOM_A_34_VFG_OIL_TEMP20_A_113 "FDS_HSMU_TEST20_83";
BA_ "AfdxSignalType" SG_ 437791610 IOM_A_34_VFG_OIL_TEMP20_A_113 "Integer";
BA_ "AfdxFSaddr" SG_ 437791610 FS_HSMU_TEST20_83 416;
BA_ "AfdxFDSaddr" SG_ 437791610 FS_HSMU_TEST20_83 416;
BA_ "AfdxFDSlength" SG_ 437791610 FS_HSMU_TEST20_83 4;
BA_ "AfdxFDSname" SG_ 437791610 FS_HSMU_TEST20_83 "FDS_HSMU_TEST20_83";
BA_ "AfdxSignalType" SG_ 437791610 FS_HSMU_TEST20_83 "Enumerate";
BA_ "AfdxFSaddr" SG_ 437791610 IOM_A_34_VFG_OIL_TEMP20_A_112 412;
BA_ "AfdxFDSaddr" SG_ 437791610 IOM_A_34_VFG_OIL_TEMP20_A_112 412;
BA_ "AfdxFDSlength" SG_ 437791610 IOM_A_34_VFG_OIL_TEMP20_A_112 4;
BA_ "AfdxFDSname" SG_ 437791610 IOM_A_34_VFG_OIL_TEMP20_A_112 "FDS_HSMU_TEST20_82";
BA_ "AfdxSignalType" SG_ 437791610 IOM_A_34_VFG_OIL_TEMP20_A_112 "Integer";
BA_ "AfdxFSaddr" SG_ 437791610 FS_HSMU_TEST20_82 412;
BA_ "AfdxFDSaddr" SG_ 437791610 FS_HSMU_TEST20_82 412;
BA_ "AfdxFDSlength" SG_ 437791610 FS_HSMU_TEST20_82 4;
BA_ "AfdxFDSname" SG_ 437791610 FS_HSMU_TEST20_82 "FDS_HSMU_TEST20_82";
BA_ "AfdxSignalType" SG_ 437791610 FS_HSMU_TEST20_82 "Enumerate";
BA_ "AfdxFSaddr" SG_ 437791610 IOM_A_34_VFG_OIL_TEMP20_A_111 408;
BA_ "AfdxFDSaddr" SG_ 437791610 IOM_A_34_VFG_OIL_TEMP20_A_111 408;
BA_ "AfdxFDSlength" SG_ 437791610 IOM_A_34_VFG_OIL_TEMP20_A_111 4;
BA_ "AfdxFDSname" SG_ 437791610 IOM_A_34_VFG_OIL_TEMP20_A_111 "FDS_HSMU_TEST20_81";
BA_ "AfdxSignalType" SG_ 437791610 IOM_A_34_VFG_OIL_TEMP20_A_111 "Integer";
BA_ "AfdxFSaddr" SG_ 437791610 FS_HSMU_TEST20_81 408;
BA_ "AfdxFDSaddr" SG_ 437791610 FS_HSMU_TEST20_81 408;
BA_ "AfdxFDSlength" SG_ 437791610 FS_HSMU_TEST20_81 4;
BA_ "AfdxFDSname" SG_ 437791610 FS_HSMU_TEST20_81 "FDS_HSMU_TEST20_81";
BA_ "AfdxSignalType" SG_ 437791610 FS_HSMU_TEST20_81 "Enumerate";
BA_ "AfdxFSaddr" SG_ 437791610 IOM_A_34_VFG_OIL_TEMP20_A_110 400;
BA_ "AfdxFDSaddr" SG_ 437791610 IOM_A_34_VFG_OIL_TEMP20_A_110 400;
BA_ "AfdxFDSlength" SG_ 437791610 IOM_A_34_VFG_OIL_TEMP20_A_110 4;
BA_ "AfdxFDSname" SG_ 437791610 IOM_A_34_VFG_OIL_TEMP20_A_110 "FDS_HSMU_TEST20_80";
BA_ "AfdxSignalType" SG_ 437791610 IOM_A_34_VFG_OIL_TEMP20_A_110 "Integer";
BA_ "AfdxFSaddr" SG_ 437791610 FS_HSMU_TEST20_80 400;
BA_ "AfdxFDSaddr" SG_ 437791610 FS_HSMU_TEST20_80 400;
BA_ "AfdxFDSlength" SG_ 437791610 FS_HSMU_TEST20_80 4;
BA_ "AfdxFDSname" SG_ 437791610 FS_HSMU_TEST20_80 "FDS_HSMU_TEST20_80";
BA_ "AfdxSignalType" SG_ 437791610 FS_HSMU_TEST20_80 "Enumerate";
BA_ "AfdxFSaddr" SG_ 437791610 IOM_A_34_VFG_OIL_TEMP20_A_109 396;
BA_ "AfdxFDSaddr" SG_ 437791610 IOM_A_34_VFG_OIL_TEMP20_A_109 396;
BA_ "AfdxFDSlength" SG_ 437791610 IOM_A_34_VFG_OIL_TEMP20_A_109 4;
BA_ "AfdxFDSname" SG_ 437791610 IOM_A_34_VFG_OIL_TEMP20_A_109 "FDS_HSMU_TEST20_79";
BA_ "AfdxSignalType" SG_ 437791610 IOM_A_34_VFG_OIL_TEMP20_A_109 "Integer";
BA_ "AfdxFSaddr" SG_ 437791610 FS_HSMU_TEST20_79 396;
BA_ "AfdxFDSaddr" SG_ 437791610 FS_HSMU_TEST20_79 396;
BA_ "AfdxFDSlength" SG_ 437791610 FS_HSMU_TEST20_79 4;
BA_ "AfdxFDSname" SG_ 437791610 FS_HSMU_TEST20_79 "FDS_HSMU_TEST20_79";
BA_ "AfdxSignalType" SG_ 437791610 FS_HSMU_TEST20_79 "Enumerate";
BA_ "AfdxFSaddr" SG_ 437791610 IOM_A_34_VFG_OIL_TEMP20_A_108 392;
BA_ "AfdxFDSaddr" SG_ 437791610 IOM_A_34_VFG_OIL_TEMP20_A_108 392;
BA_ "AfdxFDSlength" SG_ 437791610 IOM_A_34_VFG_OIL_TEMP20_A_108 4;
BA_ "AfdxFDSname" SG_ 437791610 IOM_A_34_VFG_OIL_TEMP20_A_108 "FDS_HSMU_TEST20_78";
BA_ "AfdxSignalType" SG_ 437791610 IOM_A_34_VFG_OIL_TEMP20_A_108 "Integer";
BA_ "AfdxFSaddr" SG_ 437791610 FS_HSMU_TEST20_78 392;
BA_ "AfdxFDSaddr" SG_ 437791610 FS_HSMU_TEST20_78 392;
BA_ "AfdxFDSlength" SG_ 437791610 FS_HSMU_TEST20_78 4;
BA_ "AfdxFDSname" SG_ 437791610 FS_HSMU_TEST20_78 "FDS_HSMU_TEST20_78";
BA_ "AfdxSignalType" SG_ 437791610 FS_HSMU_TEST20_78 "Enumerate";
BA_ "AfdxFSaddr" SG_ 437791610 IOM_A_34_VFG_OIL_TEMP20_A_107 388;
BA_ "AfdxFDSaddr" SG_ 437791610 IOM_A_34_VFG_OIL_TEMP20_A_107 388;
BA_ "AfdxFDSlength" SG_ 437791610 IOM_A_34_VFG_OIL_TEMP20_A_107 4;
BA_ "AfdxFDSname" SG_ 437791610 IOM_A_34_VFG_OIL_TEMP20_A_107 "FDS_HSMU_TEST20_77";
BA_ "AfdxSignalType" SG_ 437791610 IOM_A_34_VFG_OIL_TEMP20_A_107 "Integer";
BA_ "AfdxFSaddr" SG_ 437791610 FS_HSMU_TEST20_77 388;
BA_ "AfdxFDSaddr" SG_ 437791610 FS_HSMU_TEST20_77 388;
BA_ "AfdxFDSlength" SG_ 437791610 FS_HSMU_TEST20_77 4;
BA_ "AfdxFDSname" SG_ 437791610 FS_HSMU_TEST20_77 "FDS_HSMU_TEST20_77";
BA_ "AfdxSignalType" SG_ 437791610 FS_HSMU_TEST20_77 "Enumerate";
BA_ "AfdxFSaddr" SG_ 437791610 IOM_A_34_VFG_OIL_TEMP20_A_106 380;
BA_ "AfdxFDSaddr" SG_ 437791610 IOM_A_34_VFG_OIL_TEMP20_A_106 380;
BA_ "AfdxFDSlength" SG_ 437791610 IOM_A_34_VFG_OIL_TEMP20_A_106 4;
BA_ "AfdxFDSname" SG_ 437791610 IOM_A_34_VFG_OIL_TEMP20_A_106 "FDS_HSMU_TEST20_76";
BA_ "AfdxSignalType" SG_ 437791610 IOM_A_34_VFG_OIL_TEMP20_A_106 "Integer";
BA_ "AfdxFSaddr" SG_ 437791610 FS_HSMU_TEST20_76 380;
BA_ "AfdxFDSaddr" SG_ 437791610 FS_HSMU_TEST20_76 380;
BA_ "AfdxFDSlength" SG_ 437791610 FS_HSMU_TEST20_76 4;
BA_ "AfdxFDSname" SG_ 437791610 FS_HSMU_TEST20_76 "FDS_HSMU_TEST20_76";
BA_ "AfdxSignalType" SG_ 437791610 FS_HSMU_TEST20_76 "Enumerate";
BA_ "AfdxFSaddr" SG_ 437791610 IOM_A_34_VFG_OIL_TEMP20_A_105 376;
BA_ "AfdxFDSaddr" SG_ 437791610 IOM_A_34_VFG_OIL_TEMP20_A_105 376;
BA_ "AfdxFDSlength" SG_ 437791610 IOM_A_34_VFG_OIL_TEMP20_A_105 4;
BA_ "AfdxFDSname" SG_ 437791610 IOM_A_34_VFG_OIL_TEMP20_A_105 "FDS_HSMU_TEST20_75";
BA_ "AfdxSignalType" SG_ 437791610 IOM_A_34_VFG_OIL_TEMP20_A_105 "Integer";
BA_ "AfdxFSaddr" SG_ 437791610 FS_HSMU_TEST20_75 376;
BA_ "AfdxFDSaddr" SG_ 437791610 FS_HSMU_TEST20_75 376;
BA_ "AfdxFDSlength" SG_ 437791610 FS_HSMU_TEST20_75 4;
BA_ "AfdxFDSname" SG_ 437791610 FS_HSMU_TEST20_75 "FDS_HSMU_TEST20_75";
BA_ "AfdxSignalType" SG_ 437791610 FS_HSMU_TEST20_75 "Enumerate";
BA_ "AfdxFSaddr" SG_ 437791610 IOM_A_34_VFG_OIL_TEMP20_A_104 372;
BA_ "AfdxFDSaddr" SG_ 437791610 IOM_A_34_VFG_OIL_TEMP20_A_104 372;
BA_ "AfdxFDSlength" SG_ 437791610 IOM_A_34_VFG_OIL_TEMP20_A_104 4;
BA_ "AfdxFDSname" SG_ 437791610 IOM_A_34_VFG_OIL_TEMP20_A_104 "FDS_HSMU_TEST20_74";
BA_ "AfdxSignalType" SG_ 437791610 IOM_A_34_VFG_OIL_TEMP20_A_104 "Integer";
BA_ "AfdxFSaddr" SG_ 437791610 FS_HSMU_TEST20_74 372;
BA_ "AfdxFDSaddr" SG_ 437791610 FS_HSMU_TEST20_74 372;
BA_ "AfdxFDSlength" SG_ 437791610 FS_HSMU_TEST20_74 4;
BA_ "AfdxFDSname" SG_ 437791610 FS_HSMU_TEST20_74 "FDS_HSMU_TEST20_74";
BA_ "AfdxSignalType" SG_ 437791610 FS_HSMU_TEST20_74 "Enumerate";
BA_ "AfdxFSaddr" SG_ 437791610 IOM_A_34_VFG_OIL_TEMP20_A_103 368;
BA_ "AfdxFDSaddr" SG_ 437791610 IOM_A_34_VFG_OIL_TEMP20_A_103 368;
BA_ "AfdxFDSlength" SG_ 437791610 IOM_A_34_VFG_OIL_TEMP20_A_103 4;
BA_ "AfdxFDSname" SG_ 437791610 IOM_A_34_VFG_OIL_TEMP20_A_103 "FDS_HSMU_TEST20_73";
BA_ "AfdxSignalType" SG_ 437791610 IOM_A_34_VFG_OIL_TEMP20_A_103 "Integer";
BA_ "AfdxFSaddr" SG_ 437791610 FS_HSMU_TEST20_73 368;
BA_ "AfdxFDSaddr" SG_ 437791610 FS_HSMU_TEST20_73 368;
BA_ "AfdxFDSlength" SG_ 437791610 FS_HSMU_TEST20_73 4;
BA_ "AfdxFDSname" SG_ 437791610 FS_HSMU_TEST20_73 "FDS_HSMU_TEST20_73";
BA_ "AfdxSignalType" SG_ 437791610 FS_HSMU_TEST20_73 "Enumerate";
BA_ "AfdxFSaddr" SG_ 437791610 IOM_A_34_VFG_OIL_TEMP20_A_102 360;
BA_ "AfdxFDSaddr" SG_ 437791610 IOM_A_34_VFG_OIL_TEMP20_A_102 360;
BA_ "AfdxFDSlength" SG_ 437791610 IOM_A_34_VFG_OIL_TEMP20_A_102 4;
BA_ "AfdxFDSname" SG_ 437791610 IOM_A_34_VFG_OIL_TEMP20_A_102 "FDS_HSMU_TEST20_72";
BA_ "AfdxSignalType" SG_ 437791610 IOM_A_34_VFG_OIL_TEMP20_A_102 "Integer";
BA_ "AfdxFSaddr" SG_ 437791610 FS_HSMU_TEST20_72 360;
BA_ "AfdxFDSaddr" SG_ 437791610 FS_HSMU_TEST20_72 360;
BA_ "AfdxFDSlength" SG_ 437791610 FS_HSMU_TEST20_72 4;
BA_ "AfdxFDSname" SG_ 437791610 FS_HSMU_TEST20_72 "FDS_HSMU_TEST20_72";
BA_ "AfdxSignalType" SG_ 437791610 FS_HSMU_TEST20_72 "Enumerate";
BA_ "AfdxFSaddr" SG_ 437791610 IOM_A_34_VFG_OIL_TEMP20_A_101 356;
BA_ "AfdxFDSaddr" SG_ 437791610 IOM_A_34_VFG_OIL_TEMP20_A_101 356;
BA_ "AfdxFDSlength" SG_ 437791610 IOM_A_34_VFG_OIL_TEMP20_A_101 4;
BA_ "AfdxFDSname" SG_ 437791610 IOM_A_34_VFG_OIL_TEMP20_A_101 "FDS_HSMU_TEST20_71";
BA_ "AfdxSignalType" SG_ 437791610 IOM_A_34_VFG_OIL_TEMP20_A_101 "Integer";
BA_ "AfdxFSaddr" SG_ 437791610 FS_HSMU_TEST20_71 356;
BA_ "AfdxFDSaddr" SG_ 437791610 FS_HSMU_TEST20_71 356;
BA_ "AfdxFDSlength" SG_ 437791610 FS_HSMU_TEST20_71 4;
BA_ "AfdxFDSname" SG_ 437791610 FS_HSMU_TEST20_71 "FDS_HSMU_TEST20_71";
BA_ "AfdxSignalType" SG_ 437791610 FS_HSMU_TEST20_71 "Enumerate";
BA_ "AfdxFSaddr" SG_ 437791610 IOM_A_34_VFG_OIL_TEMP20_A_100 352;
BA_ "AfdxFDSaddr" SG_ 437791610 IOM_A_34_VFG_OIL_TEMP20_A_100 352;
BA_ "AfdxFDSlength" SG_ 437791610 IOM_A_34_VFG_OIL_TEMP20_A_100 4;
BA_ "AfdxFDSname" SG_ 437791610 IOM_A_34_VFG_OIL_TEMP20_A_100 "FDS_HSMU_TEST20_70";
BA_ "AfdxSignalType" SG_ 437791610 IOM_A_34_VFG_OIL_TEMP20_A_100 "Integer";
BA_ "AfdxFSaddr" SG_ 437791610 FS_HSMU_TEST20_70 352;
BA_ "AfdxFDSaddr" SG_ 437791610 FS_HSMU_TEST20_70 352;
BA_ "AfdxFDSlength" SG_ 437791610 FS_HSMU_TEST20_70 4;
BA_ "AfdxFDSname" SG_ 437791610 FS_HSMU_TEST20_70 "FDS_HSMU_TEST20_70";
BA_ "AfdxSignalType" SG_ 437791610 FS_HSMU_TEST20_70 "Enumerate";
BA_ "AfdxFSaddr" SG_ 437791610 IOM_A_34_VFG_OIL_TEMP20_A_99 348;
BA_ "AfdxFDSaddr" SG_ 437791610 IOM_A_34_VFG_OIL_TEMP20_A_99 348;
BA_ "AfdxFDSlength" SG_ 437791610 IOM_A_34_VFG_OIL_TEMP20_A_99 4;
BA_ "AfdxFDSname" SG_ 437791610 IOM_A_34_VFG_OIL_TEMP20_A_99 "FDS_HSMU_TEST20_69";
BA_ "AfdxSignalType" SG_ 437791610 IOM_A_34_VFG_OIL_TEMP20_A_99 "Integer";
BA_ "AfdxFSaddr" SG_ 437791610 FS_HSMU_TEST20_69 348;
BA_ "AfdxFDSaddr" SG_ 437791610 FS_HSMU_TEST20_69 348;
BA_ "AfdxFDSlength" SG_ 437791610 FS_HSMU_TEST20_69 4;
BA_ "AfdxFDSname" SG_ 437791610 FS_HSMU_TEST20_69 "FDS_HSMU_TEST20_69";
BA_ "AfdxSignalType" SG_ 437791610 FS_HSMU_TEST20_69 "Enumerate";
BA_ "AfdxFSaddr" SG_ 437791610 IOM_A_34_VFG_OIL_TEMP20_A_98 340;
BA_ "AfdxFDSaddr" SG_ 437791610 IOM_A_34_VFG_OIL_TEMP20_A_98 340;
BA_ "AfdxFDSlength" SG_ 437791610 IOM_A_34_VFG_OIL_TEMP20_A_98 4;
BA_ "AfdxFDSname" SG_ 437791610 IOM_A_34_VFG_OIL_TEMP20_A_98 "FDS_HSMU_TEST20_68";
BA_ "AfdxSignalType" SG_ 437791610 IOM_A_34_VFG_OIL_TEMP20_A_98 "Integer";
BA_ "AfdxFSaddr" SG_ 437791610 FS_HSMU_TEST20_68 340;
BA_ "AfdxFDSaddr" SG_ 437791610 FS_HSMU_TEST20_68 340;
BA_ "AfdxFDSlength" SG_ 437791610 FS_HSMU_TEST20_68 4;
BA_ "AfdxFDSname" SG_ 437791610 FS_HSMU_TEST20_68 "FDS_HSMU_TEST20_68";
BA_ "AfdxSignalType" SG_ 437791610 FS_HSMU_TEST20_68 "Enumerate";
BA_ "AfdxFSaddr" SG_ 437791610 IOM_A_34_VFG_OIL_TEMP20_A_97 336;
BA_ "AfdxFDSaddr" SG_ 437791610 IOM_A_34_VFG_OIL_TEMP20_A_97 336;
BA_ "AfdxFDSlength" SG_ 437791610 IOM_A_34_VFG_OIL_TEMP20_A_97 4;
BA_ "AfdxFDSname" SG_ 437791610 IOM_A_34_VFG_OIL_TEMP20_A_97 "FDS_HSMU_TEST20_67";
BA_ "AfdxSignalType" SG_ 437791610 IOM_A_34_VFG_OIL_TEMP20_A_97 "Integer";
BA_ "AfdxFSaddr" SG_ 437791610 FS_HSMU_TEST20_67 336;
BA_ "AfdxFDSaddr" SG_ 437791610 FS_HSMU_TEST20_67 336;
BA_ "AfdxFDSlength" SG_ 437791610 FS_HSMU_TEST20_67 4;
BA_ "AfdxFDSname" SG_ 437791610 FS_HSMU_TEST20_67 "FDS_HSMU_TEST20_67";
BA_ "AfdxSignalType" SG_ 437791610 FS_HSMU_TEST20_67 "Enumerate";
BA_ "AfdxFSaddr" SG_ 437791610 IOM_A_34_VFG_OIL_TEMP20_A_96 332;
BA_ "AfdxFDSaddr" SG_ 437791610 IOM_A_34_VFG_OIL_TEMP20_A_96 332;
BA_ "AfdxFDSlength" SG_ 437791610 IOM_A_34_VFG_OIL_TEMP20_A_96 4;
BA_ "AfdxFDSname" SG_ 437791610 IOM_A_34_VFG_OIL_TEMP20_A_96 "FDS_HSMU_TEST20_66";
BA_ "AfdxSignalType" SG_ 437791610 IOM_A_34_VFG_OIL_TEMP20_A_96 "Integer";
BA_ "AfdxFSaddr" SG_ 437791610 FS_HSMU_TEST20_66 332;
BA_ "AfdxFDSaddr" SG_ 437791610 FS_HSMU_TEST20_66 332;
BA_ "AfdxFDSlength" SG_ 437791610 FS_HSMU_TEST20_66 4;
BA_ "AfdxFDSname" SG_ 437791610 FS_HSMU_TEST20_66 "FDS_HSMU_TEST20_66";
BA_ "AfdxSignalType" SG_ 437791610 FS_HSMU_TEST20_66 "Enumerate";
BA_ "AfdxFSaddr" SG_ 437791610 IOM_A_34_VFG_OIL_TEMP20_A_95 328;
BA_ "AfdxFDSaddr" SG_ 437791610 IOM_A_34_VFG_OIL_TEMP20_A_95 328;
BA_ "AfdxFDSlength" SG_ 437791610 IOM_A_34_VFG_OIL_TEMP20_A_95 4;
BA_ "AfdxFDSname" SG_ 437791610 IOM_A_34_VFG_OIL_TEMP20_A_95 "FDS_HSMU_TEST20_65";
BA_ "AfdxSignalType" SG_ 437791610 IOM_A_34_VFG_OIL_TEMP20_A_95 "Integer";
BA_ "AfdxFSaddr" SG_ 437791610 FS_HSMU_TEST20_65 328;
BA_ "AfdxFDSaddr" SG_ 437791610 FS_HSMU_TEST20_65 328;
BA_ "AfdxFDSlength" SG_ 437791610 FS_HSMU_TEST20_65 4;
BA_ "AfdxFDSname" SG_ 437791610 FS_HSMU_TEST20_65 "FDS_HSMU_TEST20_65";
BA_ "AfdxSignalType" SG_ 437791610 FS_HSMU_TEST20_65 "Enumerate";
BA_ "AfdxFSaddr" SG_ 437791610 IOM_A_34_VFG_OIL_TEMP20_A_94 320;
BA_ "AfdxFDSaddr" SG_ 437791610 IOM_A_34_VFG_OIL_TEMP20_A_94 320;
BA_ "AfdxFDSlength" SG_ 437791610 IOM_A_34_VFG_OIL_TEMP20_A_94 4;
BA_ "AfdxFDSname" SG_ 437791610 IOM_A_34_VFG_OIL_TEMP20_A_94 "FDS_HSMU_TEST20_64";
BA_ "AfdxSignalType" SG_ 437791610 IOM_A_34_VFG_OIL_TEMP20_A_94 "Integer";
BA_ "AfdxFSaddr" SG_ 437791610 FS_HSMU_TEST20_64 320;
BA_ "AfdxFDSaddr" SG_ 437791610 FS_HSMU_TEST20_64 320;
BA_ "AfdxFDSlength" SG_ 437791610 FS_HSMU_TEST20_64 4;
BA_ "AfdxFDSname" SG_ 437791610 FS_HSMU_TEST20_64 "FDS_HSMU_TEST20_64";
BA_ "AfdxSignalType" SG_ 437791610 FS_HSMU_TEST20_64 "Enumerate";
BA_ "AfdxFSaddr" SG_ 437791610 IOM_A_34_VFG_OIL_TEMP20_A_93 316;
BA_ "AfdxFDSaddr" SG_ 437791610 IOM_A_34_VFG_OIL_TEMP20_A_93 316;
BA_ "AfdxFDSlength" SG_ 437791610 IOM_A_34_VFG_OIL_TEMP20_A_93 4;
BA_ "AfdxFDSname" SG_ 437791610 IOM_A_34_VFG_OIL_TEMP20_A_93 "FDS_HSMU_TEST20_63";
BA_ "AfdxSignalType" SG_ 437791610 IOM_A_34_VFG_OIL_TEMP20_A_93 "Integer";
BA_ "AfdxFSaddr" SG_ 437791610 FS_HSMU_TEST20_63 316;
BA_ "AfdxFDSaddr" SG_ 437791610 FS_HSMU_TEST20_63 316;
BA_ "AfdxFDSlength" SG_ 437791610 FS_HSMU_TEST20_63 4;
BA_ "AfdxFDSname" SG_ 437791610 FS_HSMU_TEST20_63 "FDS_HSMU_TEST20_63";
BA_ "AfdxSignalType" SG_ 437791610 FS_HSMU_TEST20_63 "Enumerate";
BA_ "AfdxFSaddr" SG_ 437791610 IOM_A_34_VFG_OIL_TEMP20_A_92 312;
BA_ "AfdxFDSaddr" SG_ 437791610 IOM_A_34_VFG_OIL_TEMP20_A_92 312;
BA_ "AfdxFDSlength" SG_ 437791610 IOM_A_34_VFG_OIL_TEMP20_A_92 4;
BA_ "AfdxFDSname" SG_ 437791610 IOM_A_34_VFG_OIL_TEMP20_A_92 "FDS_HSMU_TEST20_62";
BA_ "AfdxSignalType" SG_ 437791610 IOM_A_34_VFG_OIL_TEMP20_A_92 "Integer";
BA_ "AfdxFSaddr" SG_ 437791610 FS_HSMU_TEST20_62 312;
BA_ "AfdxFDSaddr" SG_ 437791610 FS_HSMU_TEST20_62 312;
BA_ "AfdxFDSlength" SG_ 437791610 FS_HSMU_TEST20_62 4;
BA_ "AfdxFDSname" SG_ 437791610 FS_HSMU_TEST20_62 "FDS_HSMU_TEST20_62";
BA_ "AfdxSignalType" SG_ 437791610 FS_HSMU_TEST20_62 "Enumerate";
BA_ "AfdxFSaddr" SG_ 437791610 IOM_A_34_VFG_OIL_TEMP20_A_91 308;
BA_ "AfdxFDSaddr" SG_ 437791610 IOM_A_34_VFG_OIL_TEMP20_A_91 308;
BA_ "AfdxFDSlength" SG_ 437791610 IOM_A_34_VFG_OIL_TEMP20_A_91 4;
BA_ "AfdxFDSname" SG_ 437791610 IOM_A_34_VFG_OIL_TEMP20_A_91 "FDS_HSMU_TEST20_61";
BA_ "AfdxSignalType" SG_ 437791610 IOM_A_34_VFG_OIL_TEMP20_A_91 "Integer";
BA_ "AfdxFSaddr" SG_ 437791610 FS_HSMU_TEST20_61 308;
BA_ "AfdxFDSaddr" SG_ 437791610 FS_HSMU_TEST20_61 308;
BA_ "AfdxFDSlength" SG_ 437791610 FS_HSMU_TEST20_61 4;
BA_ "AfdxFDSname" SG_ 437791610 FS_HSMU_TEST20_61 "FDS_HSMU_TEST20_61";
BA_ "AfdxSignalType" SG_ 437791610 FS_HSMU_TEST20_61 "Enumerate";
BA_ "AfdxFSaddr" SG_ 437791610 IOM_A_34_VFG_OIL_TEMP20_A_90 300;
BA_ "AfdxFDSaddr" SG_ 437791610 IOM_A_34_VFG_OIL_TEMP20_A_90 300;
BA_ "AfdxFDSlength" SG_ 437791610 IOM_A_34_VFG_OIL_TEMP20_A_90 4;
BA_ "AfdxFDSname" SG_ 437791610 IOM_A_34_VFG_OIL_TEMP20_A_90 "FDS_HSMU_TEST20_60";
BA_ "AfdxSignalType" SG_ 437791610 IOM_A_34_VFG_OIL_TEMP20_A_90 "Integer";
BA_ "AfdxFSaddr" SG_ 437791610 FS_HSMU_TEST20_60 300;
BA_ "AfdxFDSaddr" SG_ 437791610 FS_HSMU_TEST20_60 300;
BA_ "AfdxFDSlength" SG_ 437791610 FS_HSMU_TEST20_60 4;
BA_ "AfdxFDSname" SG_ 437791610 FS_HSMU_TEST20_60 "FDS_HSMU_TEST20_60";
BA_ "AfdxSignalType" SG_ 437791610 FS_HSMU_TEST20_60 "Enumerate";
BA_ "AfdxFSaddr" SG_ 437791610 IOM_A_34_VFG_OIL_TEMP20_A_89 296;
BA_ "AfdxFDSaddr" SG_ 437791610 IOM_A_34_VFG_OIL_TEMP20_A_89 296;
BA_ "AfdxFDSlength" SG_ 437791610 IOM_A_34_VFG_OIL_TEMP20_A_89 4;
BA_ "AfdxFDSname" SG_ 437791610 IOM_A_34_VFG_OIL_TEMP20_A_89 "FDS_HSMU_TEST20_59";
BA_ "AfdxSignalType" SG_ 437791610 IOM_A_34_VFG_OIL_TEMP20_A_89 "Integer";
BA_ "AfdxFSaddr" SG_ 437791610 FS_HSMU_TEST20_59 296;
BA_ "AfdxFDSaddr" SG_ 437791610 FS_HSMU_TEST20_59 296;
BA_ "AfdxFDSlength" SG_ 437791610 FS_HSMU_TEST20_59 4;
BA_ "AfdxFDSname" SG_ 437791610 FS_HSMU_TEST20_59 "FDS_HSMU_TEST20_59";
BA_ "AfdxSignalType" SG_ 437791610 FS_HSMU_TEST20_59 "Enumerate";
BA_ "AfdxFSaddr" SG_ 437791610 IOM_A_34_VFG_OIL_TEMP20_A_88 292;
BA_ "AfdxFDSaddr" SG_ 437791610 IOM_A_34_VFG_OIL_TEMP20_A_88 292;
BA_ "AfdxFDSlength" SG_ 437791610 IOM_A_34_VFG_OIL_TEMP20_A_88 4;
BA_ "AfdxFDSname" SG_ 437791610 IOM_A_34_VFG_OIL_TEMP20_A_88 "FDS_HSMU_TEST20_58";
BA_ "AfdxSignalType" SG_ 437791610 IOM_A_34_VFG_OIL_TEMP20_A_88 "Integer";
BA_ "AfdxFSaddr" SG_ 437791610 FS_HSMU_TEST20_58 292;
BA_ "AfdxFDSaddr" SG_ 437791610 FS_HSMU_TEST20_58 292;
BA_ "AfdxFDSlength" SG_ 437791610 FS_HSMU_TEST20_58 4;
BA_ "AfdxFDSname" SG_ 437791610 FS_HSMU_TEST20_58 "FDS_HSMU_TEST20_58";
BA_ "AfdxSignalType" SG_ 437791610 FS_HSMU_TEST20_58 "Enumerate";
BA_ "AfdxFSaddr" SG_ 437791610 IOM_A_34_VFG_OIL_TEMP20_A_87 288;
BA_ "AfdxFDSaddr" SG_ 437791610 IOM_A_34_VFG_OIL_TEMP20_A_87 288;
BA_ "AfdxFDSlength" SG_ 437791610 IOM_A_34_VFG_OIL_TEMP20_A_87 4;
BA_ "AfdxFDSname" SG_ 437791610 IOM_A_34_VFG_OIL_TEMP20_A_87 "FDS_HSMU_TEST20_57";
BA_ "AfdxSignalType" SG_ 437791610 IOM_A_34_VFG_OIL_TEMP20_A_87 "Integer";
BA_ "AfdxFSaddr" SG_ 437791610 FS_HSMU_TEST20_57 288;
BA_ "AfdxFDSaddr" SG_ 437791610 FS_HSMU_TEST20_57 288;
BA_ "AfdxFDSlength" SG_ 437791610 FS_HSMU_TEST20_57 4;
BA_ "AfdxFDSname" SG_ 437791610 FS_HSMU_TEST20_57 "FDS_HSMU_TEST20_57";
BA_ "AfdxSignalType" SG_ 437791610 FS_HSMU_TEST20_57 "Enumerate";
BA_ "AfdxFSaddr" SG_ 437791610 IOM_A_34_VFG_OIL_TEMP20_A_86 280;
BA_ "AfdxFDSaddr" SG_ 437791610 IOM_A_34_VFG_OIL_TEMP20_A_86 280;
BA_ "AfdxFDSlength" SG_ 437791610 IOM_A_34_VFG_OIL_TEMP20_A_86 4;
BA_ "AfdxFDSname" SG_ 437791610 IOM_A_34_VFG_OIL_TEMP20_A_86 "FDS_HSMU_TEST20_56";
BA_ "AfdxSignalType" SG_ 437791610 IOM_A_34_VFG_OIL_TEMP20_A_86 "Integer";
BA_ "AfdxFSaddr" SG_ 437791610 FS_HSMU_TEST20_56 280;
BA_ "AfdxFDSaddr" SG_ 437791610 FS_HSMU_TEST20_56 280;
BA_ "AfdxFDSlength" SG_ 437791610 FS_HSMU_TEST20_56 4;
BA_ "AfdxFDSname" SG_ 437791610 FS_HSMU_TEST20_56 "FDS_HSMU_TEST20_56";
BA_ "AfdxSignalType" SG_ 437791610 FS_HSMU_TEST20_56 "Enumerate";
BA_ "AfdxFSaddr" SG_ 437791610 IOM_A_34_VFG_OIL_TEMP20_A_85 276;
BA_ "AfdxFDSaddr" SG_ 437791610 IOM_A_34_VFG_OIL_TEMP20_A_85 276;
BA_ "AfdxFDSlength" SG_ 437791610 IOM_A_34_VFG_OIL_TEMP20_A_85 4;
BA_ "AfdxFDSname" SG_ 437791610 IOM_A_34_VFG_OIL_TEMP20_A_85 "FDS_HSMU_TEST20_55";
BA_ "AfdxSignalType" SG_ 437791610 IOM_A_34_VFG_OIL_TEMP20_A_85 "Integer";
BA_ "AfdxFSaddr" SG_ 437791610 FS_HSMU_TEST20_55 276;
BA_ "AfdxFDSaddr" SG_ 437791610 FS_HSMU_TEST20_55 276;
BA_ "AfdxFDSlength" SG_ 437791610 FS_HSMU_TEST20_55 4;
BA_ "AfdxFDSname" SG_ 437791610 FS_HSMU_TEST20_55 "FDS_HSMU_TEST20_55";
BA_ "AfdxSignalType" SG_ 437791610 FS_HSMU_TEST20_55 "Enumerate";
BA_ "AfdxFSaddr" SG_ 437791610 IOM_A_34_VFG_OIL_TEMP20_A_84 272;
BA_ "AfdxFDSaddr" SG_ 437791610 IOM_A_34_VFG_OIL_TEMP20_A_84 272;
BA_ "AfdxFDSlength" SG_ 437791610 IOM_A_34_VFG_OIL_TEMP20_A_84 4;
BA_ "AfdxFDSname" SG_ 437791610 IOM_A_34_VFG_OIL_TEMP20_A_84 "FDS_HSMU_TEST20_54";
BA_ "AfdxSignalType" SG_ 437791610 IOM_A_34_VFG_OIL_TEMP20_A_84 "Integer";
BA_ "AfdxFSaddr" SG_ 437791610 FS_HSMU_TEST20_54 272;
BA_ "AfdxFDSaddr" SG_ 437791610 FS_HSMU_TEST20_54 272;
BA_ "AfdxFDSlength" SG_ 437791610 FS_HSMU_TEST20_54 4;
BA_ "AfdxFDSname" SG_ 437791610 FS_HSMU_TEST20_54 "FDS_HSMU_TEST20_54";
BA_ "AfdxSignalType" SG_ 437791610 FS_HSMU_TEST20_54 "Enumerate";
BA_ "AfdxFSaddr" SG_ 437791610 IOM_A_34_VFG_OIL_TEMP20_A_83 268;
BA_ "AfdxFDSaddr" SG_ 437791610 IOM_A_34_VFG_OIL_TEMP20_A_83 268;
BA_ "AfdxFDSlength" SG_ 437791610 IOM_A_34_VFG_OIL_TEMP20_A_83 4;
BA_ "AfdxFDSname" SG_ 437791610 IOM_A_34_VFG_OIL_TEMP20_A_83 "FDS_HSMU_TEST20_53";
BA_ "AfdxSignalType" SG_ 437791610 IOM_A_34_VFG_OIL_TEMP20_A_83 "Integer";
BA_ "AfdxFSaddr" SG_ 437791610 FS_HSMU_TEST20_53 268;
BA_ "AfdxFDSaddr" SG_ 437791610 FS_HSMU_TEST20_53 268;
BA_ "AfdxFDSlength" SG_ 437791610 FS_HSMU_TEST20_53 4;
BA_ "AfdxFDSname" SG_ 437791610 FS_HSMU_TEST20_53 "FDS_HSMU_TEST20_53";
BA_ "AfdxSignalType" SG_ 437791610 FS_HSMU_TEST20_53 "Enumerate";
BA_ "AfdxFSaddr" SG_ 437791610 IOM_A_34_VFG_OIL_TEMP20_A_82 260;
BA_ "AfdxFDSaddr" SG_ 437791610 IOM_A_34_VFG_OIL_TEMP20_A_82 260;
BA_ "AfdxFDSlength" SG_ 437791610 IOM_A_34_VFG_OIL_TEMP20_A_82 4;
BA_ "AfdxFDSname" SG_ 437791610 IOM_A_34_VFG_OIL_TEMP20_A_82 "FDS_HSMU_TEST20_52";
BA_ "AfdxSignalType" SG_ 437791610 IOM_A_34_VFG_OIL_TEMP20_A_82 "Integer";
BA_ "AfdxFSaddr" SG_ 437791610 FS_HSMU_TEST20_52 260;
BA_ "AfdxFDSaddr" SG_ 437791610 FS_HSMU_TEST20_52 260;
BA_ "AfdxFDSlength" SG_ 437791610 FS_HSMU_TEST20_52 4;
BA_ "AfdxFDSname" SG_ 437791610 FS_HSMU_TEST20_52 "FDS_HSMU_TEST20_52";
BA_ "AfdxSignalType" SG_ 437791610 FS_HSMU_TEST20_52 "Enumerate";
BA_ "AfdxFSaddr" SG_ 437791610 IOM_A_34_VFG_OIL_TEMP20_A_81 256;
BA_ "AfdxFDSaddr" SG_ 437791610 IOM_A_34_VFG_OIL_TEMP20_A_81 256;
BA_ "AfdxFDSlength" SG_ 437791610 IOM_A_34_VFG_OIL_TEMP20_A_81 4;
BA_ "AfdxFDSname" SG_ 437791610 IOM_A_34_VFG_OIL_TEMP20_A_81 "FDS_HSMU_TEST20_51";
BA_ "AfdxSignalType" SG_ 437791610 IOM_A_34_VFG_OIL_TEMP20_A_81 "Integer";
BA_ "AfdxFSaddr" SG_ 437791610 FS_HSMU_TEST20_51 256;
BA_ "AfdxFDSaddr" SG_ 437791610 FS_HSMU_TEST20_51 256;
BA_ "AfdxFDSlength" SG_ 437791610 FS_HSMU_TEST20_51 4;
BA_ "AfdxFDSname" SG_ 437791610 FS_HSMU_TEST20_51 "FDS_HSMU_TEST20_51";
BA_ "AfdxSignalType" SG_ 437791610 FS_HSMU_TEST20_51 "Enumerate";
BA_ "AfdxFSaddr" SG_ 437791610 IOM_A_34_VFG_OIL_TEMP20_A_80 252;
BA_ "AfdxFDSaddr" SG_ 437791610 IOM_A_34_VFG_OIL_TEMP20_A_80 252;
BA_ "AfdxFDSlength" SG_ 437791610 IOM_A_34_VFG_OIL_TEMP20_A_80 4;
BA_ "AfdxFDSname" SG_ 437791610 IOM_A_34_VFG_OIL_TEMP20_A_80 "FDS_HSMU_TEST20_50";
BA_ "AfdxSignalType" SG_ 437791610 IOM_A_34_VFG_OIL_TEMP20_A_80 "Integer";
BA_ "AfdxFSaddr" SG_ 437791610 FS_HSMU_TEST20_50 252;
BA_ "AfdxFDSaddr" SG_ 437791610 FS_HSMU_TEST20_50 252;
BA_ "AfdxFDSlength" SG_ 437791610 FS_HSMU_TEST20_50 4;
BA_ "AfdxFDSname" SG_ 437791610 FS_HSMU_TEST20_50 "FDS_HSMU_TEST20_50";
BA_ "AfdxSignalType" SG_ 437791610 FS_HSMU_TEST20_50 "Enumerate";
BA_ "AfdxFSaddr" SG_ 437791610 IOM_A_34_VFG_OIL_TEMP20_A_79 248;
BA_ "AfdxFDSaddr" SG_ 437791610 IOM_A_34_VFG_OIL_TEMP20_A_79 248;
BA_ "AfdxFDSlength" SG_ 437791610 IOM_A_34_VFG_OIL_TEMP20_A_79 4;
BA_ "AfdxFDSname" SG_ 437791610 IOM_A_34_VFG_OIL_TEMP20_A_79 "FDS_HSMU_TEST20_49";
BA_ "AfdxSignalType" SG_ 437791610 IOM_A_34_VFG_OIL_TEMP20_A_79 "Integer";
BA_ "AfdxFSaddr" SG_ 437791610 FS_HSMU_TEST20_49 248;
BA_ "AfdxFDSaddr" SG_ 437791610 FS_HSMU_TEST20_49 248;
BA_ "AfdxFDSlength" SG_ 437791610 FS_HSMU_TEST20_49 4;
BA_ "AfdxFDSname" SG_ 437791610 FS_HSMU_TEST20_49 "FDS_HSMU_TEST20_49";
BA_ "AfdxSignalType" SG_ 437791610 FS_HSMU_TEST20_49 "Enumerate";
BA_ "AfdxFSaddr" SG_ 437791610 IOM_A_34_VFG_OIL_TEMP20_A_78 240;
BA_ "AfdxFDSaddr" SG_ 437791610 IOM_A_34_VFG_OIL_TEMP20_A_78 240;
BA_ "AfdxFDSlength" SG_ 437791610 IOM_A_34_VFG_OIL_TEMP20_A_78 4;
BA_ "AfdxFDSname" SG_ 437791610 IOM_A_34_VFG_OIL_TEMP20_A_78 "FDS_HSMU_TEST20_48";
BA_ "AfdxSignalType" SG_ 437791610 IOM_A_34_VFG_OIL_TEMP20_A_78 "Integer";
BA_ "AfdxFSaddr" SG_ 437791610 FS_HSMU_TEST20_48 240;
BA_ "AfdxFDSaddr" SG_ 437791610 FS_HSMU_TEST20_48 240;
BA_ "AfdxFDSlength" SG_ 437791610 FS_HSMU_TEST20_48 4;
BA_ "AfdxFDSname" SG_ 437791610 FS_HSMU_TEST20_48 "FDS_HSMU_TEST20_48";
BA_ "AfdxSignalType" SG_ 437791610 FS_HSMU_TEST20_48 "Enumerate";
BA_ "AfdxFSaddr" SG_ 437791610 IOM_A_34_VFG_OIL_TEMP20_A_77 236;
BA_ "AfdxFDSaddr" SG_ 437791610 IOM_A_34_VFG_OIL_TEMP20_A_77 236;
BA_ "AfdxFDSlength" SG_ 437791610 IOM_A_34_VFG_OIL_TEMP20_A_77 4;
BA_ "AfdxFDSname" SG_ 437791610 IOM_A_34_VFG_OIL_TEMP20_A_77 "FDS_HSMU_TEST20_47";
BA_ "AfdxSignalType" SG_ 437791610 IOM_A_34_VFG_OIL_TEMP20_A_77 "Integer";
BA_ "AfdxFSaddr" SG_ 437791610 FS_HSMU_TEST20_47 236;
BA_ "AfdxFDSaddr" SG_ 437791610 FS_HSMU_TEST20_47 236;
BA_ "AfdxFDSlength" SG_ 437791610 FS_HSMU_TEST20_47 4;
BA_ "AfdxFDSname" SG_ 437791610 FS_HSMU_TEST20_47 "FDS_HSMU_TEST20_47";
BA_ "AfdxSignalType" SG_ 437791610 FS_HSMU_TEST20_47 "Enumerate";
BA_ "AfdxFSaddr" SG_ 437791610 IOM_A_34_VFG_OIL_TEMP20_A_76 232;
BA_ "AfdxFDSaddr" SG_ 437791610 IOM_A_34_VFG_OIL_TEMP20_A_76 232;
BA_ "AfdxFDSlength" SG_ 437791610 IOM_A_34_VFG_OIL_TEMP20_A_76 4;
BA_ "AfdxFDSname" SG_ 437791610 IOM_A_34_VFG_OIL_TEMP20_A_76 "FDS_HSMU_TEST20_46";
BA_ "AfdxSignalType" SG_ 437791610 IOM_A_34_VFG_OIL_TEMP20_A_76 "Integer";
BA_ "AfdxFSaddr" SG_ 437791610 FS_HSMU_TEST20_46 232;
BA_ "AfdxFDSaddr" SG_ 437791610 FS_HSMU_TEST20_46 232;
BA_ "AfdxFDSlength" SG_ 437791610 FS_HSMU_TEST20_46 4;
BA_ "AfdxFDSname" SG_ 437791610 FS_HSMU_TEST20_46 "FDS_HSMU_TEST20_46";
BA_ "AfdxSignalType" SG_ 437791610 FS_HSMU_TEST20_46 "Enumerate";
BA_ "AfdxFSaddr" SG_ 437791610 IOM_A_34_VFG_OIL_TEMP20_A_75 228;
BA_ "AfdxFDSaddr" SG_ 437791610 IOM_A_34_VFG_OIL_TEMP20_A_75 228;
BA_ "AfdxFDSlength" SG_ 437791610 IOM_A_34_VFG_OIL_TEMP20_A_75 4;
BA_ "AfdxFDSname" SG_ 437791610 IOM_A_34_VFG_OIL_TEMP20_A_75 "FDS_HSMU_TEST20_45";
BA_ "AfdxSignalType" SG_ 437791610 IOM_A_34_VFG_OIL_TEMP20_A_75 "Integer";
BA_ "AfdxFSaddr" SG_ 437791610 FS_HSMU_TEST20_45 228;
BA_ "AfdxFDSaddr" SG_ 437791610 FS_HSMU_TEST20_45 228;
BA_ "AfdxFDSlength" SG_ 437791610 FS_HSMU_TEST20_45 4;
BA_ "AfdxFDSname" SG_ 437791610 FS_HSMU_TEST20_45 "FDS_HSMU_TEST20_45";
BA_ "AfdxSignalType" SG_ 437791610 FS_HSMU_TEST20_45 "Enumerate";
BA_ "AfdxFSaddr" SG_ 437791610 IOM_A_34_VFG_OIL_TEMP20_A_74 220;
BA_ "AfdxFDSaddr" SG_ 437791610 IOM_A_34_VFG_OIL_TEMP20_A_74 220;
BA_ "AfdxFDSlength" SG_ 437791610 IOM_A_34_VFG_OIL_TEMP20_A_74 4;
BA_ "AfdxFDSname" SG_ 437791610 IOM_A_34_VFG_OIL_TEMP20_A_74 "FDS_HSMU_TEST20_44";
BA_ "AfdxSignalType" SG_ 437791610 IOM_A_34_VFG_OIL_TEMP20_A_74 "Integer";
BA_ "AfdxFSaddr" SG_ 437791610 FS_HSMU_TEST20_44 220;
BA_ "AfdxFDSaddr" SG_ 437791610 FS_HSMU_TEST20_44 220;
BA_ "AfdxFDSlength" SG_ 437791610 FS_HSMU_TEST20_44 4;
BA_ "AfdxFDSname" SG_ 437791610 FS_HSMU_TEST20_44 "FDS_HSMU_TEST20_44";
BA_ "AfdxSignalType" SG_ 437791610 FS_HSMU_TEST20_44 "Enumerate";
BA_ "AfdxFSaddr" SG_ 437791610 IOM_A_34_VFG_OIL_TEMP20_A_73 216;
BA_ "AfdxFDSaddr" SG_ 437791610 IOM_A_34_VFG_OIL_TEMP20_A_73 216;
BA_ "AfdxFDSlength" SG_ 437791610 IOM_A_34_VFG_OIL_TEMP20_A_73 4;
BA_ "AfdxFDSname" SG_ 437791610 IOM_A_34_VFG_OIL_TEMP20_A_73 "FDS_HSMU_TEST20_43";
BA_ "AfdxSignalType" SG_ 437791610 IOM_A_34_VFG_OIL_TEMP20_A_73 "Integer";
BA_ "AfdxFSaddr" SG_ 437791610 FS_HSMU_TEST20_43 216;
BA_ "AfdxFDSaddr" SG_ 437791610 FS_HSMU_TEST20_43 216;
BA_ "AfdxFDSlength" SG_ 437791610 FS_HSMU_TEST20_43 4;
BA_ "AfdxFDSname" SG_ 437791610 FS_HSMU_TEST20_43 "FDS_HSMU_TEST20_43";
BA_ "AfdxSignalType" SG_ 437791610 FS_HSMU_TEST20_43 "Enumerate";
BA_ "AfdxFSaddr" SG_ 437791610 IOM_A_34_VFG_OIL_TEMP20_A_72 212;
BA_ "AfdxFDSaddr" SG_ 437791610 IOM_A_34_VFG_OIL_TEMP20_A_72 212;
BA_ "AfdxFDSlength" SG_ 437791610 IOM_A_34_VFG_OIL_TEMP20_A_72 4;
BA_ "AfdxFDSname" SG_ 437791610 IOM_A_34_VFG_OIL_TEMP20_A_72 "FDS_HSMU_TEST20_42";
BA_ "AfdxSignalType" SG_ 437791610 IOM_A_34_VFG_OIL_TEMP20_A_72 "Integer";
BA_ "AfdxFSaddr" SG_ 437791610 FS_HSMU_TEST20_42 212;
BA_ "AfdxFDSaddr" SG_ 437791610 FS_HSMU_TEST20_42 212;
BA_ "AfdxFDSlength" SG_ 437791610 FS_HSMU_TEST20_42 4;
BA_ "AfdxFDSname" SG_ 437791610 FS_HSMU_TEST20_42 "FDS_HSMU_TEST20_42";
BA_ "AfdxSignalType" SG_ 437791610 FS_HSMU_TEST20_42 "Enumerate";
BA_ "AfdxFSaddr" SG_ 437791610 IOM_A_34_VFG_OIL_TEMP20_A_71 208;
BA_ "AfdxFDSaddr" SG_ 437791610 IOM_A_34_VFG_OIL_TEMP20_A_71 208;
BA_ "AfdxFDSlength" SG_ 437791610 IOM_A_34_VFG_OIL_TEMP20_A_71 4;
BA_ "AfdxFDSname" SG_ 437791610 IOM_A_34_VFG_OIL_TEMP20_A_71 "FDS_HSMU_TEST20_41";
BA_ "AfdxSignalType" SG_ 437791610 IOM_A_34_VFG_OIL_TEMP20_A_71 "Integer";
BA_ "AfdxFSaddr" SG_ 437791610 FS_HSMU_TEST20_41 208;
BA_ "AfdxFDSaddr" SG_ 437791610 FS_HSMU_TEST20_41 208;
BA_ "AfdxFDSlength" SG_ 437791610 FS_HSMU_TEST20_41 4;
BA_ "AfdxFDSname" SG_ 437791610 FS_HSMU_TEST20_41 "FDS_HSMU_TEST20_41";
BA_ "AfdxSignalType" SG_ 437791610 FS_HSMU_TEST20_41 "Enumerate";
BA_ "AfdxFSaddr" SG_ 437791610 IOM_A_34_VFG_OIL_TEMP20_A_70 200;
BA_ "AfdxFDSaddr" SG_ 437791610 IOM_A_34_VFG_OIL_TEMP20_A_70 200;
BA_ "AfdxFDSlength" SG_ 437791610 IOM_A_34_VFG_OIL_TEMP20_A_70 4;
BA_ "AfdxFDSname" SG_ 437791610 IOM_A_34_VFG_OIL_TEMP20_A_70 "FDS_HSMU_TEST20_40";
BA_ "AfdxSignalType" SG_ 437791610 IOM_A_34_VFG_OIL_TEMP20_A_70 "Integer";
BA_ "AfdxFSaddr" SG_ 437791610 FS_HSMU_TEST20_40 200;
BA_ "AfdxFDSaddr" SG_ 437791610 FS_HSMU_TEST20_40 200;
BA_ "AfdxFDSlength" SG_ 437791610 FS_HSMU_TEST20_40 4;
BA_ "AfdxFDSname" SG_ 437791610 FS_HSMU_TEST20_40 "FDS_HSMU_TEST20_40";
BA_ "AfdxSignalType" SG_ 437791610 FS_HSMU_TEST20_40 "Enumerate";
BA_ "AfdxFSaddr" SG_ 437791610 IOM_A_34_VFG_OIL_TEMP20_A_69 196;
BA_ "AfdxFDSaddr" SG_ 437791610 IOM_A_34_VFG_OIL_TEMP20_A_69 196;
BA_ "AfdxFDSlength" SG_ 437791610 IOM_A_34_VFG_OIL_TEMP20_A_69 4;
BA_ "AfdxFDSname" SG_ 437791610 IOM_A_34_VFG_OIL_TEMP20_A_69 "FDS_HSMU_TEST20_39";
BA_ "AfdxSignalType" SG_ 437791610 IOM_A_34_VFG_OIL_TEMP20_A_69 "Integer";
BA_ "AfdxFSaddr" SG_ 437791610 FS_HSMU_TEST20_39 196;
BA_ "AfdxFDSaddr" SG_ 437791610 FS_HSMU_TEST20_39 196;
BA_ "AfdxFDSlength" SG_ 437791610 FS_HSMU_TEST20_39 4;
BA_ "AfdxFDSname" SG_ 437791610 FS_HSMU_TEST20_39 "FDS_HSMU_TEST20_39";
BA_ "AfdxSignalType" SG_ 437791610 FS_HSMU_TEST20_39 "Enumerate";
BA_ "AfdxFSaddr" SG_ 437791610 IOM_A_34_VFG_OIL_TEMP20_A_68 192;
BA_ "AfdxFDSaddr" SG_ 437791610 IOM_A_34_VFG_OIL_TEMP20_A_68 192;
BA_ "AfdxFDSlength" SG_ 437791610 IOM_A_34_VFG_OIL_TEMP20_A_68 4;
BA_ "AfdxFDSname" SG_ 437791610 IOM_A_34_VFG_OIL_TEMP20_A_68 "FDS_HSMU_TEST20_38";
BA_ "AfdxSignalType" SG_ 437791610 IOM_A_34_VFG_OIL_TEMP20_A_68 "Integer";
BA_ "AfdxFSaddr" SG_ 437791610 FS_HSMU_TEST20_38 192;
BA_ "AfdxFDSaddr" SG_ 437791610 FS_HSMU_TEST20_38 192;
BA_ "AfdxFDSlength" SG_ 437791610 FS_HSMU_TEST20_38 4;
BA_ "AfdxFDSname" SG_ 437791610 FS_HSMU_TEST20_38 "FDS_HSMU_TEST20_38";
BA_ "AfdxSignalType" SG_ 437791610 FS_HSMU_TEST20_38 "Enumerate";
BA_ "AfdxFSaddr" SG_ 437791610 IOM_A_34_VFG_OIL_TEMP20_A_67 188;
BA_ "AfdxFDSaddr" SG_ 437791610 IOM_A_34_VFG_OIL_TEMP20_A_67 188;
BA_ "AfdxFDSlength" SG_ 437791610 IOM_A_34_VFG_OIL_TEMP20_A_67 4;
BA_ "AfdxFDSname" SG_ 437791610 IOM_A_34_VFG_OIL_TEMP20_A_67 "FDS_HSMU_TEST20_37";
BA_ "AfdxSignalType" SG_ 437791610 IOM_A_34_VFG_OIL_TEMP20_A_67 "Integer";
BA_ "AfdxFSaddr" SG_ 437791610 FS_HSMU_TEST20_37 188;
BA_ "AfdxFDSaddr" SG_ 437791610 FS_HSMU_TEST20_37 188;
BA_ "AfdxFDSlength" SG_ 437791610 FS_HSMU_TEST20_37 4;
BA_ "AfdxFDSname" SG_ 437791610 FS_HSMU_TEST20_37 "FDS_HSMU_TEST20_37";
BA_ "AfdxSignalType" SG_ 437791610 FS_HSMU_TEST20_37 "Enumerate";
BA_ "AfdxFSaddr" SG_ 437791610 IOM_A_34_VFG_OIL_TEMP20_A_66 180;
BA_ "AfdxFDSaddr" SG_ 437791610 IOM_A_34_VFG_OIL_TEMP20_A_66 180;
BA_ "AfdxFDSlength" SG_ 437791610 IOM_A_34_VFG_OIL_TEMP20_A_66 4;
BA_ "AfdxFDSname" SG_ 437791610 IOM_A_34_VFG_OIL_TEMP20_A_66 "FDS_HSMU_TEST20_36";
BA_ "AfdxSignalType" SG_ 437791610 IOM_A_34_VFG_OIL_TEMP20_A_66 "Integer";
BA_ "AfdxFSaddr" SG_ 437791610 FS_HSMU_TEST20_36 180;
BA_ "AfdxFDSaddr" SG_ 437791610 FS_HSMU_TEST20_36 180;
BA_ "AfdxFDSlength" SG_ 437791610 FS_HSMU_TEST20_36 4;
BA_ "AfdxFDSname" SG_ 437791610 FS_HSMU_TEST20_36 "FDS_HSMU_TEST20_36";
BA_ "AfdxSignalType" SG_ 437791610 FS_HSMU_TEST20_36 "Enumerate";
BA_ "AfdxFSaddr" SG_ 437791610 IOM_A_34_VFG_OIL_TEMP20_A_65 176;
BA_ "AfdxFDSaddr" SG_ 437791610 IOM_A_34_VFG_OIL_TEMP20_A_65 176;
BA_ "AfdxFDSlength" SG_ 437791610 IOM_A_34_VFG_OIL_TEMP20_A_65 4;
BA_ "AfdxFDSname" SG_ 437791610 IOM_A_34_VFG_OIL_TEMP20_A_65 "FDS_HSMU_TEST20_35";
BA_ "AfdxSignalType" SG_ 437791610 IOM_A_34_VFG_OIL_TEMP20_A_65 "Integer";
BA_ "AfdxFSaddr" SG_ 437791610 FS_HSMU_TEST20_35 176;
BA_ "AfdxFDSaddr" SG_ 437791610 FS_HSMU_TEST20_35 176;
BA_ "AfdxFDSlength" SG_ 437791610 FS_HSMU_TEST20_35 4;
BA_ "AfdxFDSname" SG_ 437791610 FS_HSMU_TEST20_35 "FDS_HSMU_TEST20_35";
BA_ "AfdxSignalType" SG_ 437791610 FS_HSMU_TEST20_35 "Enumerate";
BA_ "AfdxFSaddr" SG_ 437791610 IOM_A_34_VFG_OIL_TEMP20_A_64 172;
BA_ "AfdxFDSaddr" SG_ 437791610 IOM_A_34_VFG_OIL_TEMP20_A_64 172;
BA_ "AfdxFDSlength" SG_ 437791610 IOM_A_34_VFG_OIL_TEMP20_A_64 4;
BA_ "AfdxFDSname" SG_ 437791610 IOM_A_34_VFG_OIL_TEMP20_A_64 "FDS_HSMU_TEST20_34";
BA_ "AfdxSignalType" SG_ 437791610 IOM_A_34_VFG_OIL_TEMP20_A_64 "Integer";
BA_ "AfdxFSaddr" SG_ 437791610 FS_HSMU_TEST20_34 172;
BA_ "AfdxFDSaddr" SG_ 437791610 FS_HSMU_TEST20_34 172;
BA_ "AfdxFDSlength" SG_ 437791610 FS_HSMU_TEST20_34 4;
BA_ "AfdxFDSname" SG_ 437791610 FS_HSMU_TEST20_34 "FDS_HSMU_TEST20_34";
BA_ "AfdxSignalType" SG_ 437791610 FS_HSMU_TEST20_34 "Enumerate";
BA_ "AfdxFSaddr" SG_ 437791610 IOM_A_34_VFG_OIL_TEMP20_A_63 168;
BA_ "AfdxFDSaddr" SG_ 437791610 IOM_A_34_VFG_OIL_TEMP20_A_63 168;
BA_ "AfdxFDSlength" SG_ 437791610 IOM_A_34_VFG_OIL_TEMP20_A_63 4;
BA_ "AfdxFDSname" SG_ 437791610 IOM_A_34_VFG_OIL_TEMP20_A_63 "FDS_HSMU_TEST20_33";
BA_ "AfdxSignalType" SG_ 437791610 IOM_A_34_VFG_OIL_TEMP20_A_63 "Integer";
BA_ "AfdxFSaddr" SG_ 437791610 FS_HSMU_TEST20_33 168;
BA_ "AfdxFDSaddr" SG_ 437791610 FS_HSMU_TEST20_33 168;
BA_ "AfdxFDSlength" SG_ 437791610 FS_HSMU_TEST20_33 4;
BA_ "AfdxFDSname" SG_ 437791610 FS_HSMU_TEST20_33 "FDS_HSMU_TEST20_33";
BA_ "AfdxSignalType" SG_ 437791610 FS_HSMU_TEST20_33 "Enumerate";
BA_ "AfdxFSaddr" SG_ 437791610 IOM_A_34_VFG_OIL_TEMP20_A_62 160;
BA_ "AfdxFDSaddr" SG_ 437791610 IOM_A_34_VFG_OIL_TEMP20_A_62 160;
BA_ "AfdxFDSlength" SG_ 437791610 IOM_A_34_VFG_OIL_TEMP20_A_62 4;
BA_ "AfdxFDSname" SG_ 437791610 IOM_A_34_VFG_OIL_TEMP20_A_62 "FDS_HSMU_TEST20_32";
BA_ "AfdxSignalType" SG_ 437791610 IOM_A_34_VFG_OIL_TEMP20_A_62 "Integer";
BA_ "AfdxFSaddr" SG_ 437791610 FS_HSMU_TEST20_32 160;
BA_ "AfdxFDSaddr" SG_ 437791610 FS_HSMU_TEST20_32 160;
BA_ "AfdxFDSlength" SG_ 437791610 FS_HSMU_TEST20_32 4;
BA_ "AfdxFDSname" SG_ 437791610 FS_HSMU_TEST20_32 "FDS_HSMU_TEST20_32";
BA_ "AfdxSignalType" SG_ 437791610 FS_HSMU_TEST20_32 "Enumerate";
BA_ "AfdxFSaddr" SG_ 437791610 IOM_A_34_VFG_OIL_TEMP20_A_61 156;
BA_ "AfdxFDSaddr" SG_ 437791610 IOM_A_34_VFG_OIL_TEMP20_A_61 156;
BA_ "AfdxFDSlength" SG_ 437791610 IOM_A_34_VFG_OIL_TEMP20_A_61 4;
BA_ "AfdxFDSname" SG_ 437791610 IOM_A_34_VFG_OIL_TEMP20_A_61 "FDS_HSMU_TEST20_31";
BA_ "AfdxSignalType" SG_ 437791610 IOM_A_34_VFG_OIL_TEMP20_A_61 "Integer";
BA_ "AfdxFSaddr" SG_ 437791610 FS_HSMU_TEST20_31 156;
BA_ "AfdxFDSaddr" SG_ 437791610 FS_HSMU_TEST20_31 156;
BA_ "AfdxFDSlength" SG_ 437791610 FS_HSMU_TEST20_31 4;
BA_ "AfdxFDSname" SG_ 437791610 FS_HSMU_TEST20_31 "FDS_HSMU_TEST20_31";
BA_ "AfdxSignalType" SG_ 437791610 FS_HSMU_TEST20_31 "Enumerate";
BA_ "AfdxFSaddr" SG_ 437791610 IOM_A_34_VFG_OIL_TEMP20_A_60 152;
BA_ "AfdxFDSaddr" SG_ 437791610 IOM_A_34_VFG_OIL_TEMP20_A_60 152;
BA_ "AfdxFDSlength" SG_ 437791610 IOM_A_34_VFG_OIL_TEMP20_A_60 4;
BA_ "AfdxFDSname" SG_ 437791610 IOM_A_34_VFG_OIL_TEMP20_A_60 "FDS_HSMU_TEST20_30";
BA_ "AfdxSignalType" SG_ 437791610 IOM_A_34_VFG_OIL_TEMP20_A_60 "Integer";
BA_ "AfdxFSaddr" SG_ 437791610 FS_HSMU_TEST20_30 152;
BA_ "AfdxFDSaddr" SG_ 437791610 FS_HSMU_TEST20_30 152;
BA_ "AfdxFDSlength" SG_ 437791610 FS_HSMU_TEST20_30 4;
BA_ "AfdxFDSname" SG_ 437791610 FS_HSMU_TEST20_30 "FDS_HSMU_TEST20_30";
BA_ "AfdxSignalType" SG_ 437791610 FS_HSMU_TEST20_30 "Enumerate";
BA_ "AfdxFSaddr" SG_ 437791610 IOM_A_34_VFG_OIL_TEMP20_A_59 148;
BA_ "AfdxFDSaddr" SG_ 437791610 IOM_A_34_VFG_OIL_TEMP20_A_59 148;
BA_ "AfdxFDSlength" SG_ 437791610 IOM_A_34_VFG_OIL_TEMP20_A_59 4;
BA_ "AfdxFDSname" SG_ 437791610 IOM_A_34_VFG_OIL_TEMP20_A_59 "FDS_HSMU_TEST20_29";
BA_ "AfdxSignalType" SG_ 437791610 IOM_A_34_VFG_OIL_TEMP20_A_59 "Integer";
BA_ "AfdxFSaddr" SG_ 437791610 FS_HSMU_TEST20_29 148;
BA_ "AfdxFDSaddr" SG_ 437791610 FS_HSMU_TEST20_29 148;
BA_ "AfdxFDSlength" SG_ 437791610 FS_HSMU_TEST20_29 4;
BA_ "AfdxFDSname" SG_ 437791610 FS_HSMU_TEST20_29 "FDS_HSMU_TEST20_29";
BA_ "AfdxSignalType" SG_ 437791610 FS_HSMU_TEST20_29 "Enumerate";
BA_ "AfdxFSaddr" SG_ 437791610 IOM_A_34_VFG_OIL_TEMP20_A_58 140;
BA_ "AfdxFDSaddr" SG_ 437791610 IOM_A_34_VFG_OIL_TEMP20_A_58 140;
BA_ "AfdxFDSlength" SG_ 437791610 IOM_A_34_VFG_OIL_TEMP20_A_58 4;
BA_ "AfdxFDSname" SG_ 437791610 IOM_A_34_VFG_OIL_TEMP20_A_58 "FDS_HSMU_TEST20_28";
BA_ "AfdxSignalType" SG_ 437791610 IOM_A_34_VFG_OIL_TEMP20_A_58 "Integer";
BA_ "AfdxFSaddr" SG_ 437791610 FS_HSMU_TEST20_28 140;
BA_ "AfdxFDSaddr" SG_ 437791610 FS_HSMU_TEST20_28 140;
BA_ "AfdxFDSlength" SG_ 437791610 FS_HSMU_TEST20_28 4;
BA_ "AfdxFDSname" SG_ 437791610 FS_HSMU_TEST20_28 "FDS_HSMU_TEST20_28";
BA_ "AfdxSignalType" SG_ 437791610 FS_HSMU_TEST20_28 "Enumerate";
BA_ "AfdxFSaddr" SG_ 437791610 IOM_A_34_VFG_OIL_TEMP20_A_57 136;
BA_ "AfdxFDSaddr" SG_ 437791610 IOM_A_34_VFG_OIL_TEMP20_A_57 136;
BA_ "AfdxFDSlength" SG_ 437791610 IOM_A_34_VFG_OIL_TEMP20_A_57 4;
BA_ "AfdxFDSname" SG_ 437791610 IOM_A_34_VFG_OIL_TEMP20_A_57 "FDS_HSMU_TEST20_27";
BA_ "AfdxSignalType" SG_ 437791610 IOM_A_34_VFG_OIL_TEMP20_A_57 "Integer";
BA_ "AfdxFSaddr" SG_ 437791610 FS_HSMU_TEST20_27 136;
BA_ "AfdxFDSaddr" SG_ 437791610 FS_HSMU_TEST20_27 136;
BA_ "AfdxFDSlength" SG_ 437791610 FS_HSMU_TEST20_27 4;
BA_ "AfdxFDSname" SG_ 437791610 FS_HSMU_TEST20_27 "FDS_HSMU_TEST20_27";
BA_ "AfdxSignalType" SG_ 437791610 FS_HSMU_TEST20_27 "Enumerate";
BA_ "AfdxFSaddr" SG_ 437791610 IOM_A_34_VFG_OIL_TEMP20_A_56 132;
BA_ "AfdxFDSaddr" SG_ 437791610 IOM_A_34_VFG_OIL_TEMP20_A_56 132;
BA_ "AfdxFDSlength" SG_ 437791610 IOM_A_34_VFG_OIL_TEMP20_A_56 4;
BA_ "AfdxFDSname" SG_ 437791610 IOM_A_34_VFG_OIL_TEMP20_A_56 "FDS_HSMU_TEST20_26";
BA_ "AfdxSignalType" SG_ 437791610 IOM_A_34_VFG_OIL_TEMP20_A_56 "Integer";
BA_ "AfdxFSaddr" SG_ 437791610 FS_HSMU_TEST20_26 132;
BA_ "AfdxFDSaddr" SG_ 437791610 FS_HSMU_TEST20_26 132;
BA_ "AfdxFDSlength" SG_ 437791610 FS_HSMU_TEST20_26 4;
BA_ "AfdxFDSname" SG_ 437791610 FS_HSMU_TEST20_26 "FDS_HSMU_TEST20_26";
BA_ "AfdxSignalType" SG_ 437791610 FS_HSMU_TEST20_26 "Enumerate";
BA_ "AfdxFSaddr" SG_ 437791610 IOM_A_34_VFG_OIL_TEMP20_A_55 128;
BA_ "AfdxFDSaddr" SG_ 437791610 IOM_A_34_VFG_OIL_TEMP20_A_55 128;
BA_ "AfdxFDSlength" SG_ 437791610 IOM_A_34_VFG_OIL_TEMP20_A_55 4;
BA_ "AfdxFDSname" SG_ 437791610 IOM_A_34_VFG_OIL_TEMP20_A_55 "FDS_HSMU_TEST20_25";
BA_ "AfdxSignalType" SG_ 437791610 IOM_A_34_VFG_OIL_TEMP20_A_55 "Integer";
BA_ "AfdxFSaddr" SG_ 437791610 FS_HSMU_TEST20_25 128;
BA_ "AfdxFDSaddr" SG_ 437791610 FS_HSMU_TEST20_25 128;
BA_ "AfdxFDSlength" SG_ 437791610 FS_HSMU_TEST20_25 4;
BA_ "AfdxFDSname" SG_ 437791610 FS_HSMU_TEST20_25 "FDS_HSMU_TEST20_25";
BA_ "AfdxSignalType" SG_ 437791610 FS_HSMU_TEST20_25 "Enumerate";
BA_ "AfdxFSaddr" SG_ 437791610 IOM_A_34_VFG_OIL_TEMP20_A_54 120;
BA_ "AfdxFDSaddr" SG_ 437791610 IOM_A_34_VFG_OIL_TEMP20_A_54 120;
BA_ "AfdxFDSlength" SG_ 437791610 IOM_A_34_VFG_OIL_TEMP20_A_54 4;
BA_ "AfdxFDSname" SG_ 437791610 IOM_A_34_VFG_OIL_TEMP20_A_54 "FDS_HSMU_TEST20_24";
BA_ "AfdxSignalType" SG_ 437791610 IOM_A_34_VFG_OIL_TEMP20_A_54 "Integer";
BA_ "AfdxFSaddr" SG_ 437791610 FS_HSMU_TEST20_24 120;
BA_ "AfdxFDSaddr" SG_ 437791610 FS_HSMU_TEST20_24 120;
BA_ "AfdxFDSlength" SG_ 437791610 FS_HSMU_TEST20_24 4;
BA_ "AfdxFDSname" SG_ 437791610 FS_HSMU_TEST20_24 "FDS_HSMU_TEST20_24";
BA_ "AfdxSignalType" SG_ 437791610 FS_HSMU_TEST20_24 "Enumerate";
BA_ "AfdxFSaddr" SG_ 437791610 IOM_A_34_VFG_OIL_TEMP20_A_53 116;
BA_ "AfdxFDSaddr" SG_ 437791610 IOM_A_34_VFG_OIL_TEMP20_A_53 116;
BA_ "AfdxFDSlength" SG_ 437791610 IOM_A_34_VFG_OIL_TEMP20_A_53 4;
BA_ "AfdxFDSname" SG_ 437791610 IOM_A_34_VFG_OIL_TEMP20_A_53 "FDS_HSMU_TEST20_23";
BA_ "AfdxSignalType" SG_ 437791610 IOM_A_34_VFG_OIL_TEMP20_A_53 "Integer";
BA_ "AfdxFSaddr" SG_ 437791610 FS_HSMU_TEST20_23 116;
BA_ "AfdxFDSaddr" SG_ 437791610 FS_HSMU_TEST20_23 116;
BA_ "AfdxFDSlength" SG_ 437791610 FS_HSMU_TEST20_23 4;
BA_ "AfdxFDSname" SG_ 437791610 FS_HSMU_TEST20_23 "FDS_HSMU_TEST20_23";
BA_ "AfdxSignalType" SG_ 437791610 FS_HSMU_TEST20_23 "Enumerate";
BA_ "AfdxFSaddr" SG_ 437791610 IOM_A_34_VFG_OIL_TEMP20_A_52 112;
BA_ "AfdxFDSaddr" SG_ 437791610 IOM_A_34_VFG_OIL_TEMP20_A_52 112;
BA_ "AfdxFDSlength" SG_ 437791610 IOM_A_34_VFG_OIL_TEMP20_A_52 4;
BA_ "AfdxFDSname" SG_ 437791610 IOM_A_34_VFG_OIL_TEMP20_A_52 "FDS_HSMU_TEST20_22";
BA_ "AfdxSignalType" SG_ 437791610 IOM_A_34_VFG_OIL_TEMP20_A_52 "Integer";
BA_ "AfdxFSaddr" SG_ 437791610 FS_HSMU_TEST20_22 112;
BA_ "AfdxFDSaddr" SG_ 437791610 FS_HSMU_TEST20_22 112;
BA_ "AfdxFDSlength" SG_ 437791610 FS_HSMU_TEST20_22 4;
BA_ "AfdxFDSname" SG_ 437791610 FS_HSMU_TEST20_22 "FDS_HSMU_TEST20_22";
BA_ "AfdxSignalType" SG_ 437791610 FS_HSMU_TEST20_22 "Enumerate";
BA_ "AfdxFSaddr" SG_ 437791610 IOM_A_34_VFG_OIL_TEMP20_A_51 108;
BA_ "AfdxFDSaddr" SG_ 437791610 IOM_A_34_VFG_OIL_TEMP20_A_51 108;
BA_ "AfdxFDSlength" SG_ 437791610 IOM_A_34_VFG_OIL_TEMP20_A_51 4;
BA_ "AfdxFDSname" SG_ 437791610 IOM_A_34_VFG_OIL_TEMP20_A_51 "FDS_HSMU_TEST20_21";
BA_ "AfdxSignalType" SG_ 437791610 IOM_A_34_VFG_OIL_TEMP20_A_51 "Integer";
BA_ "AfdxFSaddr" SG_ 437791610 FS_HSMU_TEST20_21 108;
BA_ "AfdxFDSaddr" SG_ 437791610 FS_HSMU_TEST20_21 108;
BA_ "AfdxFDSlength" SG_ 437791610 FS_HSMU_TEST20_21 4;
BA_ "AfdxFDSname" SG_ 437791610 FS_HSMU_TEST20_21 "FDS_HSMU_TEST20_21";
BA_ "AfdxSignalType" SG_ 437791610 FS_HSMU_TEST20_21 "Enumerate";
BA_ "AfdxFSaddr" SG_ 437791610 IOM_A_34_VFG_OIL_TEMP20_A_50 100;
BA_ "AfdxFDSaddr" SG_ 437791610 IOM_A_34_VFG_OIL_TEMP20_A_50 100;
BA_ "AfdxFDSlength" SG_ 437791610 IOM_A_34_VFG_OIL_TEMP20_A_50 4;
BA_ "AfdxFDSname" SG_ 437791610 IOM_A_34_VFG_OIL_TEMP20_A_50 "FDS_HSMU_TEST20_20";
BA_ "AfdxSignalType" SG_ 437791610 IOM_A_34_VFG_OIL_TEMP20_A_50 "Integer";
BA_ "AfdxFSaddr" SG_ 437791610 FS_HSMU_TEST20_20 100;
BA_ "AfdxFDSaddr" SG_ 437791610 FS_HSMU_TEST20_20 100;
BA_ "AfdxFDSlength" SG_ 437791610 FS_HSMU_TEST20_20 4;
BA_ "AfdxFDSname" SG_ 437791610 FS_HSMU_TEST20_20 "FDS_HSMU_TEST20_20";
BA_ "AfdxSignalType" SG_ 437791610 FS_HSMU_TEST20_20 "Enumerate";
BA_ "AfdxFSaddr" SG_ 437791610 IOM_A_34_VFG_OIL_TEMP20_A_49 96;
BA_ "AfdxFDSaddr" SG_ 437791610 IOM_A_34_VFG_OIL_TEMP20_A_49 96;
BA_ "AfdxFDSlength" SG_ 437791610 IOM_A_34_VFG_OIL_TEMP20_A_49 4;
BA_ "AfdxFDSname" SG_ 437791610 IOM_A_34_VFG_OIL_TEMP20_A_49 "FDS_HSMU_TEST20_19";
BA_ "AfdxSignalType" SG_ 437791610 IOM_A_34_VFG_OIL_TEMP20_A_49 "Integer";
BA_ "AfdxFSaddr" SG_ 437791610 FS_HSMU_TEST20_19 96;
BA_ "AfdxFDSaddr" SG_ 437791610 FS_HSMU_TEST20_19 96;
BA_ "AfdxFDSlength" SG_ 437791610 FS_HSMU_TEST20_19 4;
BA_ "AfdxFDSname" SG_ 437791610 FS_HSMU_TEST20_19 "FDS_HSMU_TEST20_19";
BA_ "AfdxSignalType" SG_ 437791610 FS_HSMU_TEST20_19 "Enumerate";
BA_ "AfdxFSaddr" SG_ 437791610 IOM_A_34_VFG_OIL_TEMP20_A_48 92;
BA_ "AfdxFDSaddr" SG_ 437791610 IOM_A_34_VFG_OIL_TEMP20_A_48 92;
BA_ "AfdxFDSlength" SG_ 437791610 IOM_A_34_VFG_OIL_TEMP20_A_48 4;
BA_ "AfdxFDSname" SG_ 437791610 IOM_A_34_VFG_OIL_TEMP20_A_48 "FDS_HSMU_TEST20_18";
BA_ "AfdxSignalType" SG_ 437791610 IOM_A_34_VFG_OIL_TEMP20_A_48 "Integer";
BA_ "AfdxFSaddr" SG_ 437791610 FS_HSMU_TEST20_18 92;
BA_ "AfdxFDSaddr" SG_ 437791610 FS_HSMU_TEST20_18 92;
BA_ "AfdxFDSlength" SG_ 437791610 FS_HSMU_TEST20_18 4;
BA_ "AfdxFDSname" SG_ 437791610 FS_HSMU_TEST20_18 "FDS_HSMU_TEST20_18";
BA_ "AfdxSignalType" SG_ 437791610 FS_HSMU_TEST20_18 "Enumerate";
BA_ "AfdxFSaddr" SG_ 437791610 IOM_A_34_VFG_OIL_TEMP20_A_47 88;
BA_ "AfdxFDSaddr" SG_ 437791610 IOM_A_34_VFG_OIL_TEMP20_A_47 88;
BA_ "AfdxFDSlength" SG_ 437791610 IOM_A_34_VFG_OIL_TEMP20_A_47 4;
BA_ "AfdxFDSname" SG_ 437791610 IOM_A_34_VFG_OIL_TEMP20_A_47 "FDS_HSMU_TEST20_17";
BA_ "AfdxSignalType" SG_ 437791610 IOM_A_34_VFG_OIL_TEMP20_A_47 "Integer";
BA_ "AfdxFSaddr" SG_ 437791610 FS_HSMU_TEST20_17 88;
BA_ "AfdxFDSaddr" SG_ 437791610 FS_HSMU_TEST20_17 88;
BA_ "AfdxFDSlength" SG_ 437791610 FS_HSMU_TEST20_17 4;
BA_ "AfdxFDSname" SG_ 437791610 FS_HSMU_TEST20_17 "FDS_HSMU_TEST20_17";
BA_ "AfdxSignalType" SG_ 437791610 FS_HSMU_TEST20_17 "Enumerate";
BA_ "AfdxFSaddr" SG_ 437791610 IOM_A_34_VFG_OIL_TEMP20_A_46 80;
BA_ "AfdxFDSaddr" SG_ 437791610 IOM_A_34_VFG_OIL_TEMP20_A_46 80;
BA_ "AfdxFDSlength" SG_ 437791610 IOM_A_34_VFG_OIL_TEMP20_A_46 4;
BA_ "AfdxFDSname" SG_ 437791610 IOM_A_34_VFG_OIL_TEMP20_A_46 "FDS_HSMU_TEST20_16";
BA_ "AfdxSignalType" SG_ 437791610 IOM_A_34_VFG_OIL_TEMP20_A_46 "Integer";
BA_ "AfdxFSaddr" SG_ 437791610 FS_HSMU_TEST20_16 80;
BA_ "AfdxFDSaddr" SG_ 437791610 FS_HSMU_TEST20_16 80;
BA_ "AfdxFDSlength" SG_ 437791610 FS_HSMU_TEST20_16 4;
BA_ "AfdxFDSname" SG_ 437791610 FS_HSMU_TEST20_16 "FDS_HSMU_TEST20_16";
BA_ "AfdxSignalType" SG_ 437791610 FS_HSMU_TEST20_16 "Enumerate";
BA_ "AfdxFSaddr" SG_ 437791610 IOM_A_34_VFG_OIL_TEMP20_A_45 76;
BA_ "AfdxFDSaddr" SG_ 437791610 IOM_A_34_VFG_OIL_TEMP20_A_45 76;
BA_ "AfdxFDSlength" SG_ 437791610 IOM_A_34_VFG_OIL_TEMP20_A_45 4;
BA_ "AfdxFDSname" SG_ 437791610 IOM_A_34_VFG_OIL_TEMP20_A_45 "FDS_HSMU_TEST20_15";
BA_ "AfdxSignalType" SG_ 437791610 IOM_A_34_VFG_OIL_TEMP20_A_45 "Integer";
BA_ "AfdxFSaddr" SG_ 437791610 FS_HSMU_TEST20_15 76;
BA_ "AfdxFDSaddr" SG_ 437791610 FS_HSMU_TEST20_15 76;
BA_ "AfdxFDSlength" SG_ 437791610 FS_HSMU_TEST20_15 4;
BA_ "AfdxFDSname" SG_ 437791610 FS_HSMU_TEST20_15 "FDS_HSMU_TEST20_15";
BA_ "AfdxSignalType" SG_ 437791610 FS_HSMU_TEST20_15 "Enumerate";
BA_ "AfdxFSaddr" SG_ 437791610 IOM_A_34_VFG_OIL_TEMP20_A_44 72;
BA_ "AfdxFDSaddr" SG_ 437791610 IOM_A_34_VFG_OIL_TEMP20_A_44 72;
BA_ "AfdxFDSlength" SG_ 437791610 IOM_A_34_VFG_OIL_TEMP20_A_44 4;
BA_ "AfdxFDSname" SG_ 437791610 IOM_A_34_VFG_OIL_TEMP20_A_44 "FDS_HSMU_TEST20_14";
BA_ "AfdxSignalType" SG_ 437791610 IOM_A_34_VFG_OIL_TEMP20_A_44 "Integer";
BA_ "AfdxFSaddr" SG_ 437791610 FS_HSMU_TEST20_14 72;
BA_ "AfdxFDSaddr" SG_ 437791610 FS_HSMU_TEST20_14 72;
BA_ "AfdxFDSlength" SG_ 437791610 FS_HSMU_TEST20_14 4;
BA_ "AfdxFDSname" SG_ 437791610 FS_HSMU_TEST20_14 "FDS_HSMU_TEST20_14";
BA_ "AfdxSignalType" SG_ 437791610 FS_HSMU_TEST20_14 "Enumerate";
BA_ "AfdxFSaddr" SG_ 437791610 IOM_A_34_VFG_OIL_TEMP20_A_43 68;
BA_ "AfdxFDSaddr" SG_ 437791610 IOM_A_34_VFG_OIL_TEMP20_A_43 68;
BA_ "AfdxFDSlength" SG_ 437791610 IOM_A_34_VFG_OIL_TEMP20_A_43 4;
BA_ "AfdxFDSname" SG_ 437791610 IOM_A_34_VFG_OIL_TEMP20_A_43 "FDS_HSMU_TEST20_13";
BA_ "AfdxSignalType" SG_ 437791610 IOM_A_34_VFG_OIL_TEMP20_A_43 "Integer";
BA_ "AfdxFSaddr" SG_ 437791610 FS_HSMU_TEST20_13 68;
BA_ "AfdxFDSaddr" SG_ 437791610 FS_HSMU_TEST20_13 68;
BA_ "AfdxFDSlength" SG_ 437791610 FS_HSMU_TEST20_13 4;
BA_ "AfdxFDSname" SG_ 437791610 FS_HSMU_TEST20_13 "FDS_HSMU_TEST20_13";
BA_ "AfdxSignalType" SG_ 437791610 FS_HSMU_TEST20_13 "Enumerate";
BA_ "AfdxFSaddr" SG_ 437791610 IOM_A_34_VFG_OIL_TEMP20_A_42 60;
BA_ "AfdxFDSaddr" SG_ 437791610 IOM_A_34_VFG_OIL_TEMP20_A_42 60;
BA_ "AfdxFDSlength" SG_ 437791610 IOM_A_34_VFG_OIL_TEMP20_A_42 4;
BA_ "AfdxFDSname" SG_ 437791610 IOM_A_34_VFG_OIL_TEMP20_A_42 "FDS_HSMU_TEST20_12";
BA_ "AfdxSignalType" SG_ 437791610 IOM_A_34_VFG_OIL_TEMP20_A_42 "Integer";
BA_ "AfdxFSaddr" SG_ 437791610 FS_HSMU_TEST20_12 60;
BA_ "AfdxFDSaddr" SG_ 437791610 FS_HSMU_TEST20_12 60;
BA_ "AfdxFDSlength" SG_ 437791610 FS_HSMU_TEST20_12 4;
BA_ "AfdxFDSname" SG_ 437791610 FS_HSMU_TEST20_12 "FDS_HSMU_TEST20_12";
BA_ "AfdxSignalType" SG_ 437791610 FS_HSMU_TEST20_12 "Enumerate";
BA_ "AfdxFSaddr" SG_ 437791610 IOM_A_34_VFG_OIL_TEMP20_A_41 56;
BA_ "AfdxFDSaddr" SG_ 437791610 IOM_A_34_VFG_OIL_TEMP20_A_41 56;
BA_ "AfdxFDSlength" SG_ 437791610 IOM_A_34_VFG_OIL_TEMP20_A_41 4;
BA_ "AfdxFDSname" SG_ 437791610 IOM_A_34_VFG_OIL_TEMP20_A_41 "FDS_HSMU_TEST20_11";
BA_ "AfdxSignalType" SG_ 437791610 IOM_A_34_VFG_OIL_TEMP20_A_41 "Integer";
BA_ "AfdxFSaddr" SG_ 437791610 FS_HSMU_TEST20_11 56;
BA_ "AfdxFDSaddr" SG_ 437791610 FS_HSMU_TEST20_11 56;
BA_ "AfdxFDSlength" SG_ 437791610 FS_HSMU_TEST20_11 4;
BA_ "AfdxFDSname" SG_ 437791610 FS_HSMU_TEST20_11 "FDS_HSMU_TEST20_11";
BA_ "AfdxSignalType" SG_ 437791610 FS_HSMU_TEST20_11 "Enumerate";
BA_ "AfdxFSaddr" SG_ 437791610 IOM_A_34_VFG_OIL_TEMP20_A_40 52;
BA_ "AfdxFDSaddr" SG_ 437791610 IOM_A_34_VFG_OIL_TEMP20_A_40 52;
BA_ "AfdxFDSlength" SG_ 437791610 IOM_A_34_VFG_OIL_TEMP20_A_40 4;
BA_ "AfdxFDSname" SG_ 437791610 IOM_A_34_VFG_OIL_TEMP20_A_40 "FDS_HSMU_TEST20_10";
BA_ "AfdxSignalType" SG_ 437791610 IOM_A_34_VFG_OIL_TEMP20_A_40 "Integer";
BA_ "AfdxFSaddr" SG_ 437791610 FS_HSMU_TEST20_10 52;
BA_ "AfdxFDSaddr" SG_ 437791610 FS_HSMU_TEST20_10 52;
BA_ "AfdxFDSlength" SG_ 437791610 FS_HSMU_TEST20_10 4;
BA_ "AfdxFDSname" SG_ 437791610 FS_HSMU_TEST20_10 "FDS_HSMU_TEST20_10";
BA_ "AfdxSignalType" SG_ 437791610 FS_HSMU_TEST20_10 "Enumerate";
BA_ "AfdxFSaddr" SG_ 437791610 IOM_A_34_VFG_OIL_TEMP20_A_39 48;
BA_ "AfdxFDSaddr" SG_ 437791610 IOM_A_34_VFG_OIL_TEMP20_A_39 48;
BA_ "AfdxFDSlength" SG_ 437791610 IOM_A_34_VFG_OIL_TEMP20_A_39 4;
BA_ "AfdxFDSname" SG_ 437791610 IOM_A_34_VFG_OIL_TEMP20_A_39 "FDS_HSMU_TEST20_9";
BA_ "AfdxSignalType" SG_ 437791610 IOM_A_34_VFG_OIL_TEMP20_A_39 "Integer";
BA_ "AfdxFSaddr" SG_ 437791610 FS_HSMU_TEST20_9 48;
BA_ "AfdxFDSaddr" SG_ 437791610 FS_HSMU_TEST20_9 48;
BA_ "AfdxFDSlength" SG_ 437791610 FS_HSMU_TEST20_9 4;
BA_ "AfdxFDSname" SG_ 437791610 FS_HSMU_TEST20_9 "FDS_HSMU_TEST20_9";
BA_ "AfdxSignalType" SG_ 437791610 FS_HSMU_TEST20_9 "Enumerate";
BA_ "AfdxFSaddr" SG_ 437791610 IOM_A_34_VFG_OIL_TEMP20_A_38 40;
BA_ "AfdxFDSaddr" SG_ 437791610 IOM_A_34_VFG_OIL_TEMP20_A_38 40;
BA_ "AfdxFDSlength" SG_ 437791610 IOM_A_34_VFG_OIL_TEMP20_A_38 4;
BA_ "AfdxFDSname" SG_ 437791610 IOM_A_34_VFG_OIL_TEMP20_A_38 "FDS_HSMU_TEST20_8";
BA_ "AfdxSignalType" SG_ 437791610 IOM_A_34_VFG_OIL_TEMP20_A_38 "Integer";
BA_ "AfdxFSaddr" SG_ 437791610 FS_HSMU_TEST20_8 40;
BA_ "AfdxFDSaddr" SG_ 437791610 FS_HSMU_TEST20_8 40;
BA_ "AfdxFDSlength" SG_ 437791610 FS_HSMU_TEST20_8 4;
BA_ "AfdxFDSname" SG_ 437791610 FS_HSMU_TEST20_8 "FDS_HSMU_TEST20_8";
BA_ "AfdxSignalType" SG_ 437791610 FS_HSMU_TEST20_8 "Enumerate";
BA_ "AfdxFSaddr" SG_ 437791610 IOM_A_34_VFG_OIL_TEMP20_A_37 36;
BA_ "AfdxFDSaddr" SG_ 437791610 IOM_A_34_VFG_OIL_TEMP20_A_37 36;
BA_ "AfdxFDSlength" SG_ 437791610 IOM_A_34_VFG_OIL_TEMP20_A_37 4;
BA_ "AfdxFDSname" SG_ 437791610 IOM_A_34_VFG_OIL_TEMP20_A_37 "FDS_HSMU_TEST20_7";
BA_ "AfdxSignalType" SG_ 437791610 IOM_A_34_VFG_OIL_TEMP20_A_37 "Integer";
BA_ "AfdxFSaddr" SG_ 437791610 FS_HSMU_TEST20_7 36;
BA_ "AfdxFDSaddr" SG_ 437791610 FS_HSMU_TEST20_7 36;
BA_ "AfdxFDSlength" SG_ 437791610 FS_HSMU_TEST20_7 4;
BA_ "AfdxFDSname" SG_ 437791610 FS_HSMU_TEST20_7 "FDS_HSMU_TEST20_7";
BA_ "AfdxSignalType" SG_ 437791610 FS_HSMU_TEST20_7 "Enumerate";
BA_ "AfdxFSaddr" SG_ 437791610 IOM_A_34_VFG_OIL_TEMP20_A_36 32;
BA_ "AfdxFDSaddr" SG_ 437791610 IOM_A_34_VFG_OIL_TEMP20_A_36 32;
BA_ "AfdxFDSlength" SG_ 437791610 IOM_A_34_VFG_OIL_TEMP20_A_36 4;
BA_ "AfdxFDSname" SG_ 437791610 IOM_A_34_VFG_OIL_TEMP20_A_36 "FDS_HSMU_TEST20_6";
BA_ "AfdxSignalType" SG_ 437791610 IOM_A_34_VFG_OIL_TEMP20_A_36 "Integer";
BA_ "AfdxFSaddr" SG_ 437791610 FS_HSMU_TEST20_6 32;
BA_ "AfdxFDSaddr" SG_ 437791610 FS_HSMU_TEST20_6 32;
BA_ "AfdxFDSlength" SG_ 437791610 FS_HSMU_TEST20_6 4;
BA_ "AfdxFDSname" SG_ 437791610 FS_HSMU_TEST20_6 "FDS_HSMU_TEST20_6";
BA_ "AfdxSignalType" SG_ 437791610 FS_HSMU_TEST20_6 "Enumerate";
BA_ "AfdxFSaddr" SG_ 437791610 IOM_A_34_VFG_OIL_TEMP20_A_35 28;
BA_ "AfdxFDSaddr" SG_ 437791610 IOM_A_34_VFG_OIL_TEMP20_A_35 28;
BA_ "AfdxFDSlength" SG_ 437791610 IOM_A_34_VFG_OIL_TEMP20_A_35 4;
BA_ "AfdxFDSname" SG_ 437791610 IOM_A_34_VFG_OIL_TEMP20_A_35 "FDS_HSMU_TEST20_5";
BA_ "AfdxSignalType" SG_ 437791610 IOM_A_34_VFG_OIL_TEMP20_A_35 "Integer";
BA_ "AfdxFSaddr" SG_ 437791610 FS_HSMU_TEST20_5 28;
BA_ "AfdxFDSaddr" SG_ 437791610 FS_HSMU_TEST20_5 28;
BA_ "AfdxFDSlength" SG_ 437791610 FS_HSMU_TEST20_5 4;
BA_ "AfdxFDSname" SG_ 437791610 FS_HSMU_TEST20_5 "FDS_HSMU_TEST20_5";
BA_ "AfdxSignalType" SG_ 437791610 FS_HSMU_TEST20_5 "Enumerate";
BA_ "AfdxFSaddr" SG_ 437791610 IOM_A_34_VFG_OIL_TEMP20_A_34 20;
BA_ "AfdxFDSaddr" SG_ 437791610 IOM_A_34_VFG_OIL_TEMP20_A_34 20;
BA_ "AfdxFDSlength" SG_ 437791610 IOM_A_34_VFG_OIL_TEMP20_A_34 4;
BA_ "AfdxFDSname" SG_ 437791610 IOM_A_34_VFG_OIL_TEMP20_A_34 "FDS_HSMU_TEST20_4";
BA_ "AfdxSignalType" SG_ 437791610 IOM_A_34_VFG_OIL_TEMP20_A_34 "Integer";
BA_ "AfdxFSaddr" SG_ 437791610 FS_HSMU_TEST20_4 20;
BA_ "AfdxFDSaddr" SG_ 437791610 FS_HSMU_TEST20_4 20;
BA_ "AfdxFDSlength" SG_ 437791610 FS_HSMU_TEST20_4 4;
BA_ "AfdxFDSname" SG_ 437791610 FS_HSMU_TEST20_4 "FDS_HSMU_TEST20_4";
BA_ "AfdxSignalType" SG_ 437791610 FS_HSMU_TEST20_4 "Enumerate";
BA_ "AfdxFSaddr" SG_ 437791610 IOM_A_34_VFG_OIL_TEMP20_A_33 16;
BA_ "AfdxFDSaddr" SG_ 437791610 IOM_A_34_VFG_OIL_TEMP20_A_33 16;
BA_ "AfdxFDSlength" SG_ 437791610 IOM_A_34_VFG_OIL_TEMP20_A_33 4;
BA_ "AfdxFDSname" SG_ 437791610 IOM_A_34_VFG_OIL_TEMP20_A_33 "FDS_HSMU_TEST20_3";
BA_ "AfdxSignalType" SG_ 437791610 IOM_A_34_VFG_OIL_TEMP20_A_33 "Integer";
BA_ "AfdxFSaddr" SG_ 437791610 FS_HSMU_TEST20_3 16;
BA_ "AfdxFDSaddr" SG_ 437791610 FS_HSMU_TEST20_3 16;
BA_ "AfdxFDSlength" SG_ 437791610 FS_HSMU_TEST20_3 4;
BA_ "AfdxFDSname" SG_ 437791610 FS_HSMU_TEST20_3 "FDS_HSMU_TEST20_3";
BA_ "AfdxSignalType" SG_ 437791610 FS_HSMU_TEST20_3 "Enumerate";
BA_ "AfdxFSaddr" SG_ 437791610 IOM_A_34_VFG_OIL_TEMP20_A_32 12;
BA_ "AfdxFDSaddr" SG_ 437791610 IOM_A_34_VFG_OIL_TEMP20_A_32 12;
BA_ "AfdxFDSlength" SG_ 437791610 IOM_A_34_VFG_OIL_TEMP20_A_32 4;
BA_ "AfdxFDSname" SG_ 437791610 IOM_A_34_VFG_OIL_TEMP20_A_32 "FDS_HSMU_TEST20_2";
BA_ "AfdxSignalType" SG_ 437791610 IOM_A_34_VFG_OIL_TEMP20_A_32 "Integer";
BA_ "AfdxFSaddr" SG_ 437791610 FS_HSMU_TEST20_2 12;
BA_ "AfdxFDSaddr" SG_ 437791610 FS_HSMU_TEST20_2 12;
BA_ "AfdxFDSlength" SG_ 437791610 FS_HSMU_TEST20_2 4;
BA_ "AfdxFDSname" SG_ 437791610 FS_HSMU_TEST20_2 "FDS_HSMU_TEST20_2";
BA_ "AfdxSignalType" SG_ 437791610 FS_HSMU_TEST20_2 "Enumerate";
BA_ "AfdxFSaddr" SG_ 437791610 IOM_A_34_VFG_OIL_TEMP20_A_31 8;
BA_ "AfdxFDSaddr" SG_ 437791610 IOM_A_34_VFG_OIL_TEMP20_A_31 8;
BA_ "AfdxFDSlength" SG_ 437791610 IOM_A_34_VFG_OIL_TEMP20_A_31 4;
BA_ "AfdxFDSname" SG_ 437791610 IOM_A_34_VFG_OIL_TEMP20_A_31 "FDS_HSMU_TEST20_1";
BA_ "AfdxSignalType" SG_ 437791610 IOM_A_34_VFG_OIL_TEMP20_A_31 "Integer";
BA_ "AfdxFSaddr" SG_ 437791610 FS_HSMU_TEST20_1 8;
BA_ "AfdxFDSaddr" SG_ 437791610 FS_HSMU_TEST20_1 8;
BA_ "AfdxFDSlength" SG_ 437791610 FS_HSMU_TEST20_1 4;
BA_ "AfdxFDSname" SG_ 437791610 FS_HSMU_TEST20_1 "FDS_HSMU_TEST20_1";
BA_ "AfdxSignalType" SG_ 437791610 FS_HSMU_TEST20_1 "Enumerate";
BA_ "AfdxFSaddr" SG_ 437267314 IOM_A_34_VFG_OIL_TEMP_A_33 16;
BA_ "AfdxFDSaddr" SG_ 437267314 IOM_A_34_VFG_OIL_TEMP_A_33 16;
BA_ "AfdxFDSlength" SG_ 437267314 IOM_A_34_VFG_OIL_TEMP_A_33 4;
BA_ "AfdxFDSname" SG_ 437267314 IOM_A_34_VFG_OIL_TEMP_A_33 "FDS_3_HSMU_TEST_INT3";
BA_ "AfdxSignalType" SG_ 437267314 IOM_A_34_VFG_OIL_TEMP_A_33 "Integer";
BA_ "AfdxFSaddr" SG_ 437267314 FS_FDS_3_HSMU_TEST_INT3 16;
BA_ "AfdxFDSaddr" SG_ 437267314 FS_FDS_3_HSMU_TEST_INT3 16;
BA_ "AfdxFDSlength" SG_ 437267314 FS_FDS_3_HSMU_TEST_INT3 4;
BA_ "AfdxFDSname" SG_ 437267314 FS_FDS_3_HSMU_TEST_INT3 "FDS_3_HSMU_TEST_INT3";
BA_ "AfdxSignalType" SG_ 437267314 FS_FDS_3_HSMU_TEST_INT3 "Enumerate";
BA_ "AfdxFSaddr" SG_ 437267314 IOM_A_34_VFG_OIL_TEMP_A_32 12;
BA_ "AfdxFDSaddr" SG_ 437267314 IOM_A_34_VFG_OIL_TEMP_A_32 12;
BA_ "AfdxFDSlength" SG_ 437267314 IOM_A_34_VFG_OIL_TEMP_A_32 4;
BA_ "AfdxFDSname" SG_ 437267314 IOM_A_34_VFG_OIL_TEMP_A_32 "FDS_2_HSMU_TEST_INT3";
BA_ "AfdxSignalType" SG_ 437267314 IOM_A_34_VFG_OIL_TEMP_A_32 "Integer";
BA_ "AfdxFSaddr" SG_ 437267314 FS_FDS_2_HSMU_TEST_INT3 12;
BA_ "AfdxFDSaddr" SG_ 437267314 FS_FDS_2_HSMU_TEST_INT3 12;
BA_ "AfdxFDSlength" SG_ 437267314 FS_FDS_2_HSMU_TEST_INT3 4;
BA_ "AfdxFDSname" SG_ 437267314 FS_FDS_2_HSMU_TEST_INT3 "FDS_2_HSMU_TEST_INT3";
BA_ "AfdxSignalType" SG_ 437267314 FS_FDS_2_HSMU_TEST_INT3 "Enumerate";
BA_ "AfdxFSaddr" SG_ 437267314 IOM_A_34_VFG_OIL_TEMP_A_31 8;
BA_ "AfdxFDSaddr" SG_ 437267314 IOM_A_34_VFG_OIL_TEMP_A_31 8;
BA_ "AfdxFDSlength" SG_ 437267314 IOM_A_34_VFG_OIL_TEMP_A_31 4;
BA_ "AfdxFDSname" SG_ 437267314 IOM_A_34_VFG_OIL_TEMP_A_31 "FDS_1_HSMU_TEST_INT3";
BA_ "AfdxSignalType" SG_ 437267314 IOM_A_34_VFG_OIL_TEMP_A_31 "Integer";
BA_ "AfdxFSaddr" SG_ 437267314 FS_FDS_1_HSMU_TEST_INT3 8;
BA_ "AfdxFDSaddr" SG_ 437267314 FS_FDS_1_HSMU_TEST_INT3 8;
BA_ "AfdxFDSlength" SG_ 437267314 FS_FDS_1_HSMU_TEST_INT3 4;
BA_ "AfdxFDSname" SG_ 437267314 FS_FDS_1_HSMU_TEST_INT3 "FDS_1_HSMU_TEST_INT3";
BA_ "AfdxSignalType" SG_ 437267314 FS_FDS_1_HSMU_TEST_INT3 "Enumerate";
BA_ "AfdxFSaddr" SG_ 437201777 IOM_A_34_VFG_OIL_TEMP_A_2_22 12;
BA_ "AfdxFDSaddr" SG_ 437201777 IOM_A_34_VFG_OIL_TEMP_A_2_22 12;
BA_ "AfdxFDSlength" SG_ 437201777 IOM_A_34_VFG_OIL_TEMP_A_2_22 4;
BA_ "AfdxFDSname" SG_ 437201777 IOM_A_34_VFG_OIL_TEMP_A_2_22 "FDS_1_HSMU_TEST_INT2";
BA_ "AfdxSignalType" SG_ 437201777 IOM_A_34_VFG_OIL_TEMP_A_2_22 "Integer";
BA_ "AfdxFSaddr" SG_ 437201777 IOM_A_34_VFG_OIL_TEMP_A_2_21 12;
BA_ "AfdxFDSaddr" SG_ 437201777 IOM_A_34_VFG_OIL_TEMP_A_2_21 12;
BA_ "AfdxFDSlength" SG_ 437201777 IOM_A_34_VFG_OIL_TEMP_A_2_21 4;
BA_ "AfdxFDSname" SG_ 437201777 IOM_A_34_VFG_OIL_TEMP_A_2_21 "FDS_1_HSMU_TEST_INT2";
BA_ "AfdxSignalType" SG_ 437201777 IOM_A_34_VFG_OIL_TEMP_A_2_21 "Integer";
BA_ "AfdxFSaddr" SG_ 437201777 FS_FDS_1_HSMU_TEST_INT2 12;
BA_ "AfdxFDSaddr" SG_ 437201777 FS_FDS_1_HSMU_TEST_INT2 12;
BA_ "AfdxFDSlength" SG_ 437201777 FS_FDS_1_HSMU_TEST_INT2 4;
BA_ "AfdxFDSname" SG_ 437201777 FS_FDS_1_HSMU_TEST_INT2 "FDS_1_HSMU_TEST_INT2";
BA_ "AfdxSignalType" SG_ 437201777 FS_FDS_1_HSMU_TEST_INT2 "Enumerate";
BA_ "AfdxFSaddr" SG_ 437136240 IOM_A_34_VFG_OIL_TEMP_A_2_1 8;
BA_ "AfdxFDSaddr" SG_ 437136240 IOM_A_34_VFG_OIL_TEMP_A_2_1 8;
BA_ "AfdxFDSlength" SG_ 437136240 IOM_A_34_VFG_OIL_TEMP_A_2_1 4;
BA_ "AfdxFDSname" SG_ 437136240 IOM_A_34_VFG_OIL_TEMP_A_2_1 "FDS_1_HSMU_TEST_INT1";
BA_ "AfdxSignalType" SG_ 437136240 IOM_A_34_VFG_OIL_TEMP_A_2_1 "Integer";
BA_ "AfdxFSaddr" SG_ 437136240 FS_FDS_1_HSMU_TEST_INT1 8;
BA_ "AfdxFDSaddr" SG_ 437136240 FS_FDS_1_HSMU_TEST_INT1 8;
BA_ "AfdxFDSlength" SG_ 437136240 FS_FDS_1_HSMU_TEST_INT1 4;
BA_ "AfdxFDSname" SG_ 437136240 FS_FDS_1_HSMU_TEST_INT1 "FDS_1_HSMU_TEST_INT1";
BA_ "AfdxSignalType" SG_ 437136240 FS_FDS_1_HSMU_TEST_INT1 "Enumerate";
BA_ "AfdxFSaddr" SG_ 437070703 IOM_A_34_SYS_PRESS_2_YY_10 8;
BA_ "AfdxFDSaddr" SG_ 437070703 IOM_A_34_SYS_PRESS_2_YY_10 8;
BA_ "AfdxFDSlength" SG_ 437070703 IOM_A_34_SYS_PRESS_2_YY_10 4;
BA_ "AfdxFDSname" SG_ 437070703 IOM_A_34_SYS_PRESS_2_YY_10 "FDS_1_HSMU_TEST10_FLOAT";
BA_ "AfdxSignalType" SG_ 437070703 IOM_A_34_SYS_PRESS_2_YY_10 "Float";
BA_ "AfdxFSaddr" SG_ 437070703 FS_FDS_1_HSMU_TEST10_FLOAT 8;
BA_ "AfdxFDSaddr" SG_ 437070703 FS_FDS_1_HSMU_TEST10_FLOAT 8;
BA_ "AfdxFDSlength" SG_ 437070703 FS_FDS_1_HSMU_TEST10_FLOAT 4;
BA_ "AfdxFDSname" SG_ 437070703 FS_FDS_1_HSMU_TEST10_FLOAT "FDS_1_HSMU_TEST10_FLOAT";
BA_ "AfdxSignalType" SG_ 437070703 FS_FDS_1_HSMU_TEST10_FLOAT "Enumerate";
BA_ "AfdxFSaddr" SG_ 437005166 IOM_A_34_SYS_PRESS_2_YY_9 8;
BA_ "AfdxFDSaddr" SG_ 437005166 IOM_A_34_SYS_PRESS_2_YY_9 8;
BA_ "AfdxFDSlength" SG_ 437005166 IOM_A_34_SYS_PRESS_2_YY_9 4;
BA_ "AfdxFDSname" SG_ 437005166 IOM_A_34_SYS_PRESS_2_YY_9 "FDS_1_HSMU_TEST9_FLOAT";
BA_ "AfdxSignalType" SG_ 437005166 IOM_A_34_SYS_PRESS_2_YY_9 "Float";
BA_ "AfdxFSaddr" SG_ 437005166 FS_FDS_1_HSMU_TEST9_FLOAT 8;
BA_ "AfdxFDSaddr" SG_ 437005166 FS_FDS_1_HSMU_TEST9_FLOAT 8;
BA_ "AfdxFDSlength" SG_ 437005166 FS_FDS_1_HSMU_TEST9_FLOAT 4;
BA_ "AfdxFDSname" SG_ 437005166 FS_FDS_1_HSMU_TEST9_FLOAT "FDS_1_HSMU_TEST9_FLOAT";
BA_ "AfdxSignalType" SG_ 437005166 FS_FDS_1_HSMU_TEST9_FLOAT "Enumerate";
BA_ "AfdxFSaddr" SG_ 436939629 IOM_A_34_SYS_PRESS_2_YY_8 8;
BA_ "AfdxFDSaddr" SG_ 436939629 IOM_A_34_SYS_PRESS_2_YY_8 8;
BA_ "AfdxFDSlength" SG_ 436939629 IOM_A_34_SYS_PRESS_2_YY_8 4;
BA_ "AfdxFDSname" SG_ 436939629 IOM_A_34_SYS_PRESS_2_YY_8 "FDS_1_HSMU_TEST8_FLOAT";
BA_ "AfdxSignalType" SG_ 436939629 IOM_A_34_SYS_PRESS_2_YY_8 "Float";
BA_ "AfdxFSaddr" SG_ 436939629 FS_FDS_1_HSMU_TEST8_FLOAT 8;
BA_ "AfdxFDSaddr" SG_ 436939629 FS_FDS_1_HSMU_TEST8_FLOAT 8;
BA_ "AfdxFDSlength" SG_ 436939629 FS_FDS_1_HSMU_TEST8_FLOAT 4;
BA_ "AfdxFDSname" SG_ 436939629 FS_FDS_1_HSMU_TEST8_FLOAT "FDS_1_HSMU_TEST8_FLOAT";
BA_ "AfdxSignalType" SG_ 436939629 FS_FDS_1_HSMU_TEST8_FLOAT "Enumerate";
BA_ "AfdxFSaddr" SG_ 436874092 IOM_A_34_SYS_PRESS_2_YY_75 28;
BA_ "AfdxFDSaddr" SG_ 436874092 IOM_A_34_SYS_PRESS_2_YY_75 28;
BA_ "AfdxFDSlength" SG_ 436874092 IOM_A_34_SYS_PRESS_2_YY_75 4;
BA_ "AfdxFDSname" SG_ 436874092 IOM_A_34_SYS_PRESS_2_YY_75 "FDS_1_HSMU_TEST7_FLOAT";
BA_ "AfdxSignalType" SG_ 436874092 IOM_A_34_SYS_PRESS_2_YY_75 "Float";
BA_ "AfdxFSaddr" SG_ 436874092 IOM_A_34_SYS_PRESS_2_YY_74 28;
BA_ "AfdxFDSaddr" SG_ 436874092 IOM_A_34_SYS_PRESS_2_YY_74 28;
BA_ "AfdxFDSlength" SG_ 436874092 IOM_A_34_SYS_PRESS_2_YY_74 4;
BA_ "AfdxFDSname" SG_ 436874092 IOM_A_34_SYS_PRESS_2_YY_74 "FDS_1_HSMU_TEST7_FLOAT";
BA_ "AfdxSignalType" SG_ 436874092 IOM_A_34_SYS_PRESS_2_YY_74 "Float";
BA_ "AfdxFSaddr" SG_ 436874092 IOM_A_34_SYS_PRESS_2_YY_73 28;
BA_ "AfdxFDSaddr" SG_ 436874092 IOM_A_34_SYS_PRESS_2_YY_73 28;
BA_ "AfdxFDSlength" SG_ 436874092 IOM_A_34_SYS_PRESS_2_YY_73 4;
BA_ "AfdxFDSname" SG_ 436874092 IOM_A_34_SYS_PRESS_2_YY_73 "FDS_1_HSMU_TEST7_FLOAT";
BA_ "AfdxSignalType" SG_ 436874092 IOM_A_34_SYS_PRESS_2_YY_73 "Float";
BA_ "AfdxFSaddr" SG_ 436874092 IOM_A_34_SYS_PRESS_2_YY_72 28;
BA_ "AfdxFDSaddr" SG_ 436874092 IOM_A_34_SYS_PRESS_2_YY_72 28;
BA_ "AfdxFDSlength" SG_ 436874092 IOM_A_34_SYS_PRESS_2_YY_72 4;
BA_ "AfdxFDSname" SG_ 436874092 IOM_A_34_SYS_PRESS_2_YY_72 "FDS_1_HSMU_TEST7_FLOAT";
BA_ "AfdxSignalType" SG_ 436874092 IOM_A_34_SYS_PRESS_2_YY_72 "Float";
BA_ "AfdxFSaddr" SG_ 436874092 IOM_A_34_SYS_PRESS_2_YY_71 28;
BA_ "AfdxFDSaddr" SG_ 436874092 IOM_A_34_SYS_PRESS_2_YY_71 28;
BA_ "AfdxFDSlength" SG_ 436874092 IOM_A_34_SYS_PRESS_2_YY_71 4;
BA_ "AfdxFDSname" SG_ 436874092 IOM_A_34_SYS_PRESS_2_YY_71 "FDS_1_HSMU_TEST7_FLOAT";
BA_ "AfdxSignalType" SG_ 436874092 IOM_A_34_SYS_PRESS_2_YY_71 "Float";
BA_ "AfdxFSaddr" SG_ 436874092 FS_FDS_1_HSMU_TEST7_FLOAT 28;
BA_ "AfdxFDSaddr" SG_ 436874092 FS_FDS_1_HSMU_TEST7_FLOAT 28;
BA_ "AfdxFDSlength" SG_ 436874092 FS_FDS_1_HSMU_TEST7_FLOAT 4;
BA_ "AfdxFDSname" SG_ 436874092 FS_FDS_1_HSMU_TEST7_FLOAT "FDS_1_HSMU_TEST7_FLOAT";
BA_ "AfdxSignalType" SG_ 436874092 FS_FDS_1_HSMU_TEST7_FLOAT "Enumerate";
BA_ "AfdxFSaddr" SG_ 436808555 IOM_A_34_SYS_PRESS_2_YY_64 20;
BA_ "AfdxFDSaddr" SG_ 436808555 IOM_A_34_SYS_PRESS_2_YY_64 20;
BA_ "AfdxFDSlength" SG_ 436808555 IOM_A_34_SYS_PRESS_2_YY_64 4;
BA_ "AfdxFDSname" SG_ 436808555 IOM_A_34_SYS_PRESS_2_YY_64 "FDS_1_HSMU_TEST6_FLOAT";
BA_ "AfdxSignalType" SG_ 436808555 IOM_A_34_SYS_PRESS_2_YY_64 "Float";
BA_ "AfdxFSaddr" SG_ 436808555 IOM_A_34_SYS_PRESS_2_YY_63 20;
BA_ "AfdxFDSaddr" SG_ 436808555 IOM_A_34_SYS_PRESS_2_YY_63 20;
BA_ "AfdxFDSlength" SG_ 436808555 IOM_A_34_SYS_PRESS_2_YY_63 4;
BA_ "AfdxFDSname" SG_ 436808555 IOM_A_34_SYS_PRESS_2_YY_63 "FDS_1_HSMU_TEST6_FLOAT";
BA_ "AfdxSignalType" SG_ 436808555 IOM_A_34_SYS_PRESS_2_YY_63 "Float";
BA_ "AfdxFSaddr" SG_ 436808555 IOM_A_34_SYS_PRESS_2_YY_62 20;
BA_ "AfdxFDSaddr" SG_ 436808555 IOM_A_34_SYS_PRESS_2_YY_62 20;
BA_ "AfdxFDSlength" SG_ 436808555 IOM_A_34_SYS_PRESS_2_YY_62 4;
BA_ "AfdxFDSname" SG_ 436808555 IOM_A_34_SYS_PRESS_2_YY_62 "FDS_1_HSMU_TEST6_FLOAT";
BA_ "AfdxSignalType" SG_ 436808555 IOM_A_34_SYS_PRESS_2_YY_62 "Float";
BA_ "AfdxFSaddr" SG_ 436808555 IOM_A_34_SYS_PRESS_2_YY_61 20;
BA_ "AfdxFDSaddr" SG_ 436808555 IOM_A_34_SYS_PRESS_2_YY_61 20;
BA_ "AfdxFDSlength" SG_ 436808555 IOM_A_34_SYS_PRESS_2_YY_61 4;
BA_ "AfdxFDSname" SG_ 436808555 IOM_A_34_SYS_PRESS_2_YY_61 "FDS_1_HSMU_TEST6_FLOAT";
BA_ "AfdxSignalType" SG_ 436808555 IOM_A_34_SYS_PRESS_2_YY_61 "Float";
BA_ "AfdxFSaddr" SG_ 436808555 FS_FDS_1_HSMU_TEST6_FLOAT 20;
BA_ "AfdxFDSaddr" SG_ 436808555 FS_FDS_1_HSMU_TEST6_FLOAT 20;
BA_ "AfdxFDSlength" SG_ 436808555 FS_FDS_1_HSMU_TEST6_FLOAT 4;
BA_ "AfdxFDSname" SG_ 436808555 FS_FDS_1_HSMU_TEST6_FLOAT "FDS_1_HSMU_TEST6_FLOAT";
BA_ "AfdxSignalType" SG_ 436808555 FS_FDS_1_HSMU_TEST6_FLOAT "Enumerate";
BA_ "AfdxFSaddr" SG_ 436743018 IOM_A_34_SYS_PRESS_2_YY_5 16;
BA_ "AfdxFDSaddr" SG_ 436743018 IOM_A_34_SYS_PRESS_2_YY_5 16;
BA_ "AfdxFDSlength" SG_ 436743018 IOM_A_34_SYS_PRESS_2_YY_5 4;
BA_ "AfdxFDSname" SG_ 436743018 IOM_A_34_SYS_PRESS_2_YY_5 "FDS_1_HSMU_TEST5_FLOAT";
BA_ "AfdxSignalType" SG_ 436743018 IOM_A_34_SYS_PRESS_2_YY_5 "Float";
BA_ "AfdxFSaddr" SG_ 436743018 IOM_A_34_SYS_PRESS_2_YY_52 16;
BA_ "AfdxFDSaddr" SG_ 436743018 IOM_A_34_SYS_PRESS_2_YY_52 16;
BA_ "AfdxFDSlength" SG_ 436743018 IOM_A_34_SYS_PRESS_2_YY_52 4;
BA_ "AfdxFDSname" SG_ 436743018 IOM_A_34_SYS_PRESS_2_YY_52 "FDS_1_HSMU_TEST5_FLOAT";
BA_ "AfdxSignalType" SG_ 436743018 IOM_A_34_SYS_PRESS_2_YY_52 "Float";
BA_ "AfdxFSaddr" SG_ 436743018 IOM_A_34_SYS_PRESS_2_YY_51 16;
BA_ "AfdxFDSaddr" SG_ 436743018 IOM_A_34_SYS_PRESS_2_YY_51 16;
BA_ "AfdxFDSlength" SG_ 436743018 IOM_A_34_SYS_PRESS_2_YY_51 4;
BA_ "AfdxFDSname" SG_ 436743018 IOM_A_34_SYS_PRESS_2_YY_51 "FDS_1_HSMU_TEST5_FLOAT";
BA_ "AfdxSignalType" SG_ 436743018 IOM_A_34_SYS_PRESS_2_YY_51 "Float";
BA_ "AfdxFSaddr" SG_ 436743018 FS_FDS_1_HSMU_TEST5_FLOAT 16;
BA_ "AfdxFDSaddr" SG_ 436743018 FS_FDS_1_HSMU_TEST5_FLOAT 16;
BA_ "AfdxFDSlength" SG_ 436743018 FS_FDS_1_HSMU_TEST5_FLOAT 4;
BA_ "AfdxFDSname" SG_ 436743018 FS_FDS_1_HSMU_TEST5_FLOAT "FDS_1_HSMU_TEST5_FLOAT";
BA_ "AfdxSignalType" SG_ 436743018 FS_FDS_1_HSMU_TEST5_FLOAT "Enumerate";
BA_ "AfdxFSaddr" SG_ 436677481 IOM_A_34_SYS_PRESS_2_YY_42 12;
BA_ "AfdxFDSaddr" SG_ 436677481 IOM_A_34_SYS_PRESS_2_YY_42 12;
BA_ "AfdxFDSlength" SG_ 436677481 IOM_A_34_SYS_PRESS_2_YY_42 4;
BA_ "AfdxFDSname" SG_ 436677481 IOM_A_34_SYS_PRESS_2_YY_42 "FDS_1_HSMU_TEST4_FLOAT";
BA_ "AfdxSignalType" SG_ 436677481 IOM_A_34_SYS_PRESS_2_YY_42 "Float";
BA_ "AfdxFSaddr" SG_ 436677481 IOM_A_34_SYS_PRESS_2_YY_41 12;
BA_ "AfdxFDSaddr" SG_ 436677481 IOM_A_34_SYS_PRESS_2_YY_41 12;
BA_ "AfdxFDSlength" SG_ 436677481 IOM_A_34_SYS_PRESS_2_YY_41 4;
BA_ "AfdxFDSname" SG_ 436677481 IOM_A_34_SYS_PRESS_2_YY_41 "FDS_1_HSMU_TEST4_FLOAT";
BA_ "AfdxSignalType" SG_ 436677481 IOM_A_34_SYS_PRESS_2_YY_41 "Float";
BA_ "AfdxFSaddr" SG_ 436677481 FS_FDS_1_HSMU_TEST4_FLOAT 12;
BA_ "AfdxFDSaddr" SG_ 436677481 FS_FDS_1_HSMU_TEST4_FLOAT 12;
BA_ "AfdxFDSlength" SG_ 436677481 FS_FDS_1_HSMU_TEST4_FLOAT 4;
BA_ "AfdxFDSname" SG_ 436677481 FS_FDS_1_HSMU_TEST4_FLOAT "FDS_1_HSMU_TEST4_FLOAT";
BA_ "AfdxSignalType" SG_ 436677481 FS_FDS_1_HSMU_TEST4_FLOAT "Enumerate";
BA_ "AfdxFSaddr" SG_ 436611944 IOM_A_34_SYS_PRESS_2_YY_31 8;
BA_ "AfdxFDSaddr" SG_ 436611944 IOM_A_34_SYS_PRESS_2_YY_31 8;
BA_ "AfdxFDSlength" SG_ 436611944 IOM_A_34_SYS_PRESS_2_YY_31 4;
BA_ "AfdxFDSname" SG_ 436611944 IOM_A_34_SYS_PRESS_2_YY_31 "FDS_1_HSMU_TEST3_FLOAT";
BA_ "AfdxSignalType" SG_ 436611944 IOM_A_34_SYS_PRESS_2_YY_31 "Float";
BA_ "AfdxFSaddr" SG_ 436611944 FS_FDS_1_HSMU_TEST3_FLOAT 8;
BA_ "AfdxFDSaddr" SG_ 436611944 FS_FDS_1_HSMU_TEST3_FLOAT 8;
BA_ "AfdxFDSlength" SG_ 436611944 FS_FDS_1_HSMU_TEST3_FLOAT 4;
BA_ "AfdxFDSname" SG_ 436611944 FS_FDS_1_HSMU_TEST3_FLOAT "FDS_1_HSMU_TEST3_FLOAT";
BA_ "AfdxSignalType" SG_ 436611944 FS_FDS_1_HSMU_TEST3_FLOAT "Enumerate";
BA_ "AfdxFSaddr" SG_ 436546407 IOM_A_34_ACCU_PRESSURE_SGX_1_3 32;
BA_ "AfdxFDSaddr" SG_ 436546407 IOM_A_34_ACCU_PRESSURE_SGX_1_3 32;
BA_ "AfdxFDSlength" SG_ 436546407 IOM_A_34_ACCU_PRESSURE_SGX_1_3 4;
BA_ "AfdxFDSname" SG_ 436546407 IOM_A_34_ACCU_PRESSURE_SGX_1_3 "FDS_6_HSMU_TEST1_FLOAT";
BA_ "AfdxSignalType" SG_ 436546407 IOM_A_34_ACCU_PRESSURE_SGX_1_3 "Float";
BA_ "AfdxFSaddr" SG_ 436546407 FS_FDS_6_HSMU_TEST1_FLOAT 32;
BA_ "AfdxFDSaddr" SG_ 436546407 FS_FDS_6_HSMU_TEST1_FLOAT 32;
BA_ "AfdxFDSlength" SG_ 436546407 FS_FDS_6_HSMU_TEST1_FLOAT 4;
BA_ "AfdxFDSname" SG_ 436546407 FS_FDS_6_HSMU_TEST1_FLOAT "FDS_6_HSMU_TEST1_FLOAT";
BA_ "AfdxSignalType" SG_ 436546407 FS_FDS_6_HSMU_TEST1_FLOAT "Enumerate";
BA_ "AfdxFSaddr" SG_ 436546407 IOM_A_34_NORMAL_BRAKE_PRESSURE_W 28;
BA_ "AfdxFDSaddr" SG_ 436546407 IOM_A_34_NORMAL_BRAKE_PRESSURE_W 28;
BA_ "AfdxFDSlength" SG_ 436546407 IOM_A_34_NORMAL_BRAKE_PRESSURE_W 4;
BA_ "AfdxFDSname" SG_ 436546407 IOM_A_34_NORMAL_BRAKE_PRESSURE_W "FDS_5_HSMU_TEST1_FLOAT";
BA_ "AfdxSignalType" SG_ 436546407 IOM_A_34_NORMAL_BRAKE_PRESSURE_W "Float";
BA_ "SystemSignalLongSymbol" SG_ 436546407 IOM_A_34_NORMAL_BRAKE_PRESSURE_W "IOM_A_34_NORMAL_BRAKE_PRESSURE_WHEEL_13_14_SGX_1_3";
BA_ "AfdxFSaddr" SG_ 436546407 FS_FDS_5_HSMU_TEST1_FLOAT 28;
BA_ "AfdxFDSaddr" SG_ 436546407 FS_FDS_5_HSMU_TEST1_FLOAT 28;
BA_ "AfdxFDSlength" SG_ 436546407 FS_FDS_5_HSMU_TEST1_FLOAT 4;
BA_ "AfdxFDSname" SG_ 436546407 FS_FDS_5_HSMU_TEST1_FLOAT "FDS_5_HSMU_TEST1_FLOAT";
BA_ "AfdxSignalType" SG_ 436546407 FS_FDS_5_HSMU_TEST1_FLOAT "Enumerate";
BA_ "AfdxFSaddr" SG_ 436546407 IOM_A_34_NORMAL_BRAKE_PRESS_0000 20;
BA_ "AfdxFDSaddr" SG_ 436546407 IOM_A_34_NORMAL_BRAKE_PRESS_0000 20;
BA_ "AfdxFDSlength" SG_ 436546407 IOM_A_34_NORMAL_BRAKE_PRESS_0000 4;
BA_ "AfdxFDSname" SG_ 436546407 IOM_A_34_NORMAL_BRAKE_PRESS_0000 "FDS_4_HSMU_TEST1_FLOAT";
BA_ "AfdxSignalType" SG_ 436546407 IOM_A_34_NORMAL_BRAKE_PRESS_0000 "Float";
BA_ "SystemSignalLongSymbol" SG_ 436546407 IOM_A_34_NORMAL_BRAKE_PRESS_0000 "IOM_A_34_NORMAL_BRAKE_PRESSURE_WHEEL_11_12_SGX_1_3";
BA_ "AfdxFSaddr" SG_ 436546407 FS_FDS_4_HSMU_TEST1_FLOAT 20;
BA_ "AfdxFDSaddr" SG_ 436546407 FS_FDS_4_HSMU_TEST1_FLOAT 20;
BA_ "AfdxFDSlength" SG_ 436546407 FS_FDS_4_HSMU_TEST1_FLOAT 4;
BA_ "AfdxFDSname" SG_ 436546407 FS_FDS_4_HSMU_TEST1_FLOAT "FDS_4_HSMU_TEST1_FLOAT";
BA_ "AfdxSignalType" SG_ 436546407 FS_FDS_4_HSMU_TEST1_FLOAT "Enumerate";
BA_ "AfdxFSaddr" SG_ 436546407 IOM_A_34_RSVR_MOVABLE_INDEX_YY_3 16;
BA_ "AfdxFDSaddr" SG_ 436546407 IOM_A_34_RSVR_MOVABLE_INDEX_YY_3 16;
BA_ "AfdxFDSlength" SG_ 436546407 IOM_A_34_RSVR_MOVABLE_INDEX_YY_3 4;
BA_ "AfdxFDSname" SG_ 436546407 IOM_A_34_RSVR_MOVABLE_INDEX_YY_3 "FDS_3_HSMU_TEST1_FLOAT";
BA_ "AfdxSignalType" SG_ 436546407 IOM_A_34_RSVR_MOVABLE_INDEX_YY_3 "Float";
BA_ "AfdxFSaddr" SG_ 436546407 FS_FDS_3_HSMU_TEST1_FLOAT 16;
BA_ "AfdxFDSaddr" SG_ 436546407 FS_FDS_3_HSMU_TEST1_FLOAT 16;
BA_ "AfdxFDSlength" SG_ 436546407 FS_FDS_3_HSMU_TEST1_FLOAT 4;
BA_ "AfdxFDSname" SG_ 436546407 FS_FDS_3_HSMU_TEST1_FLOAT "FDS_3_HSMU_TEST1_FLOAT";
BA_ "AfdxSignalType" SG_ 436546407 FS_FDS_3_HSMU_TEST1_FLOAT "Enumerate";
BA_ "AfdxFSaddr" SG_ 436546407 IOM_A_34_RSVR_LEVEL_YY_3 12;
BA_ "AfdxFDSaddr" SG_ 436546407 IOM_A_34_RSVR_LEVEL_YY_3 12;
BA_ "AfdxFDSlength" SG_ 436546407 IOM_A_34_RSVR_LEVEL_YY_3 4;
BA_ "AfdxFDSname" SG_ 436546407 IOM_A_34_RSVR_LEVEL_YY_3 "FDS_2_HSMU_TEST1_FLOAT";
BA_ "AfdxSignalType" SG_ 436546407 IOM_A_34_RSVR_LEVEL_YY_3 "Float";
BA_ "AfdxFSaddr" SG_ 436546407 FS_FDS_2_HSMU_TEST1_FLOAT 12;
BA_ "AfdxFDSaddr" SG_ 436546407 FS_FDS_2_HSMU_TEST1_FLOAT 12;
BA_ "AfdxFDSlength" SG_ 436546407 FS_FDS_2_HSMU_TEST1_FLOAT 4;
BA_ "AfdxFDSname" SG_ 436546407 FS_FDS_2_HSMU_TEST1_FLOAT "FDS_2_HSMU_TEST1_FLOAT";
BA_ "AfdxSignalType" SG_ 436546407 FS_FDS_2_HSMU_TEST1_FLOAT "Enumerate";
BA_ "AfdxFSaddr" SG_ 436546407 IOM_A_34_SYS_PRESS_2_YY_3 8;
BA_ "AfdxFDSaddr" SG_ 436546407 IOM_A_34_SYS_PRESS_2_YY_3 8;
BA_ "AfdxFDSlength" SG_ 436546407 IOM_A_34_SYS_PRESS_2_YY_3 4;
BA_ "AfdxFDSname" SG_ 436546407 IOM_A_34_SYS_PRESS_2_YY_3 "FDS_1_HSMU_TEST1_FLOAT";
BA_ "AfdxSignalType" SG_ 436546407 IOM_A_34_SYS_PRESS_2_YY_3 "Float";
BA_ "AfdxFSaddr" SG_ 436546407 FS_FDS_1_HSMU_TEST1_FLOAT 8;
BA_ "AfdxFDSaddr" SG_ 436546407 FS_FDS_1_HSMU_TEST1_FLOAT 8;
BA_ "AfdxFDSlength" SG_ 436546407 FS_FDS_1_HSMU_TEST1_FLOAT 4;
BA_ "AfdxFDSname" SG_ 436546407 FS_FDS_1_HSMU_TEST1_FLOAT "FDS_1_HSMU_TEST1_FLOAT";
BA_ "AfdxSignalType" SG_ 436546407 FS_FDS_1_HSMU_TEST1_FLOAT "Enumerate";
BA_ "AfdxFSaddr" SG_ 436480870 IOM_A_34_ACCU_PRESSURE_SGX_1_3 32;
BA_ "AfdxFDSaddr" SG_ 436480870 IOM_A_34_ACCU_PRESSURE_SGX_1_3 32;
BA_ "AfdxFDSlength" SG_ 436480870 IOM_A_34_ACCU_PRESSURE_SGX_1_3 4;
BA_ "AfdxFDSname" SG_ 436480870 IOM_A_34_ACCU_PRESSURE_SGX_1_3 "FDS_6_HSMU_TEST1_FLOAT";
BA_ "AfdxSignalType" SG_ 436480870 IOM_A_34_ACCU_PRESSURE_SGX_1_3 "Float";
BA_ "AfdxFSaddr" SG_ 436480870 FS_FDS_6_HSMU_TEST1_FLOAT 32;
BA_ "AfdxFDSaddr" SG_ 436480870 FS_FDS_6_HSMU_TEST1_FLOAT 32;
BA_ "AfdxFDSlength" SG_ 436480870 FS_FDS_6_HSMU_TEST1_FLOAT 4;
BA_ "AfdxFDSname" SG_ 436480870 FS_FDS_6_HSMU_TEST1_FLOAT "FDS_6_HSMU_TEST1_FLOAT";
BA_ "AfdxSignalType" SG_ 436480870 FS_FDS_6_HSMU_TEST1_FLOAT "Enumerate";
BA_ "AfdxFSaddr" SG_ 436480870 IOM_A_34_NORMAL_BRAKE_PRESS_0001 28;
BA_ "AfdxFDSaddr" SG_ 436480870 IOM_A_34_NORMAL_BRAKE_PRESS_0001 28;
BA_ "AfdxFDSlength" SG_ 436480870 IOM_A_34_NORMAL_BRAKE_PRESS_0001 4;
BA_ "AfdxFDSname" SG_ 436480870 IOM_A_34_NORMAL_BRAKE_PRESS_0001 "FDS_5_HSMU_TEST1_FLOAT";
BA_ "AfdxSignalType" SG_ 436480870 IOM_A_34_NORMAL_BRAKE_PRESS_0001 "Float";
BA_ "SystemSignalLongSymbol" SG_ 436480870 IOM_A_34_NORMAL_BRAKE_PRESS_0001 "IOM_A_34_NORMAL_BRAKE_PRESSURE_WHEEL_13_14_SGX_1_3";
BA_ "AfdxFSaddr" SG_ 436480870 FS_FDS_5_HSMU_TEST1_FLOAT 28;
BA_ "AfdxFDSaddr" SG_ 436480870 FS_FDS_5_HSMU_TEST1_FLOAT 28;
BA_ "AfdxFDSlength" SG_ 436480870 FS_FDS_5_HSMU_TEST1_FLOAT 4;
BA_ "AfdxFDSname" SG_ 436480870 FS_FDS_5_HSMU_TEST1_FLOAT "FDS_5_HSMU_TEST1_FLOAT";
BA_ "AfdxSignalType" SG_ 436480870 FS_FDS_5_HSMU_TEST1_FLOAT "Enumerate";
BA_ "AfdxFSaddr" SG_ 436480870 IOM_A_34_NORMAL_BRAKE_PRESS_0002 20;
BA_ "AfdxFDSaddr" SG_ 436480870 IOM_A_34_NORMAL_BRAKE_PRESS_0002 20;
BA_ "AfdxFDSlength" SG_ 436480870 IOM_A_34_NORMAL_BRAKE_PRESS_0002 4;
BA_ "AfdxFDSname" SG_ 436480870 IOM_A_34_NORMAL_BRAKE_PRESS_0002 "FDS_4_HSMU_TEST1_FLOAT";
BA_ "AfdxSignalType" SG_ 436480870 IOM_A_34_NORMAL_BRAKE_PRESS_0002 "Float";
BA_ "SystemSignalLongSymbol" SG_ 436480870 IOM_A_34_NORMAL_BRAKE_PRESS_0002 "IOM_A_34_NORMAL_BRAKE_PRESSURE_WHEEL_11_12_SGX_1_3";
BA_ "AfdxFSaddr" SG_ 436480870 FS_FDS_4_HSMU_TEST1_FLOAT 20;
BA_ "AfdxFDSaddr" SG_ 436480870 FS_FDS_4_HSMU_TEST1_FLOAT 20;
BA_ "AfdxFDSlength" SG_ 436480870 FS_FDS_4_HSMU_TEST1_FLOAT 4;
BA_ "AfdxFDSname" SG_ 436480870 FS_FDS_4_HSMU_TEST1_FLOAT "FDS_4_HSMU_TEST1_FLOAT";
BA_ "AfdxSignalType" SG_ 436480870 FS_FDS_4_HSMU_TEST1_FLOAT "Enumerate";
BA_ "AfdxFSaddr" SG_ 436480870 IOM_A_34_RSVR_MOVABLE_INDEX_YY_3 16;
BA_ "AfdxFDSaddr" SG_ 436480870 IOM_A_34_RSVR_MOVABLE_INDEX_YY_3 16;
BA_ "AfdxFDSlength" SG_ 436480870 IOM_A_34_RSVR_MOVABLE_INDEX_YY_3 4;
BA_ "AfdxFDSname" SG_ 436480870 IOM_A_34_RSVR_MOVABLE_INDEX_YY_3 "FDS_3_HSMU_TEST1_FLOAT";
BA_ "AfdxSignalType" SG_ 436480870 IOM_A_34_RSVR_MOVABLE_INDEX_YY_3 "Float";
BA_ "AfdxFSaddr" SG_ 436480870 FS_FDS_3_HSMU_TEST1_FLOAT 16;
BA_ "AfdxFDSaddr" SG_ 436480870 FS_FDS_3_HSMU_TEST1_FLOAT 16;
BA_ "AfdxFDSlength" SG_ 436480870 FS_FDS_3_HSMU_TEST1_FLOAT 4;
BA_ "AfdxFDSname" SG_ 436480870 FS_FDS_3_HSMU_TEST1_FLOAT "FDS_3_HSMU_TEST1_FLOAT";
BA_ "AfdxSignalType" SG_ 436480870 FS_FDS_3_HSMU_TEST1_FLOAT "Enumerate";
BA_ "AfdxFSaddr" SG_ 436480870 IOM_A_34_RSVR_LEVEL_YY_3 12;
BA_ "AfdxFDSaddr" SG_ 436480870 IOM_A_34_RSVR_LEVEL_YY_3 12;
BA_ "AfdxFDSlength" SG_ 436480870 IOM_A_34_RSVR_LEVEL_YY_3 4;
BA_ "AfdxFDSname" SG_ 436480870 IOM_A_34_RSVR_LEVEL_YY_3 "FDS_2_HSMU_TEST1_FLOAT";
BA_ "AfdxSignalType" SG_ 436480870 IOM_A_34_RSVR_LEVEL_YY_3 "Float";
BA_ "AfdxFSaddr" SG_ 436480870 FS_FDS_2_HSMU_TEST1_FLOAT 12;
BA_ "AfdxFDSaddr" SG_ 436480870 FS_FDS_2_HSMU_TEST1_FLOAT 12;
BA_ "AfdxFDSlength" SG_ 436480870 FS_FDS_2_HSMU_TEST1_FLOAT 4;
BA_ "AfdxFDSname" SG_ 436480870 FS_FDS_2_HSMU_TEST1_FLOAT "FDS_2_HSMU_TEST1_FLOAT";
BA_ "AfdxSignalType" SG_ 436480870 FS_FDS_2_HSMU_TEST1_FLOAT "Enumerate";
BA_ "AfdxFSaddr" SG_ 436480870 IOM_A_34_SYS_PRESS_2_YY_3 8;
BA_ "AfdxFDSaddr" SG_ 436480870 IOM_A_34_SYS_PRESS_2_YY_3 8;
BA_ "AfdxFDSlength" SG_ 436480870 IOM_A_34_SYS_PRESS_2_YY_3 4;
BA_ "AfdxFDSname" SG_ 436480870 IOM_A_34_SYS_PRESS_2_YY_3 "FDS_1_HSMU_TEST1_FLOAT";
BA_ "AfdxSignalType" SG_ 436480870 IOM_A_34_SYS_PRESS_2_YY_3 "Float";
BA_ "AfdxFSaddr" SG_ 436480870 FS_FDS_1_HSMU_TEST1_FLOAT 8;
BA_ "AfdxFDSaddr" SG_ 436480870 FS_FDS_1_HSMU_TEST1_FLOAT 8;
BA_ "AfdxFDSlength" SG_ 436480870 FS_FDS_1_HSMU_TEST1_FLOAT 4;
BA_ "AfdxFDSname" SG_ 436480870 FS_FDS_1_HSMU_TEST1_FLOAT "FDS_1_HSMU_TEST1_FLOAT";
BA_ "AfdxSignalType" SG_ 436480870 FS_FDS_1_HSMU_TEST1_FLOAT "Enumerate";
VAL_ 437922684 FS_HSMU_TEST22_21 48 "NCD" 12 "FT" 3 "NO" 0 "ND" ;
VAL_ 437922684 FS_HSMU_TEST22_20 48 "NCD" 12 "FT" 3 "NO" 0 "ND" ;
VAL_ 437922684 FS_HSMU_TEST22_19 48 "NCD" 12 "FT" 3 "NO" 0 "ND" ;
VAL_ 437922684 FS_HSMU_TEST22_18 48 "NCD" 12 "FT" 3 "NO" 0 "ND" ;
VAL_ 437922684 FS_HSMU_TEST22_17 48 "NCD" 12 "FT" 3 "NO" 0 "ND" ;
VAL_ 437922684 FS_HSMU_TEST22_16 48 "NCD" 12 "FT" 3 "NO" 0 "ND" ;
VAL_ 437922684 FS_HSMU_TEST22_15 48 "NCD" 12 "FT" 3 "NO" 0 "ND" ;
VAL_ 437922684 FS_HSMU_TEST22_14 48 "NCD" 12 "FT" 3 "NO" 0 "ND" ;
VAL_ 437922684 FS_HSMU_TEST22_13 48 "NCD" 12 "FT" 3 "NO" 0 "ND" ;
VAL_ 437922684 FS_HSMU_TEST22_12 48 "NCD" 12 "FT" 3 "NO" 0 "ND" ;
VAL_ 437922684 FS_HSMU_TEST22_11 48 "NCD" 12 "FT" 3 "NO" 0 "ND" ;
VAL_ 437922684 FS_HSMU_TEST22_10 48 "NCD" 12 "FT" 3 "NO" 0 "ND" ;
VAL_ 437922684 FS_HSMU_TEST22_9 48 "NCD" 12 "FT" 3 "NO" 0 "ND" ;
VAL_ 437922684 FS_HSMU_TEST22_8 48 "NCD" 12 "FT" 3 "NO" 0 "ND" ;
VAL_ 437922684 FS_HSMU_TEST22_7 48 "NCD" 12 "FT" 3 "NO" 0 "ND" ;
VAL_ 437922684 FS_HSMU_TEST22_6 48 "NCD" 12 "FT" 3 "NO" 0 "ND" ;
VAL_ 437922684 FS_HSMU_TEST22_5 48 "NCD" 12 "FT" 3 "NO" 0 "ND" ;
VAL_ 437922684 FS_HSMU_TEST22_4 48 "NCD" 12 "FT" 3 "NO" 0 "ND" ;
VAL_ 437922684 FS_HSMU_TEST22_3 48 "NCD" 12 "FT" 3 "NO" 0 "ND" ;
VAL_ 437922684 FS_HSMU_TEST22_2 48 "NCD" 12 "FT" 3 "NO" 0 "ND" ;
VAL_ 437922684 FS_HSMU_TEST22_1 48 "NCD" 12 "FT" 3 "NO" 0 "ND" ;
VAL_ 437857147 FS_HSMU_TEST21_40 48 "NCD" 12 "FT" 3 "NO" 0 "ND" ;
VAL_ 437857147 FS_HSMU_TEST21_39 48 "NCD" 12 "FT" 3 "NO" 0 "ND" ;
VAL_ 437857147 FS_HSMU_TEST21_38 48 "NCD" 12 "FT" 3 "NO" 0 "ND" ;
VAL_ 437857147 FS_HSMU_TEST21_37 48 "NCD" 12 "FT" 3 "NO" 0 "ND" ;
VAL_ 437857147 FS_HSMU_TEST21_36 48 "NCD" 12 "FT" 3 "NO" 0 "ND" ;
VAL_ 437857147 FS_HSMU_TEST21_35 48 "NCD" 12 "FT" 3 "NO" 0 "ND" ;
VAL_ 437857147 FS_HSMU_TEST21_34 48 "NCD" 12 "FT" 3 "NO" 0 "ND" ;
VAL_ 437857147 FS_HSMU_TEST21_33 48 "NCD" 12 "FT" 3 "NO" 0 "ND" ;
VAL_ 437857147 FS_HSMU_TEST21_32 48 "NCD" 12 "FT" 3 "NO" 0 "ND" ;
VAL_ 437857147 FS_HSMU_TEST21_31 48 "NCD" 12 "FT" 3 "NO" 0 "ND" ;
VAL_ 437857147 FS_HSMU_TEST21_30 48 "NCD" 12 "FT" 3 "NO" 0 "ND" ;
VAL_ 437857147 FS_HSMU_TEST21_29 48 "NCD" 12 "FT" 3 "NO" 0 "ND" ;
VAL_ 437857147 FS_HSMU_TEST21_28 48 "NCD" 12 "FT" 3 "NO" 0 "ND" ;
VAL_ 437857147 FS_HSMU_TEST21_27 48 "NCD" 12 "FT" 3 "NO" 0 "ND" ;
VAL_ 437857147 FS_HSMU_TEST21_26 48 "NCD" 12 "FT" 3 "NO" 0 "ND" ;
VAL_ 437857147 FS_HSMU_TEST21_25 48 "NCD" 12 "FT" 3 "NO" 0 "ND" ;
VAL_ 437857147 FS_HSMU_TEST21_24 48 "NCD" 12 "FT" 3 "NO" 0 "ND" ;
VAL_ 437857147 FS_HSMU_TEST21_23 48 "NCD" 12 "FT" 3 "NO" 0 "ND" ;
VAL_ 437857147 FS_HSMU_TEST21_22 48 "NCD" 12 "FT" 3 "NO" 0 "ND" ;
VAL_ 437857147 FS_HSMU_TEST21_21 48 "NCD" 12 "FT" 3 "NO" 0 "ND" ;
VAL_ 437857147 FS_HSMU_TEST21_20 48 "NCD" 12 "FT" 3 "NO" 0 "ND" ;
VAL_ 437857147 FS_HSMU_TEST21_19 48 "NCD" 12 "FT" 3 "NO" 0 "ND" ;
VAL_ 437857147 FS_HSMU_TEST21_18 48 "NCD" 12 "FT" 3 "NO" 0 "ND" ;
VAL_ 437857147 FS_HSMU_TEST21_17 48 "NCD" 12 "FT" 3 "NO" 0 "ND" ;
VAL_ 437857147 FS_HSMU_TEST21_16 48 "NCD" 12 "FT" 3 "NO" 0 "ND" ;
VAL_ 437857147 FS_HSMU_TEST21_15 48 "NCD" 12 "FT" 3 "NO" 0 "ND" ;
VAL_ 437857147 FS_HSMU_TEST21_14 48 "NCD" 12 "FT" 3 "NO" 0 "ND" ;
VAL_ 437857147 FS_HSMU_TEST21_13 48 "NCD" 12 "FT" 3 "NO" 0 "ND" ;
VAL_ 437857147 FS_HSMU_TEST21_12 48 "NCD" 12 "FT" 3 "NO" 0 "ND" ;
VAL_ 437857147 FS_HSMU_TEST21_11 48 "NCD" 12 "FT" 3 "NO" 0 "ND" ;
VAL_ 437857147 FS_HSMU_TEST21_10 48 "NCD" 12 "FT" 3 "NO" 0 "ND" ;
VAL_ 437857147 FS_HSMU_TEST21_9 48 "NCD" 12 "FT" 3 "NO" 0 "ND" ;
VAL_ 437857147 FS_HSMU_TEST21_8 48 "NCD" 12 "FT" 3 "NO" 0 "ND" ;
VAL_ 437857147 FS_HSMU_TEST21_7 48 "NCD" 12 "FT" 3 "NO" 0 "ND" ;
VAL_ 437857147 FS_HSMU_TEST21_6 48 "NCD" 12 "FT" 3 "NO" 0 "ND" ;
VAL_ 437857147 FS_HSMU_TEST21_5 48 "NCD" 12 "FT" 3 "NO" 0 "ND" ;
VAL_ 437857147 FS_HSMU_TEST21_4 48 "NCD" 12 "FT" 3 "NO" 0 "ND" ;
VAL_ 437857147 FS_HSMU_TEST21_3 48 "NCD" 12 "FT" 3 "NO" 0 "ND" ;
VAL_ 437857147 FS_HSMU_TEST21_2 48 "NCD" 12 "FT" 3 "NO" 0 "ND" ;
VAL_ 437857147 FS_HSMU_TEST21_1 48 "NCD" 12 "FT" 3 "NO" 0 "ND" ;
VAL_ 437791610 FS_HSMU_TEST20_100 48 "NCD" 12 "FT" 3 "NO" 0 "ND" ;
VAL_ 437791610 FS_HSMU_TEST20_99 48 "NCD" 12 "FT" 3 "NO" 0 "ND" ;
VAL_ 437791610 FS_HSMU_TEST20_98 48 "NCD" 12 "FT" 3 "NO" 0 "ND" ;
VAL_ 437791610 FS_HSMU_TEST20_97 48 "NCD" 12 "FT" 3 "NO" 0 "ND" ;
VAL_ 437791610 FS_HSMU_TEST20_96 48 "NCD" 12 "FT" 3 "NO" 0 "ND" ;
VAL_ 437791610 FS_HSMU_TEST20_95 48 "NCD" 12 "FT" 3 "NO" 0 "ND" ;
VAL_ 437791610 FS_HSMU_TEST20_94 48 "NCD" 12 "FT" 3 "NO" 0 "ND" ;
VAL_ 437791610 FS_HSMU_TEST20_93 48 "NCD" 12 "FT" 3 "NO" 0 "ND" ;
VAL_ 437791610 FS_HSMU_TEST20_92 48 "NCD" 12 "FT" 3 "NO" 0 "ND" ;
VAL_ 437791610 FS_HSMU_TEST20_91 48 "NCD" 12 "FT" 3 "NO" 0 "ND" ;
VAL_ 437791610 FS_HSMU_TEST20_90 48 "NCD" 12 "FT" 3 "NO" 0 "ND" ;
VAL_ 437791610 FS_HSMU_TEST20_89 48 "NCD" 12 "FT" 3 "NO" 0 "ND" ;
VAL_ 437791610 FS_HSMU_TEST20_88 48 "NCD" 12 "FT" 3 "NO" 0 "ND" ;
VAL_ 437791610 FS_HSMU_TEST20_87 48 "NCD" 12 "FT" 3 "NO" 0 "ND" ;
VAL_ 437791610 FS_HSMU_TEST20_86 48 "NCD" 12 "FT" 3 "NO" 0 "ND" ;
VAL_ 437791610 FS_HSMU_TEST20_85 48 "NCD" 12 "FT" 3 "NO" 0 "ND" ;
VAL_ 437791610 FS_HSMU_TEST20_84 48 "NCD" 12 "FT" 3 "NO" 0 "ND" ;
VAL_ 437791610 FS_HSMU_TEST20_83 48 "NCD" 12 "FT" 3 "NO" 0 "ND" ;
VAL_ 437791610 FS_HSMU_TEST20_82 48 "NCD" 12 "FT" 3 "NO" 0 "ND" ;
VAL_ 437791610 FS_HSMU_TEST20_81 48 "NCD" 12 "FT" 3 "NO" 0 "ND" ;
VAL_ 437791610 FS_HSMU_TEST20_80 48 "NCD" 12 "FT" 3 "NO" 0 "ND" ;
VAL_ 437791610 FS_HSMU_TEST20_79 48 "NCD" 12 "FT" 3 "NO" 0 "ND" ;
VAL_ 437791610 FS_HSMU_TEST20_78 48 "NCD" 12 "FT" 3 "NO" 0 "ND" ;
VAL_ 437791610 FS_HSMU_TEST20_77 48 "NCD" 12 "FT" 3 "NO" 0 "ND" ;
VAL_ 437791610 FS_HSMU_TEST20_76 48 "NCD" 12 "FT" 3 "NO" 0 "ND" ;
VAL_ 437791610 FS_HSMU_TEST20_75 48 "NCD" 12 "FT" 3 "NO" 0 "ND" ;
VAL_ 437791610 FS_HSMU_TEST20_74 48 "NCD" 12 "FT" 3 "NO" 0 "ND" ;
VAL_ 437791610 FS_HSMU_TEST20_73 48 "NCD" 12 "FT" 3 "NO" 0 "ND" ;
VAL_ 437791610 FS_HSMU_TEST20_72 48 "NCD" 12 "FT" 3 "NO" 0 "ND" ;
VAL_ 437791610 FS_HSMU_TEST20_71 48 "NCD" 12 "FT" 3 "NO" 0 "ND" ;
VAL_ 437791610 FS_HSMU_TEST20_70 48 "NCD" 12 "FT" 3 "NO" 0 "ND" ;
VAL_ 437791610 FS_HSMU_TEST20_69 48 "NCD" 12 "FT" 3 "NO" 0 "ND" ;
VAL_ 437791610 FS_HSMU_TEST20_68 48 "NCD" 12 "FT" 3 "NO" 0 "ND" ;
VAL_ 437791610 FS_HSMU_TEST20_67 48 "NCD" 12 "FT" 3 "NO" 0 "ND" ;
VAL_ 437791610 FS_HSMU_TEST20_66 48 "NCD" 12 "FT" 3 "NO" 0 "ND" ;
VAL_ 437791610 FS_HSMU_TEST20_65 48 "NCD" 12 "FT" 3 "NO" 0 "ND" ;
VAL_ 437791610 FS_HSMU_TEST20_64 48 "NCD" 12 "FT" 3 "NO" 0 "ND" ;
VAL_ 437791610 FS_HSMU_TEST20_63 48 "NCD" 12 "FT" 3 "NO" 0 "ND" ;
VAL_ 437791610 FS_HSMU_TEST20_62 48 "NCD" 12 "FT" 3 "NO" 0 "ND" ;
VAL_ 437791610 FS_HSMU_TEST20_61 48 "NCD" 12 "FT" 3 "NO" 0 "ND" ;
VAL_ 437791610 FS_HSMU_TEST20_60 48 "NCD" 12 "FT" 3 "NO" 0 "ND" ;
VAL_ 437791610 FS_HSMU_TEST20_59 48 "NCD" 12 "FT" 3 "NO" 0 "ND" ;
VAL_ 437791610 FS_HSMU_TEST20_58 48 "NCD" 12 "FT" 3 "NO" 0 "ND" ;
VAL_ 437791610 FS_HSMU_TEST20_57 48 "NCD" 12 "FT" 3 "NO" 0 "ND" ;
VAL_ 437791610 FS_HSMU_TEST20_56 48 "NCD" 12 "FT" 3 "NO" 0 "ND" ;
VAL_ 437791610 FS_HSMU_TEST20_55 48 "NCD" 12 "FT" 3 "NO" 0 "ND" ;
VAL_ 437791610 FS_HSMU_TEST20_54 48 "NCD" 12 "FT" 3 "NO" 0 "ND" ;
VAL_ 437791610 FS_HSMU_TEST20_53 48 "NCD" 12 "FT" 3 "NO" 0 "ND" ;
VAL_ 437791610 FS_HSMU_TEST20_52 48 "NCD" 12 "FT" 3 "NO" 0 "ND" ;
VAL_ 437791610 FS_HSMU_TEST20_51 48 "NCD" 12 "FT" 3 "NO" 0 "ND" ;
VAL_ 437791610 FS_HSMU_TEST20_50 48 "NCD" 12 "FT" 3 "NO" 0 "ND" ;
VAL_ 437791610 FS_HSMU_TEST20_49 48 "NCD" 12 "FT" 3 "NO" 0 "ND" ;
VAL_ 437791610 FS_HSMU_TEST20_48 48 "NCD" 12 "FT" 3 "NO" 0 "ND" ;
VAL_ 437791610 FS_HSMU_TEST20_47 48 "NCD" 12 "FT" 3 "NO" 0 "ND" ;
VAL_ 437791610 FS_HSMU_TEST20_46 48 "NCD" 12 "FT" 3 "NO" 0 "ND" ;
VAL_ 437791610 FS_HSMU_TEST20_45 48 "NCD" 12 "FT" 3 "NO" 0 "ND" ;
VAL_ 437791610 FS_HSMU_TEST20_44 48 "NCD" 12 "FT" 3 "NO" 0 "ND" ;
VAL_ 437791610 FS_HSMU_TEST20_43 48 "NCD" 12 "FT" 3 "NO" 0 "ND" ;
VAL_ 437791610 FS_HSMU_TEST20_42 48 "NCD" 12 "FT" 3 "NO" 0 "ND" ;
VAL_ 437791610 FS_HSMU_TEST20_41 48 "NCD" 12 "FT" 3 "NO" 0 "ND" ;
VAL_ 437791610 FS_HSMU_TEST20_40 48 "NCD" 12 "FT" 3 "NO" 0 "ND" ;
VAL_ 437791610 FS_HSMU_TEST20_39 48 "NCD" 12 "FT" 3 "NO" 0 "ND" ;
VAL_ 437791610 FS_HSMU_TEST20_38 48 "NCD" 12 "FT" 3 "NO" 0 "ND" ;
VAL_ 437791610 FS_HSMU_TEST20_37 48 "NCD" 12 "FT" 3 "NO" 0 "ND" ;
VAL_ 437791610 FS_HSMU_TEST20_36 48 "NCD" 12 "FT" 3 "NO" 0 "ND" ;
VAL_ 437791610 FS_HSMU_TEST20_35 48 "NCD" 12 "FT" 3 "NO" 0 "ND" ;
VAL_ 437791610 FS_HSMU_TEST20_34 48 "NCD" 12 "FT" 3 "NO" 0 "ND" ;
VAL_ 437791610 FS_HSMU_TEST20_33 48 "NCD" 12 "FT" 3 "NO" 0 "ND" ;
VAL_ 437791610 FS_HSMU_TEST20_32 48 "NCD" 12 "FT" 3 "NO" 0 "ND" ;
VAL_ 437791610 FS_HSMU_TEST20_31 48 "NCD" 12 "FT" 3 "NO" 0 "ND" ;
VAL_ 437791610 FS_HSMU_TEST20_30 48 "NCD" 12 "FT" 3 "NO" 0 "ND" ;
VAL_ 437791610 FS_HSMU_TEST20_29 48 "NCD" 12 "FT" 3 "NO" 0 "ND" ;
VAL_ 437791610 FS_HSMU_TEST20_28 48 "NCD" 12 "FT" 3 "NO" 0 "ND" ;
VAL_ 437791610 FS_HSMU_TEST20_27 48 "NCD" 12 "FT" 3 "NO" 0 "ND" ;
VAL_ 437791610 FS_HSMU_TEST20_26 48 "NCD" 12 "FT" 3 "NO" 0 "ND" ;
VAL_ 437791610 FS_HSMU_TEST20_25 48 "NCD" 12 "FT" 3 "NO" 0 "ND" ;
VAL_ 437791610 FS_HSMU_TEST20_24 48 "NCD" 12 "FT" 3 "NO" 0 "ND" ;
VAL_ 437791610 FS_HSMU_TEST20_23 48 "NCD" 12 "FT" 3 "NO" 0 "ND" ;
VAL_ 437791610 FS_HSMU_TEST20_22 48 "NCD" 12 "FT" 3 "NO" 0 "ND" ;
VAL_ 437791610 FS_HSMU_TEST20_21 48 "NCD" 12 "FT" 3 "NO" 0 "ND" ;
VAL_ 437791610 FS_HSMU_TEST20_20 48 "NCD" 12 "FT" 3 "NO" 0 "ND" ;
VAL_ 437791610 FS_HSMU_TEST20_19 48 "NCD" 12 "FT" 3 "NO" 0 "ND" ;
VAL_ 437791610 FS_HSMU_TEST20_18 48 "NCD" 12 "FT" 3 "NO" 0 "ND" ;
VAL_ 437791610 FS_HSMU_TEST20_17 48 "NCD" 12 "FT" 3 "NO" 0 "ND" ;
VAL_ 437791610 FS_HSMU_TEST20_16 48 "NCD" 12 "FT" 3 "NO" 0 "ND" ;
VAL_ 437791610 FS_HSMU_TEST20_15 48 "NCD" 12 "FT" 3 "NO" 0 "ND" ;
VAL_ 437791610 FS_HSMU_TEST20_14 48 "NCD" 12 "FT" 3 "NO" 0 "ND" ;
VAL_ 437791610 FS_HSMU_TEST20_13 48 "NCD" 12 "FT" 3 "NO" 0 "ND" ;
VAL_ 437791610 FS_HSMU_TEST20_12 48 "NCD" 12 "FT" 3 "NO" 0 "ND" ;
VAL_ 437791610 FS_HSMU_TEST20_11 48 "NCD" 12 "FT" 3 "NO" 0 "ND" ;
VAL_ 437791610 FS_HSMU_TEST20_10 48 "NCD" 12 "FT" 3 "NO" 0 "ND" ;
VAL_ 437791610 FS_HSMU_TEST20_9 48 "NCD" 12 "FT" 3 "NO" 0 "ND" ;
VAL_ 437791610 FS_HSMU_TEST20_8 48 "NCD" 12 "FT" 3 "NO" 0 "ND" ;
VAL_ 437791610 FS_HSMU_TEST20_7 48 "NCD" 12 "FT" 3 "NO" 0 "ND" ;
VAL_ 437791610 FS_HSMU_TEST20_6 48 "NCD" 12 "FT" 3 "NO" 0 "ND" ;
VAL_ 437791610 FS_HSMU_TEST20_5 48 "NCD" 12 "FT" 3 "NO" 0 "ND" ;
VAL_ 437791610 FS_HSMU_TEST20_4 48 "NCD" 12 "FT" 3 "NO" 0 "ND" ;
VAL_ 437791610 FS_HSMU_TEST20_3 48 "NCD" 12 "FT" 3 "NO" 0 "ND" ;
VAL_ 437791610 FS_HSMU_TEST20_2 48 "NCD" 12 "FT" 3 "NO" 0 "ND" ;
VAL_ 437791610 FS_HSMU_TEST20_1 48 "NCD" 12 "FT" 3 "NO" 0 "ND" ;
VAL_ 437267314 FS_FDS_3_HSMU_TEST_INT3 48 "NCD" 12 "FT" 3 "NO" 0 "ND" ;
VAL_ 437267314 FS_FDS_2_HSMU_TEST_INT3 48 "NCD" 12 "FT" 3 "NO" 0 "ND" ;
VAL_ 437267314 FS_FDS_1_HSMU_TEST_INT3 48 "NCD" 12 "FT" 3 "NO" 0 "ND" ;
VAL_ 437201777 FS_FDS_1_HSMU_TEST_INT2 48 "NCD" 12 "FT" 3 "NO" 0 "ND" ;
VAL_ 437136240 FS_FDS_1_HSMU_TEST_INT1 48 "NCD" 12 "FT" 3 "NO" 0 "ND" ;
VAL_ 437070703 FS_FDS_1_HSMU_TEST10_FLOAT 48 "NCD" 12 "FT" 3 "NO" 0 "ND" ;
VAL_ 437005166 FS_FDS_1_HSMU_TEST9_FLOAT 48 "NCD" 12 "FT" 3 "NO" 0 "ND" ;
VAL_ 436939629 FS_FDS_1_HSMU_TEST8_FLOAT 48 "NCD" 12 "FT" 3 "NO" 0 "ND" ;
VAL_ 436874092 FS_FDS_1_HSMU_TEST7_FLOAT 48 "NCD" 12 "FT" 3 "NO" 0 "ND" ;
VAL_ 436808555 FS_FDS_1_HSMU_TEST6_FLOAT 48 "NCD" 12 "FT" 3 "NO" 0 "ND" ;
VAL_ 436743018 FS_FDS_1_HSMU_TEST5_FLOAT 48 "NCD" 12 "FT" 3 "NO" 0 "ND" ;
VAL_ 436677481 FS_FDS_1_HSMU_TEST4_FLOAT 48 "NCD" 12 "FT" 3 "NO" 0 "ND" ;
VAL_ 436611944 FS_FDS_1_HSMU_TEST3_FLOAT 48 "NCD" 12 "FT" 3 "NO" 0 "ND" ;
VAL_ 436546407 FS_FDS_6_HSMU_TEST1_FLOAT 48 "NCD" 12 "FT" 3 "NO" 0 "ND" ;
VAL_ 436546407 FS_FDS_5_HSMU_TEST1_FLOAT 48 "NCD" 12 "FT" 3 "NO" 0 "ND" ;
VAL_ 436546407 FS_FDS_4_HSMU_TEST1_FLOAT 48 "NCD" 12 "FT" 3 "NO" 0 "ND" ;
VAL_ 436546407 FS_FDS_3_HSMU_TEST1_FLOAT 48 "NCD" 12 "FT" 3 "NO" 0 "ND" ;
VAL_ 436546407 FS_FDS_2_HSMU_TEST1_FLOAT 48 "NCD" 12 "FT" 3 "NO" 0 "ND" ;
VAL_ 436546407 FS_FDS_1_HSMU_TEST1_FLOAT 48 "NCD" 12 "FT" 3 "NO" 0 "ND" ;
VAL_ 436480870 FS_FDS_6_HSMU_TEST1_FLOAT 48 "NCD" 12 "FT" 3 "NO" 0 "ND" ;
VAL_ 436480870 FS_FDS_5_HSMU_TEST1_FLOAT 48 "NCD" 12 "FT" 3 "NO" 0 "ND" ;
VAL_ 436480870 FS_FDS_4_HSMU_TEST1_FLOAT 48 "NCD" 12 "FT" 3 "NO" 0 "ND" ;
VAL_ 436480870 FS_FDS_3_HSMU_TEST1_FLOAT 48 "NCD" 12 "FT" 3 "NO" 0 "ND" ;
VAL_ 436480870 FS_FDS_2_HSMU_TEST1_FLOAT 48 "NCD" 12 "FT" 3 "NO" 0 "ND" ;
VAL_ 436480870 FS_FDS_1_HSMU_TEST1_FLOAT 48 "NCD" 12 "FT" 3 "NO" 0 "ND" ;
SIG_VALTYPE_ 437070703 IOM_A_34_SYS_PRESS_2_YY_10 : 1;
SIG_VALTYPE_ 437005166 IOM_A_34_SYS_PRESS_2_YY_9 : 1;
SIG_VALTYPE_ 436939629 IOM_A_34_SYS_PRESS_2_YY_8 : 1;
SIG_VALTYPE_ 436874092 IOM_A_34_SYS_PRESS_2_YY_75 : 1;
SIG_VALTYPE_ 436874092 IOM_A_34_SYS_PRESS_2_YY_74 : 1;
SIG_VALTYPE_ 436874092 IOM_A_34_SYS_PRESS_2_YY_73 : 1;
SIG_VALTYPE_ 436874092 IOM_A_34_SYS_PRESS_2_YY_72 : 1;
SIG_VALTYPE_ 436874092 IOM_A_34_SYS_PRESS_2_YY_71 : 1;
SIG_VALTYPE_ 436808555 IOM_A_34_SYS_PRESS_2_YY_64 : 1;
SIG_VALTYPE_ 436808555 IOM_A_34_SYS_PRESS_2_YY_63 : 1;
SIG_VALTYPE_ 436808555 IOM_A_34_SYS_PRESS_2_YY_62 : 1;
SIG_VALTYPE_ 436808555 IOM_A_34_SYS_PRESS_2_YY_61 : 1;
SIG_VALTYPE_ 436743018 IOM_A_34_SYS_PRESS_2_YY_5 : 1;
SIG_VALTYPE_ 436743018 IOM_A_34_SYS_PRESS_2_YY_52 : 1;
SIG_VALTYPE_ 436743018 IOM_A_34_SYS_PRESS_2_YY_51 : 1;
SIG_VALTYPE_ 436677481 IOM_A_34_SYS_PRESS_2_YY_42 : 1;
SIG_VALTYPE_ 436677481 IOM_A_34_SYS_PRESS_2_YY_41 : 1;
SIG_VALTYPE_ 436611944 IOM_A_34_SYS_PRESS_2_YY_31 : 1;
SIG_VALTYPE_ 436546407 IOM_A_34_ACCU_PRESSURE_SGX_1_3 : 1;
SIG_VALTYPE_ 436546407 IOM_A_34_NORMAL_BRAKE_PRESSURE_W : 1;
SIG_VALTYPE_ 436546407 IOM_A_34_NORMAL_BRAKE_PRESS_0000 : 1;
SIG_VALTYPE_ 436546407 IOM_A_34_RSVR_MOVABLE_INDEX_YY_3 : 1;
SIG_VALTYPE_ 436546407 IOM_A_34_RSVR_LEVEL_YY_3 : 1;
SIG_VALTYPE_ 436546407 IOM_A_34_SYS_PRESS_2_YY_3 : 1;
SIG_VALTYPE_ 436480870 IOM_A_34_ACCU_PRESSURE_SGX_1_3 : 1;
SIG_VALTYPE_ 436480870 IOM_A_34_NORMAL_BRAKE_PRESS_0001 : 1;
SIG_VALTYPE_ 436480870 IOM_A_34_NORMAL_BRAKE_PRESS_0002 : 1;
SIG_VALTYPE_ 436480870 IOM_A_34_RSVR_MOVABLE_INDEX_YY_3 : 1;
SIG_VALTYPE_ 436480870 IOM_A_34_RSVR_LEVEL_YY_3 : 1;
SIG_VALTYPE_ 436480870 IOM_A_34_SYS_PRESS_2_YY_3 : 1;
